AUTOSAR XML (schema 3.1.4)
standard types defined: UInt8, UInt16, UInt32, SInt8, SInt16, SInt32
package /pwm_node2_hcs12
  ecu configuration pwm_node2_hcs12: ecu-sw-composition=SwComposition_pwm_node2_hcs12, module=[CanIf, Com, EcuC, EcuM, Os, PduR, Port, Pwm, Can]
  ecu sw composition SwComposition_pwm_node2_hcs12
  module config CanIf
    CanIfDispatchConfig: CanIfBusOffNotification=, CanIfErrorNotificaton=, CanIfWakeupNotification=, CanIfWakeupValidNotification=
    CanIfDriverConfig: CanIfBusoffNotification=true, CanIfReceiveIndication=false, CanIfTransmitCancellation=false, CanIfTxConfirmation=false, CanIfWakeupNotification=true
    CanIfInitConfiguration: CanIfConfigSet=, CanIfNumberOfCanRxPduIds=0, CanIfNumberOfCanTXPduIds=0, CanIfNumberOfDynamicCanTXPduIds=0
      Hoh_1 (CanIfInitHohConfig)
        RxHandler (CanIfHrhConfig): CanIfHrhType=BASIC_CAN, CanIfSoftwareFilterHrh=true, CanIfCanControllerHrhIdRef=CHANNEL_0, CanIfHrhIdSymRef=RxBox
      Rx_PDU_1 (CanIfRxPduConfig):
        CanIfCanRxPduCanId = 291
        CanIfCanRxPduDlc = 8
        CanIfCanRxPduId = 0
        CanIfReadRxPduData = false
        CanIfReadRxPduNotifyStatus = false
        CanIfRxPduIdCanIdType = EXTENDED_CAN
        CanIfRxUserType = PDUR
        CanIfUserRxIndication = 
        CanIfCanRxPduHrhRef = RxHandler
        PduIdRef = PduCollection/LedCommandRx
    CanIfPrivateConfiguration: CanIfDlcCheck=true, CanIfNumberOfTxBuffers=0, CanIfSoftwareFilterType=
    CanIfPublicConfiguration:
      CanIfDevErrorDetect = true
      CanIfMultipleDriverSupport = true
      CanIfNumberOfCanHwUnits = 1
      CanIfReadRxPduDataApi = false
      CanIfReadRxPduNotifyStatusApi = false
      CanIfReadTxPduNotifyStatusApi = false
      CanIfSetDynamicTxIdApi = false
      CanIfVersionInfoApi = true
      CanIfWakeupEventApi = false
    CHANNEL_0 (CanIfControllerConfig): CanIfWakeupSupport=NO_WAKEUP, CanIfControllerIdRef=CanConfigSet/CAN0
  module config Com
    ComConfig: ComConfigurationId=0
      RxGroup (ComIPduGroup): ComIPduGroupHandleId=0
      LedCommandRx (ComIPdu):
        ComIPduCallout = 
        ComIPduRxHandleId = 0
        ComIPduSignalProcessing = DEFERRED
        ComIPduDirection = RECEIVE
        ComIPduGroupRef = RxGroup
        PduIdRef = PduCollection/LedCommandRx
        ComIPduSignalRef = SetLedLevelRx
        ComTxIPdu: ComTxIPduMinimumDelayTimeFactor=0, ComTxIPduUnusedAreasDefault=0
          ComTxModeTrue
            ComTxMode: ComTxModeMode=DIRECT, ComTxModeNumberOfRepetitions=0, ComTxModeRepetitionPeriodFactor=0, ComTxModeTimeOffsetFactor=0, ComTxModeTimePeriodFactor=0
      SetLedLevelRx (ComSignal):
        ComBitPosition = 7
        ComBitSize = 16
        ComFirstTimeoutFactor = 0
        ComHandleId = 0
        ComNotification = 
        ComSignalEndianess = BIG_ENDIAN
        ComSignalInitValue = 0
        ComSignalLength = 0
        ComSignalType = UINT16
        ComTimeoutFactor = 0
        ComTimeoutNotification = 
        ComTransferProperty = TRIGGERED
    ComGeneral: ComConfigurationTimeBase=0.0, ComConfigurationUseDet=false
  module config EcuC
    PduCollection
      LedCommandRx (Pdu): PduLength=64
  module config EcuM
    EcuMGeneral: EcuMDevErrorDetect=false, EcuMIncludeNvramMgr=false, EcuMVersionInfoApi=false, EcuMMainFunctionPeriod=0.2
    EcuMConfiguration: EcuMNvramReadallTimeout=10.0, EcuMRunMinimumDuration=10.0, EcuMNvramWriteallTimeout=10.0
  module config Os
    OsOS:
      OsStackMonitoring = false
      OsStatus = EXTENDED
      OsUseGetServiceId = true
      OsUseParameterAccess = true
      OsUseResScheduler = true
      OsTickFrequency = 1000
      OsInterruptStackSize = 512
      OsIdleStackSize = 512
      ArcCoreOsUseDebug = false
      ArcCoreOsDebugTask = true
      ArcCoreOsDebugAlarm = true
      ArcCoreOsDebugResource = true
      ArcCoreOsDebugScheduleTable = true
      ArcCoreOsDebugEvent = true
      OsHooks: OsErrorHook=true, OsPostTaskHook=true, OsPreTaskHook=true, OsProtectionHook=false, OsShutdownHook=true, OsStartupHook=true
    ComTask (OsTask): OsTaskActivation=1, OsTaskPriority=1, OsTaskProcessType=BASIC, ArcCoreOsTaskStackSize=512, OsTaskSchedule=FULL
    StartupTask (OsTask): OsTaskActivation=1, OsTaskPriority=2, OsTaskProcessType=BASIC, ArcCoreOsTaskStackSize=512, OsTaskSchedule=FULL
      OsTaskAutostart
    OsTick (OsCounter): OsCounterMaxAllowedValue=65535, OsCounterMinCycle=0, OsCounterTicksPerBase=0, OsCounterType=OS_TICK
    ComAlarm (OsAlarm): OsAlarmCounterRef=OsTick
      OsAlarmActivateTask: OsAlarmActivateTaskRef=ComTask
      OsAlarmAutostart: OsAlarmAlarmTime=5, OsAlarmAutostartType=ABSOLUTE, OsAlarmCycleTime=20
  module config PduR
    PduRGeneral:
      PduRCanIfSupport = true
      PduRCanTpSupport = false
      PduRComSupport = true
      PduRDcmSupport = false
      PduRDevErrorDetect = false
      PduRFifoTxBufferSupport = false
      PduRFrIfSupport = false
      PduRFrTpSupport = false
      PduRGatewayOperation = false
      PduRIPduMSupport = false
      PduRLinIfSupport = false
      PduRLinTpSupport = false
      PduRMemorySize = 0
      PduRMinimumRoutingLoModule = 
      PduRMinimumRoutingLoRxPduId = 0
      PduRMinimumRoutingLoTxPduId = 0
      PduRMinimumRoutingUpModule = 
      PduRMinimumRoutingUpRxPduId = 0
      PduRMinimumRoutingUpTxPduId = 0
      PduRMulticastFromIfSupport = false
      PduRMulticastFromTpSupport = false
      PduRMulticastToIfSupport = false
      PduRMulticastToTpSupport = false
      PduRSbTxBufferSupport = false
      PduRSingleIf = CAN_IF
      PduRSingleTp = CAN_TP
      PduRVersionInfoApi = false
      PduRZeroCostOperation = true
    PduRGlobalConfig: PduRConfigurationId=0
      PduRRoutingTable
  module config Port
    PortConfigSet
      8 x PortContainer:
        II2C
          SDA (PortPin):
            PortPinPullMode = PULL_NONE
            PortPinDirection = PORT_PIN_IN
            PortPinDirectionChangeable = true
            PortPinHysteresisEnabled = false
            PortPinOpenDrainEnabled = false
            ArcReducedDrive = false
            ArcPortPinName = PJ6
            PortPinId = 38
            PortPinLevelValue = PORT_PIN_LEVEL_HIGH
            PortPinMode = 
          SCL (PortPin):
            PortPinPullMode = PULL_NONE
            PortPinDirection = PORT_PIN_OUT
            PortPinDirectionChangeable = false
            PortPinHysteresisEnabled = false
            PortPinOpenDrainEnabled = false
            ArcReducedDrive = false
            ArcPortPinName = PJ7
            PortPinId = 39
            PortPinLevelValue = PORT_PIN_LEVEL_HIGH
            PortPinMode = 
        CAN0
          TXD (PortPin):
            PortPinPullMode = 
            PortPinDirection = PORT_PIN_IN
            PortPinDirectionChangeable = false
            PortPinHysteresisEnabled = false
            PortPinOpenDrainEnabled = false
            ArcReducedDrive = false
            ArcPortPinName = PM1
            PortPinId = 49
            PortPinLevelValue = PORT_PIN_LEVEL_HIGH
            PortPinMode = 
          RXD (PortPin):
            PortPinPullMode = 
            PortPinDirection = PORT_PIN_IN
            PortPinDirectionChangeable = false
            PortPinHysteresisEnabled = false
            PortPinOpenDrainEnabled = false
            ArcReducedDrive = false
            ArcPortPinName = PM0
            PortPinId = 48
            PortPinLevelValue = PORT_PIN_LEVEL_HIGH
            PortPinMode = 
        LEDBAR
          8 x PortPin, all with PortPinPullMode=, PortPinDirection=PORT_PIN_OUT, PortPinDirectionChangeable=false, PortPinHysteresisEnabled=false, PortPinOpenDrainEnabled=false, ArcReducedDrive=false, PortPinLevelValue=PORT_PIN_LEVEL_HIGH, PortPinMode=:
            PB0: ArcPortPinName=PB0, PortPinId=16
            PB1: ArcPortPinName=PB1, PortPinId=17
            PB2: ArcPortPinName=PB2, PortPinId=18
            PB3: ArcPortPinName=PB3, PortPinId=19
            PB4: ArcPortPinName=PB4, PortPinId=20
            PB5: ArcPortPinName=PB5, PortPinId=21
            PB6: ArcPortPinName=PB6, PortPinId=22
            PB7: ArcPortPinName=PB7, PortPinId=23
        DIPSW
          8 x PortPin, all with PortPinPullMode=PULL_UP, PortPinDirection=PORT_PIN_IN, PortPinDirectionChangeable=false, PortPinHysteresisEnabled=false, PortPinOpenDrainEnabled=false, ArcReducedDrive=false, PortPinLevelValue=PORT_PIN_LEVEL_LOW, PortPinMode=:
            PH0: ArcPortPinName=PH0, PortPinId=24
            PH1: ArcPortPinName=PH1, PortPinId=25
            PH2: ArcPortPinName=PH2, PortPinId=26
            PH3: ArcPortPinName=PH3, PortPinId=27
            PH4: ArcPortPinName=PH4, PortPinId=28
            PH5: ArcPortPinName=PH5, PortPinId=29
            PH6: ArcPortPinName=PH6, PortPinId=30
            PH7: ArcPortPinName=PH7, PortPinId=31
        TIMER
          3 x PortPin, all with PortPinPullMode=PULL_NONE, PortPinDirectionChangeable=false, PortPinHysteresisEnabled=false, PortPinOpenDrainEnabled=false, ArcReducedDrive=false, PortPinMode=:
            PT0: PortPinDirection=PORT_PIN_IN, ArcPortPinName=PT0, PortPinId=72, PortPinLevelValue=PORT_PIN_LEVEL_HIGH
            PT1: PortPinDirection=PORT_PIN_IN, ArcPortPinName=PT1, PortPinId=73, PortPinLevelValue=PORT_PIN_LEVEL_HIGH
            BEEPER: PortPinDirection=PORT_PIN_OUT, ArcPortPinName=PT2, PortPinId=74, PortPinLevelValue=PORT_PIN_LEVEL_LOW
        PWM
          PP0 (PortPin):
            PortPinPullMode = PULL_NONE
            PortPinDirection = PORT_PIN_OUT
            PortPinDirectionChangeable = false
            PortPinHysteresisEnabled = false
            PortPinOpenDrainEnabled = false
            ArcReducedDrive = false
            ArcPortPinName = PP0
            PortPinId = 56
            PortPinLevelValue = PORT_PIN_LEVEL_LOW
            PortPinMode = 
          PP1 (PortPin):
            PortPinPullMode = PULL_NONE
            PortPinDirection = PORT_PIN_OUT
            PortPinDirectionChangeable = false
            PortPinHysteresisEnabled = false
            PortPinOpenDrainEnabled = false
            ArcReducedDrive = false
            ArcPortPinName = PP1
            PortPinId = 57
            PortPinLevelValue = PORT_PIN_LEVEL_LOW
            PortPinMode = 
        SCI0
          RXD0 (PortPin):
            PortPinPullMode = PULL_UP
            PortPinDirection = PORT_PIN_IN
            PortPinDirectionChangeable = false
            PortPinHysteresisEnabled = false
            PortPinOpenDrainEnabled = false
            ArcReducedDrive = false
            ArcPortPinName = PS0
            PortPinId = 56
            PortPinLevelValue = PORT_PIN_LEVEL_HIGH
            PortPinMode = 
          TXD0 (PortPin):
            PortPinPullMode = PULL_NONE
            PortPinDirection = PORT_PIN_IN
            PortPinDirectionChangeable = false
            PortPinHysteresisEnabled = false
            PortPinOpenDrainEnabled = false
            ArcReducedDrive = false
            ArcPortPinName = PS1
            PortPinId = 57
            PortPinLevelValue = PORT_PIN_LEVEL_HIGH
            PortPinMode = 
        SCI1
          4 x PortPin, all with PortPinDirection=PORT_PIN_IN, PortPinDirectionChangeable=false, PortPinHysteresisEnabled=false, PortPinOpenDrainEnabled=false, ArcReducedDrive=false, PortPinLevelValue=PORT_PIN_LEVEL_HIGH, PortPinMode=:
            RXD1: PortPinPullMode=PULL_UP, ArcPortPinName=PS2, PortPinId=58
            TXD1: PortPinPullMode=PULL_NONE, ArcPortPinName=PS3, PortPinId=59
            PM6: PortPinPullMode=PULL_NONE, ArcPortPinName=PM6, PortPinId=54
            PM7: PortPinPullMode=PULL_NONE, ArcPortPinName=PM7, PortPinId=55
    PortGeneral: PortDevErrorDetect=true, PortSetPinDirectionApi=false, PortSetPinModeApi=false, PortVersionInfoApi=true
  module config Pwm
    PwmChannelConfigSet
      PWM_CHANNEL_1 (PwmChannel):
        ArcPwmCenterAlign = false
        ArcPwmScaledClockEnable = true
        PwmChannelClass = PWM_VARIABLE_PERIOD
        PwmChannelId = 0
        PwmDutycycleDefault = 24576
        PwmIdleState = PWM_LOW
        PwmNotification = 
        PwmPeriodDefault = 188.0
        PwmPolarity = POLARITY_NORMAL
    PwmConfigurationOfOptApiServices: PwmDeInitApi=false, PwmGetOutputState=false, PwmSetDutyCycle=true, PwmSetOutputToIdle=false, PwmSetPeriodAndDuty=true, PwmVersionInfoApi=false
    PwmGeneral:
      ArcPwmFreezeEnable = false
      PwmDevErorDetect = true
      PwmDutycycleUpdatedEndperiod = true
      PwmIndex = 1
      PwmNotificationSupported = false
      PwmPeriodUpdatedEndperiod = true
      ArcPwmChannelBusPrescalerA = PRESCALER_128
      ArcPwmChannelBusPrescalerB = PRESCALER_2
      ArcPwmChannelPrescalerA = 1
      ArcPwmChannelPrescalerB = 1
  module config Can
    CanConfigSet
      CAN0 (CanController):
        CanControllerActivation = true
        CanControllerLoopback = false
        CanControllerBaudRate = 125
        CanHWControllerId = CAN_CTRL_0
        CanControllerPropSeg = 0
        CanControllerSeg1 = 12
        CanControllerSeg2 = 1
        Mask_1 (CanFilterMask): ArcCanHcs12IdamMaskType=CAN_ARC_IDAM_2_32BIT, ArcCanHcs12ArcIdmrValue=18446744073709551615, ArcCanHcs12ArcIdarValue=0
      RxBox (CanHardwareObject): CanIdType=EXTENDED, CanObjectType=RECEIVE, CanMBMask=0, CanControllerRef=CanConfigSet/CAN0, CanFilterMaskRef=Mask_1
      TxBox (CanHardwareObject): CanIdType=EXTENDED, CanObjectType=TRANSMIT, CanMBMask=0, CanControllerRef=CanConfigSet/CAN0, CanFilterMaskRef=Mask_1
    CanGeneral: CanDevErrorDetection=false, CanMultiplexedTransmission=false, CanVersionInfoApi=false
package /pwm_node2_hcs12/GeneratedSystemSignals
  system signal SetLedLevelRx: init-value=SetLedLevelRxInitValueLiteral, length=16
package /pwm_node2_hcs12/GeneratedSystemSignals/Data/IntegerLiterals
  constant specification SetLedLevelRxInitValue
    value:
      integer literal SetLedLevelRxInitValueLiteral: value=0
