AUTOSAR XML (schema 3.1.0)
package /pwm_node_mpc551x
  elements ecu-configuration=module=[Os, EcuC, Com, Can, CanIf, Pwm, Port]:
    module config Os: module-description=/ArcCore/Os
      OsOS: OsTickFrequency=1000
        OsHooks: OsErrorHook=true, OsPostTaskHook=true, OsPreTaskHook=true, OsProtectionHook=true, OsShutdownHook=true, OsStartupHook=true
      OsTick (OsCounter): OsCounterMaxAllowedValue=65535, OsCounterMinCycle=1, OsCounterTicksPerBase=1, OsCounterType=OS-TICK
      ComTask (OsTask): OsTaskPriority=1, OsTaskProcessType=BASIC
      StartupTask (OsTask): OsTaskPriority=2, OsTaskProcessType=BASIC
        OsTaskAutostart
      ComAlarm (OsAlarm): OsAlarmCounterRef=/pwm_node_mpc551x/Os/OsTick
        OsAlarmAutostart: OsAlarmAlarmTime=5, OsAlarmAutostartType=ABSOLUTE, OsAlarmCycleTime=20
        ActivateTask (OsAlarmActivateTask): OsAlarmActivateTaskRef=/pwm_node_mpc551x/Os/ComTask
    module config EcuC: module-description=/ArcCore/EcuC
      PduCollection
        LedCommandRx (Pdu): PduLength=64
    module config Com: module-description=/ArcCore/Com
      ComConfig: ComConfigurationId=(unset)
        RxGroup (ComIPduGroup): ComIPduGroupHandleId=(unset)
        LedCommandRx (ComIPdu):
          ComIPduCallout = (unset)
          ComIPduRxHandleId = (unset)
          ComIPduSignalProcessing = IMMEDIATE
          ComIPduDirection = RECEIVE
          ComIPduGroupRef = /pwm_node_mpc551x/Com/ComConfig/RxGroup
          PduIdRef = /pwm_node_mpc551x/EcuC/PduCollection/LedCommandRx
          ComIPduSignalRef = /pwm_node_mpc551x/Com/ComConfig/SetLedLevelRx
          ComTxIPdu: ComTxIPduMinimumDelayTimeFactor=0, ComTxIPduUnusedAreasDefault=0
            ComTxModeTrue
              ComTxMode: ComTxModeMode=DIRECT, ComTxModeNumberOfRepetitions=0, ComTxModeRepetitionPeriodFactor=0, ComTxModeTimeOffsetFactor=0, ComTxModeTimePeriodFactor=0
        SetLedLevelRx (ComSignal):
          ComBitPosition = 0
          ComBitSize = 16
          ComFirstTimeoutFactor = 0
          ComHandleId = (unset)
          ComNotification = (unset)
          ComSignalEndianess = BIG_ENDIAN
          ComSignalInitValue = 0
          ComSignalLength = (unset)
          ComSignalType = UINT16
          ComTimeoutFactor = 0
          ComTimeoutNotification = (unset)
          ComTransferProperty = TRIGGERED
      ComGeneral: ComConfigurationTimeBase=(unset), ComConfigurationUseDet=false
    module config Can: module-description=/ArcCore/Can
      CanConfigSet
        Can_A (CanController):
          CanControllerActivation = true
          CanControllerLoopback = false
          CanControllerBaudRate = 125
          CanHWControllerId = FLEXCAN_A
          CanControllerPropSeg = 4
          CanControllerSeg1 = 4
          CanControllerSeg2 = 4
          Mask_1 (CanFilterMask): CanFilterMaskValue=0
        HWObj_1 (CanHardwareObject):
          CanIdType = EXTENDED
          CanObjectType = RECEIVE
          CanMBMask = 16711680
          CanControllerRef = /pwm_node_mpc551x/Can/CanConfigSet/Can_A
          CanFilterMaskRef = /pwm_node_mpc551x/Can/CanConfigSet/Can_A/Mask_1
      CanGeneral: CanDevErrorDetection=false, CanMultiplexedTransmission=false, CanVersionInfoApi=false
    module config CanIf: module-description=/ArcCore/CanIf
      CanIfDispatchConfig: CanIfBusOffNotification=(unset), CanIfErrorNotificaton=(unset), CanIfWakeupNotification=(unset), CanIfWakeupValidNotification=(unset)
      CanIfDriverConfig: CanIfBusoffNotification=true, CanIfReceiveIndication=false, CanIfTransmitCancellation=false, CanIfTxConfirmation=false, CanIfWakeupNotification=true
      CanIfInitConfiguration: CanIfConfigSet=(unset), CanIfNumberOfCanRxPduIds=(unset), CanIfNumberOfCanTXPduIds=(unset), CanIfNumberOfDynamicCanTXPduIds=(unset)
        Hoh_1 (CanIfInitHohConfig)
          Hrh_1 (CanIfHrhConfig):
            CanIfHrhType = BASIC_CAN
            CanIfSoftwareFilterHrh = true
            CanIfCanControllerHrhIdRef = /pwm_node_mpc551x/CanIf/CHANNEL_0
            CanIfHrhIdSymRef = /pwm_node_mpc551x/Can/CanConfigSet/HWObj_1
        Rx_PDU_1 (CanIfRxPduConfig):
          CanIfCanRxPduCanId = 291
          CanIfCanRxPduDlc = 8
          CanIfCanRxPduId = (unset)
          CanIfReadRxPduData = false
          CanIfReadRxPduNotifyStatus = true
          CanIfRxPduIdCanIdType = EXTENDED_CAN
          CanIfRxUserType = PDUR
          CanIfUserRxIndication = (unset)
          CanIfCanRxPduHrhRef = /pwm_node_mpc551x/CanIf/CanIfInitConfiguration/Hoh_1/Hrh_1
          PduIdRef = /pwm_node_mpc551x/EcuC/PduCollection/LedCommandRx
      CanIfPrivateConfiguration: CanIfDlcCheck=true, CanIfNumberOfTxBuffers=(unset), CanIfSoftwareFilterType=(unset)
      CanIfPublicConfiguration:
        CanIfDevErrorDetect = true
        CanIfMultipleDriverSupport = true
        CanIfNumberOfCanHwUnits = 1
        CanIfReadRxPduDataApi = false
        CanIfReadRxPduNotifyStatusApi = false
        CanIfReadTxPduNotifyStatusApi = false
        CanIfSetDynamicTxIdApi = false
        CanIfVersionInfoApi = true
        CanIfWakeupEventApi = false
      CanIfTransceiverDrvConfig: CanIfTrcvWakeupNotification=false
      CHANNEL_0 (CanIfControllerConfig): CanIfWakeupSupport=NO_WAKEUP, CanIfControllerIdRef=/pwm_node_mpc551x/Can/CanConfigSet/Can_A
    module config Pwm: module-description=/ArcCore/Pwm
      PwmChannelConfigSet
        PWM_CHANNEL_1 (PwmChannel):
          PwmChannelClass = PWM_VARIABLE_PERIOD
          PwmChannelId = 12
          PwmDutycycleDefault = 0
          PwmIdleState = PWM_LOW
          PwmArcticCoreChannelPrescaler = PWM_CHANNEL_PRESCALER_1
          PwmNotification = 
          PwmPeriodDefault = 0.0010
          PwmPolarity = PWM_LOW
      PwmConfigurationOfOptApiServices: PwmDeInitApi=false, PwmGetOutputState=true, PwmSetDutyCycle=true, PwmSetOutputToIdle=false, PwmSetPeriodAndDuty=true, PwmVersionInfoApi=false
      PwmGeneral: PwmDevErorDetect=true, PwmDutycycleUpdatedEndperiod=true, PwmIndex=1, PwmNotificationSupported=true, PwmPeriodUpdatedEndperiod=true
    module config Port: module-description=/ArcCore/Port
      PortConfigSet
        PWM (PortContainer)
          eMIOS[12] (PortPin):
            PortPinPullMode = PULL_NONE
            PortPinDirection = PORT_PIN_OUT
            PortPinDirectionChangeable = false
            PortPinHysteresisEnabled = false
            PortPinOpenDrainEnabled = false
            PortPinId = 52
            PortPinSlewRate = SLEW_RATE_MIN
            PortPinLevelValue = PORT_PIN_LEVEL_LOW
            PortPinMode = PORT_PIN_MODE_PWM
        CAN (PortContainer)
          CNTX_A (PortPin):
            PortPinPullMode = PULL_NONE
            PortPinDirection = PORT_PIN_OUT
            PortPinDirectionChangeable = false
            PortPinHysteresisEnabled = false
            PortPinOpenDrainEnabled = false
            PortPinId = 48
            PortPinSlewRate = SLEW_RATE_MIN
            PortPinLevelValue = PORT_PIN_LEVEL_LOW
            PortPinMode = PORT_PIN_MODE_CAN
          CNRX_A (PortPin):
            PortPinPullMode = PULL_NONE
            PortPinDirection = PORT_PIN_IN
            PortPinDirectionChangeable = false
            PortPinHysteresisEnabled = false
            PortPinOpenDrainEnabled = false
            PortPinId = 49
            PortPinSlewRate = SLEW_RATE_MIN
            PortPinLevelValue = PORT_PIN_LEVEL_LOW
            PortPinMode = PORT_PIN_MODE_CAN
      PortGeneral: PortDevErrorDetect=true, PortSetPinDirectionApi=false, PortSetPinModeApi=false, PortVersionInfoApi=true
