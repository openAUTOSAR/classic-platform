AUTOSAR XML (schema 3.1.4)
package /wdgm_node_stm32
  ecu configuration wdgm_node_stm32: ecu-sw-composition=SwComposition_wdgm_node_stm32, module=[Os, Port, Dio, Mcu]
  ecu sw composition SwComposition_wdgm_node_stm32
  module config Os
    OsOS:
      OsStackMonitoring = true
      OsStatus = EXTENDED
      OsUseGetServiceId = true
      OsUseParameterAccess = true
      OsUseResScheduler = true
      OsTickFrequency = 2000
      OsInterruptStackSize = 2048
      OsIdleStackSize = 512
      ArcCoreOsUseDebug = false
      ArcCoreOsDebugTask = true
      ArcCoreOsDebugAlarm = true
      ArcCoreOsDebugResource = true
      ArcCoreOsDebugScheduleTable = true
      ArcCoreOsDebugEvent = true
      OsHooks: OsErrorHook=true, OsPostTaskHook=true, OsPreTaskHook=true, OsProtectionHook=false, OsShutdownHook=true, OsStartupHook=true
    Alarm_4ms (OsAlarm): OsAlarmCounterRef=OsTick
      OsAlarmAutostart: OsAlarmAlarmTime=10, OsAlarmAutostartType=ABSOLUTE, OsAlarmCycleTime=50
      OsAlarmSetEvent: OsAlarmSetEventRef=EVENT_2, OsAlarmSetEventTaskRef=etask_1
    OsTick (OsCounter): OsCounterMaxAllowedValue=65535, OsCounterMinCycle=0, OsCounterTicksPerBase=0, OsCounterType=OS_TICK
    3 x OsTask, all with OsTaskActivation=1, OsTaskSchedule=FULL:
      btask_3: OsTaskPriority=3, OsTaskProcessType=BASIC, ArcCoreOsTaskStackSize=1048
      etask_1: OsTaskPriority=1, OsTaskProcessType=EXTENDED, ArcCoreOsTaskStackSize=2048
        OsTaskAutostart
      etask_2: OsTaskPriority=2, OsTaskProcessType=EXTENDED, ArcCoreOsTaskStackSize=2048
        OsTaskAutostart
    3 x OsEvent:
      EVENT_1: OsEventMask=1
      EVENT_0: OsEventMask=0
      EVENT_2: OsEventMask=2
    Alarm_WdM (OsAlarm): OsAlarmCounterRef=OsTick
      OsAlarmActivateTask: OsAlarmActivateTaskRef=WDTask
      OsAlarmAutostart: OsAlarmAlarmTime=1, OsAlarmAutostartType=ABSOLUTE, OsAlarmCycleTime=1
    WDTask (OsTask): OsTaskActivation=1, OsTaskPriority=4, OsTaskProcessType=BASIC, ArcCoreOsTaskStackSize=1048, OsTaskSchedule=FULL
    WDFailureCounter (OsCounter): OsCounterMaxAllowedValue=65535, OsCounterMinCycle=1, OsCounterTicksPerBase=0, OsCounterType=SOFTWARE
  module config Port
    PortConfigSet
      PortContainer_1 (PortContainer)
        8 x PortPin, all with PortPinPullMode=, PortPinDirection=OUTPUT_2MHz_MODE, PortPinDirectionChangeable=false, PortPinHysteresisEnabled=false, PortPinOpenDrainEnabled=false, ArcReducedDrive=false, ArcPortPinName=, PortPinMode=OUTPUT_PUSHPULL_CNF:
          B15: PortPinId=31, PortPinLevelValue=OUTPUT_HIGH
          B8: PortPinId=24, PortPinLevelValue=OUTPUT_LOW
          B9: PortPinId=25, PortPinLevelValue=OUTPUT_LOW
          B10: PortPinId=26, PortPinLevelValue=OUTPUT_LOW
          B11: PortPinId=27, PortPinLevelValue=OUTPUT_LOW
          B12: PortPinId=28, PortPinLevelValue=OUTPUT_LOW
          B13: PortPinId=29, PortPinLevelValue=OUTPUT_LOW
          B14: PortPinId=30, PortPinLevelValue=OUTPUT_LOW
    PortGeneral: ArcGpioRemap=, PortDevErrorDetect=false, PortSetPinDirectionApi=false, PortSetPinModeApi=false, PortVersionInfoApi=false
  module config Dio
    DioGeneral: DioDevErrorDetect=false, DioVersionInfoApi=false
    DioPort_1 (DioPort): DioPortId=0, ArcCoreDioPhysicalPort=B
      HeartBeatLED (DioChannel): DioChannelId=31
  module config Mcu
    McuGeneralConfiguration: McuDevErrorDetect=false, McuPerformResetApi=true, McuVersionInfoApi=true
    McuModuleConfiguration: McuClockSrcFailureNotification=DISABLED, McuNumberOfMcuModes=0, McuRamSectors=1, McuResetSetting=0
      McuClockSettingConfig:
        ArcAPB1ClocksEnable = TIM3
        ArcAPB2ClocksEnable = GPIOB
        ArcAPB1ClocksEnable = WWDG
        ArcAPB1ClocksEnable = TIM2
        ArcAPB2ClocksEnable = AFIO
        McuDefaultClockReference = Clock
        Clock (McuClockReferencePoint): McuClockReferencePointFrequency=8000000.0, McuClockReferencePointPllEprediv=9, McuClockReferencePointPllEmfd=8, McuClockReferencePointPllErfd=0
      McuModeSettingConf: McuMode=0
