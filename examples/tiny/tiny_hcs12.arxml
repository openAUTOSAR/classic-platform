AUTOSAR XML (schema 3.1.2)
# Copyright ArcCore AB 2010
package /tiny_hcs12
  ecu configuration tiny_hcs12: module=Os
  module config Os
    OsOS:
      OsStackMonitoring = true
      OsStatus = EXTENDED
      OsUseGetServiceId = true
      OsUseParameterAccess = true
      OsUseResScheduler = true
      OsTickFrequency = 1000
      OsInterruptStackSize = 512
      OsIdleStackSize = 200
      ArcCoreOsUseDebug = false
      ArcCoreOsDebugTask = true
      ArcCoreOsDebugAlarm = true
      ArcCoreOsDebugResource = true
      ArcCoreOsDebugScheduleTable = true
      ArcCoreOsDebugEvent = true
      OsHooks: OsErrorHook=true, OsPostTaskHook=true, OsPreTaskHook=true, OsProtectionHook=false, OsShutdownHook=true, OsStartupHook=true
    3 x OsTask, all with OsTaskActivation=1, ArcCoreOsTaskStackSize=512, OsTaskSchedule=FULL:
      etask_1: OsTaskPriority=1, OsTaskProcessType=EXTENDED
        OsTaskAutostart
      etask_2: OsTaskPriority=2, OsTaskProcessType=EXTENDED
        OsTaskAutostart
      btask_3: OsTaskPriority=3, OsTaskProcessType=BASIC
    Alarm_4ms (OsAlarm): OsAlarmCounterRef=OsTick
      OsAlarmAutostart: OsAlarmAlarmTime=100, OsAlarmAutostartType=ABSOLUTE, OsAlarmCycleTime=4
      OsAlarmSetEvent: OsAlarmSetEventRef=EVENT_2, OsAlarmSetEventTaskRef=etask_1
    OsTick (OsCounter): OsCounterMaxAllowedValue=65535, OsCounterMinCycle=0, OsCounterTicksPerBase=0, OsCounterType=OS_TICK
    3 x OsEvent:
      EVENT_{0..2}: OsEventMask={0..2}
