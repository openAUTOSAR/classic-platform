AUTOSAR XML (schema 3-1-5)
package /rte_simple_extract
  system rte_simple_extract
    mapping rte_simple_extract_mapping
      data-mappings:
        data-element=rte_simple_extract_softwareComposition.Arguments.arg1, signal=Arg1
        data-element=rte_simple_extract_softwareComposition.Arguments.arg2, signal=Arg2
        data-element=rte_simple_extract_softwareComposition.Result.result, signal=Result
      sw-impl-mappings:
        swc to impl mapping Calculator_prototypeImplMapping: component-implementation=CalculatorImplementation, component=rte_simple_extract_softwareComposition.Calculator_prototype.Calculator_prototype
        swc to impl mapping Tester_prototypeImplMapping: component-implementation=TesterImplementation, component=rte_simple_extract_softwareComposition.Tester_prototype.Tester_prototype
    software composition rte_simple_extract_softwareComposition: software-composition=rte_simple_extract_toplevelcomposition
  composition type rte_simple_extract_toplevelcomposition
    require port Arguments: required-interface=ArgumentIf
    provide port Result: provided-interface=ResultIf
    component Calculator_prototype: type=Calculator
    component Tester_prototype: type=Tester
    connect Calculator_prototype.Port -> Tester_prototype.Calculator
    delegate Tester_prototype.Arguments <-> outer port Arguments
    delegate Tester_prototype.Result <-> outer port Result
