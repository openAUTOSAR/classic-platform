AUTOSAR XML (schema 3-1-5)
package /rte_simple_extract
  system rte_simple_extract
    mapping rte_simple_extract_mapping
      data-mappings:
        data-element=rte_simple_extract_softwareComposition.Arguments.arg1, signal=Arg1
        data-element=rte_simple_extract_softwareComposition.Arguments.arg2, signal=Arg2
        data-element=rte_simple_extract_softwareComposition.Result.result, signal=ResultSig
        data-element=rte_simple_extract_softwareComposition.FreqReq.freq, signal=FreqReqSig
        data-element=rte_simple_extract_softwareComposition.FreqReqInd.freq, signal=FreqIndSig
      sw-impl-mappings:
        4 x swc to impl mapping:
          Calculator_prototypeImplMapping: component-implementation=CalculatorImplementation, component=rte_simple_extract_softwareComposition.Calculator_prototype.Calculator_prototype
          Tester_prototypeImplMapping: component-implementation=TesterImplementation, component=rte_simple_extract_softwareComposition.Tester_prototype.Tester_prototype
          Logger_prototypeImplMapping: component-implementation=LoggerImplementation, component=rte_simple_extract_softwareComposition.Logger_prototype.Logger_prototype
          Logger2_prototypeImplMapping: component-implementation=Logger2Implementation, component=rte_simple_extract_softwareComposition.Logger2_prototype.Logger2_prototype
    software composition rte_simple_extract_softwareComposition: software-composition=rte_simple_extract_toplevelcomposition
  composition type rte_simple_extract_toplevelcomposition
    require port Arguments: required-interface=ArgumentIf
    provide port Result: provided-interface=ResultIf
    require port FreqReq: required-interface=FreqReqIf
    provide port FreqReqInd: provided-interface=FreqReqIf
    4 x component:
      Calculator_prototype: type=Calculator
      Tester_prototype: type=Tester
      Logger_prototype: type=Logger
      Logger2_prototype: type=Logger2
    connect Calculator_prototype.Port -> Tester_prototype.Calculator
    delegate Tester_prototype.Arguments <-> outer port Arguments
    delegate Tester_prototype.Result <-> outer port Result
    connect Tester_prototype.Result -> Logger_prototype.Result
    connect Tester_prototype.Result -> Logger2_prototype.Result
    delegate Tester_prototype.FreqReq <-> outer port FreqReq
    delegate Tester_prototype.FreqReqInd <-> outer port FreqReqInd
