AUTOSAR XML (schema 3.1.2)
# Copyright ArcCore AB 2010
standard types defined: UInt8, UInt16, UInt32, SInt8, SInt16, SInt32
package /switch_node_mpc551x
  ecu configuration switch_node_mpc551x: ecu-sw-composition=SwComposition_switch_node_mpc551x, module=[Can, CanIf, Com, EcuC, Os, PduR, Port, EcuM]
  module config Can
    CanConfigSet
      Controller_1 (CanController):
        CanControllerActivation = true
        CanControllerLoopback = false
        CanControllerBaudRate = 125
        CanHWControllerId = FLEXCAN_A
        CanControllerPropSeg = 4
        CanControllerSeg1 = 4
        CanControllerSeg2 = 4
        Mask_1 (CanFilterMask): CanFilterMaskValue=0
      HWObj_1 (CanHardwareObject): CanIdType=EXTENDED, CanObjectType=TRANSMIT, CanMBMask=16711680, CanControllerRef=Controller_1, CanFilterMaskRef=Mask_1
    CanGeneral: CanDevErrorDetection=false, CanMultiplexedTransmission=false, CanVersionInfoApi=false
  module config CanIf
    CanIfDispatchConfig: CanIfBusOffNotification=, CanIfErrorNotificaton=, CanIfWakeupNotification=, CanIfWakeupValidNotification=
    CanIfDriverConfig: CanIfBusoffNotification=true, CanIfReceiveIndication=false, CanIfTransmitCancellation=false, CanIfTxConfirmation=false, CanIfWakeupNotification=true
    CanIfInitConfiguration: CanIfConfigSet=, CanIfNumberOfCanRxPduIds=0, CanIfNumberOfCanTXPduIds=0, CanIfNumberOfDynamicCanTXPduIds=0
      Hoh_1 (CanIfInitHohConfig)
        Hth_1 (CanIfHthConfig): CanIfHthType=BASIC_CAN, CanIfCanControllerIdRef=CHANNEL_0, CanIfHthIdSymRef=HWObj_1
      Tx_PDU_1 (CanIfTxPduConfig):
        CanIfCanTxPduId = 0
        CanIfCanTxPduIdCanId = 291
        CanIfCanTxPduIdDlc = 8
        CanIfCanTxPduType = STATIC
        CanIfReadTxPduNotifyStatus = true
        CanIfTxPduIdCanIdType = EXTENDED_CAN
        CanIfTxUserType = PDUR
        CanIfUserTxConfirmation = 
        CanIfCanTxPduHthRef = Hth_1
        PduIdRef = PduCollection/LedCommandTx
    CanIfPrivateConfiguration: CanIfDlcCheck=true, CanIfNumberOfTxBuffers=0, CanIfSoftwareFilterType=
    CanIfPublicConfiguration:
      CanIfDevErrorDetect = true
      CanIfMultipleDriverSupport = true
      CanIfNumberOfCanHwUnits = 1
      CanIfReadRxPduDataApi = false
      CanIfReadRxPduNotifyStatusApi = false
      CanIfReadTxPduNotifyStatusApi = false
      CanIfSetDynamicTxIdApi = false
      CanIfVersionInfoApi = true
      CanIfWakeupEventApi = false
      ArcCanIfDynamicPduConfiguration = false
    CHANNEL_0 (CanIfControllerConfig): CanIfWakeupSupport=NO_WAKEUP, CanIfControllerIdRef=Controller_1
  module config Com
    ComConfig: ComConfigurationId=0
      TxGroup (ComIPduGroup): ComIPduGroupHandleId=0
      LedCommandTx (ComIPdu):
        ComIPduCallout = 
        ComIPduRxHandleId = 0
        ComIPduSignalProcessing = DEFERRED
        ComIPduDirection = SEND
        ComIPduGroupRef = TxGroup
        PduIdRef = PduCollection/LedCommandTx
        ComIPduSignalRef = SetLedLevelTx
        ComTxIPdu: ComTxIPduMinimumDelayTimeFactor=0, ComTxIPduUnusedAreasDefault=0
          ComTxModeTrue
            ComTxMode: ComTxModeMode=DIRECT, ComTxModeNumberOfRepetitions=0, ComTxModeRepetitionPeriodFactor=0, ComTxModeTimeOffsetFactor=0, ComTxModeTimePeriodFactor=0
      SetLedLevelTx (ComSignal):
        ComBitPosition = 7
        ComBitSize = 16
        ComFirstTimeoutFactor = 0
        ComHandleId = 0
        ComNotification = 
        ComSignalEndianess = BIG_ENDIAN
        ComSignalInitValue = 0
        ComSignalLength = 0
        ComSignalType = UINT16
        ComTimeoutFactor = 0
        ComTimeoutNotification = 
        ComTransferProperty = TRIGGERED
    ComGeneral: ComConfigurationTimeBase=0.0, ComConfigurationUseDet=false
  module config EcuC
    PduCollection
      LedCommandTx (Pdu): PduLength=64
  module config Os
    OsOS:
      OsStackMonitoring = true
      OsStatus = EXTENDED
      OsUseGetServiceId = true
      OsUseParameterAccess = true
      OsUseResScheduler = true
      OsTickFrequency = 1000
      OsInterruptStackSize = 2048
      OsIdleStackSize = 512
      ArcCoreOsUseDebug = true
      ArcCoreOsDebugTask = true
      ArcCoreOsDebugAlarm = true
      ArcCoreOsDebugResource = true
      ArcCoreOsDebugScheduleTable = true
      ArcCoreOsDebugEvent = true
      OsHooks: OsErrorHook=true, OsPostTaskHook=true, OsPreTaskHook=true, OsProtectionHook=false, OsShutdownHook=true, OsStartupHook=true
    ComAlarm (OsAlarm): OsAlarmCounterRef=OsTick
      OsAlarmAutostart: OsAlarmAlarmTime=5, OsAlarmAutostartType=RELATIVE, OsAlarmCycleTime=20
      OsAlarmActivateTask: OsAlarmActivateTaskRef=ComTask
    ReadSwAlarm (OsAlarm): OsAlarmCounterRef=OsTick
      OsAlarmAutostart: OsAlarmAlarmTime=10, OsAlarmAutostartType=RELATIVE, OsAlarmCycleTime=30
      OsAlarmActivateTask: OsAlarmActivateTaskRef=ReadSwitches
    OsTick (OsCounter): OsCounterMaxAllowedValue=65535, OsCounterMinCycle=0, OsCounterTicksPerBase=0, OsCounterType=OS_TICK
    3 x OsTask, all with OsTaskActivation=1, OsTaskProcessType=BASIC, ArcCoreOsTaskStackSize=2048, OsTaskSchedule=FULL:
      ComTask: OsTaskPriority=10
      ReadSwitches: OsTaskPriority=5
      StartupTask: OsTaskPriority=20
        OsTaskAutostart
  module config PduR
    PduRGeneral:
      PduRCanIfSupport = true
      PduRCanTpSupport = false
      PduRComSupport = true
      PduRDcmSupport = false
      PduRDevErrorDetect = false
      PduRFifoTxBufferSupport = false
      PduRFrIfSupport = false
      PduRFrTpSupport = false
      PduRGatewayOperation = false
      PduRIPduMSupport = false
      PduRLinIfSupport = false
      PduRLinTpSupport = false
      PduRMemorySize = 0
      PduRMinimumRoutingLoModule = 
      PduRMinimumRoutingLoRxPduId = 0
      PduRMinimumRoutingLoTxPduId = 0
      PduRMinimumRoutingUpModule = 
      PduRMinimumRoutingUpRxPduId = 0
      PduRMinimumRoutingUpTxPduId = 0
      PduRMulticastFromIfSupport = false
      PduRMulticastFromTpSupport = false
      PduRMulticastToIfSupport = false
      PduRMulticastToTpSupport = false
      PduRSbTxBufferSupport = false
      PduRSingleIf = CAN_IF
      PduRSingleTp = CAN_TP
      PduRVersionInfoApi = false
      PduRZeroCostOperation = true
    PduRGlobalConfig: PduRConfigurationId=0
      PduRRoutingTable
  module config Port
    PortConfigSet
      Can (PortContainer)
        CNTX_A (PortPin):
          PortPinPullMode = PULL_NONE
          PortPinDirection = PORT_PIN_OUT
          PortPinDirectionChangeable = false
          PortPinHysteresisEnabled = false
          PortPinOpenDrainEnabled = false
          PortPinId = 48
          PortPinSlewRate = SLEW_RATE_MIN
          PortPinLevelValue = PORT_PIN_LEVEL_LOW
          PortPinMode = PORT_PIN_MODE_CAN
        CNRX_A (PortPin):
          PortPinPullMode = PULL_NONE
          PortPinDirection = PORT_PIN_IN
          PortPinDirectionChangeable = false
          PortPinHysteresisEnabled = false
          PortPinOpenDrainEnabled = false
          PortPinId = 49
          PortPinSlewRate = SLEW_RATE_MIN
          PortPinLevelValue = PORT_PIN_LEVEL_LOW
          PortPinMode = PORT_PIN_MODE_CAN
    PortGeneral: PortDevErrorDetect=false, PortSetPinDirectionApi=false, PortSetPinModeApi=false, PortVersionInfoApi=false
  module config EcuM
    EcuMGeneral: EcuMDevErrorDetect=false, EcuMIncludeNvramMgr=false, EcuMVersionInfoApi=false, EcuMMainFunctionPeriod=0.2
    EcuMConfiguration: EcuMNvramReadallTimeout=10.0, EcuMRunMinimumDuration=10.0, EcuMNvramWriteallTimeout=10.0
      EcuMUserConfig
  ecu sw composition SwComposition_switch_node_mpc551x
package /switch_node_mpc551x/GeneratedSystemSignals
  system signal SetLedLevelTx: init-value=SetLedLevelTxInitValueLiteral, length=16
package /switch_node_mpc551x/GeneratedSystemSignals/Data/IntegerLiterals
  constant specification SetLedLevelTxInitValue
    value:
      integer literal SetLedLevelTxInitValueLiteral: value=0
