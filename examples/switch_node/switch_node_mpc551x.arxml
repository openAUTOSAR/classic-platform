AUTOSAR XML (schema 3.1.0)
package /switch_node_mpc551x
  elements ecu-configuration=module=[Os, EcuC, CanIf, Can, Com, Port]:
    module config Os: module-description=/ArcCore/Os
      OsOS: OsTickFrequency=1000
        OsHooks: OsErrorHook=false, OsPostTaskHook=false, OsPreTaskHook=false, OsProtectionHook=false, OsShutdownHook=false, OsStartupHook=false
      OsTick (OsCounter): OsCounterMaxAllowedValue=65535, OsCounterMinCycle=1, OsCounterTicksPerBase=1, OsCounterType=OS-TICK
      3 x OsTask, all with OsTaskProcessType=BASIC:
        ComTask: OsTaskPriority=1
        ReadSwitches: OsTaskPriority=2
        StartupTask: OsTaskPriority=3
          OsTaskAutostart
      ComAlarm (OsAlarm): OsAlarmCounterRef=/switch_node_mpc551x/Os/OsTick
        OsAlarmAutostart: OsAlarmAlarmTime=5, OsAlarmAutostartType=ABSOLUTE, OsAlarmCycleTime=20
        ActivateTask (OsAlarmActivateTask): OsAlarmActivateTaskRef=/switch_node_mpc551x/Os/ComTask
      ReadSwAlarm (OsAlarm): OsAlarmCounterRef=/switch_node_mpc551x/Os/OsTick
        OsAlarmAutostart: OsAlarmAlarmTime=10, OsAlarmAutostartType=ABSOLUTE, OsAlarmCycleTime=30
        ActivateTask (OsAlarmActivateTask): OsAlarmActivateTaskRef=/switch_node_mpc551x/Os/ReadSwitches
    module config EcuC: module-description=/ArcCore/EcuC
      PduCollection
        LedCommandTx (Pdu): PduLength=64
    module config CanIf: module-description=/ArcCore/CanIf
      CanIfDispatchConfig: CanIfBusOffNotification=(unset), CanIfErrorNotificaton=(unset), CanIfWakeupNotification=(unset), CanIfWakeupValidNotification=(unset)
      CanIfDriverConfig: CanIfBusoffNotification=true, CanIfReceiveIndication=false, CanIfTransmitCancellation=false, CanIfTxConfirmation=false, CanIfWakeupNotification=true
      CanIfInitConfiguration: CanIfConfigSet=(unset), CanIfNumberOfCanRxPduIds=(unset), CanIfNumberOfCanTXPduIds=(unset), CanIfNumberOfDynamicCanTXPduIds=(unset)
        Hoh_1 (CanIfInitHohConfig)
          Hth_1 (CanIfHthConfig): CanIfHthType=BASIC_CAN, CanIfCanControllerIdRef=/switch_node_mpc551x/CanIf/CHANNEL_0, CanIfHthIdSymRef=/switch_node_mpc551x/Can/CanConfigSet/Tx1
        Tx_PDU_1 (CanIfTxPduConfig):
          CanIfCanTxPduId = (unset)
          CanIfCanTxPduIdCanId = 291
          CanIfCanTxPduIdDlc = 8
          CanIfCanTxPduType = STATIC
          CanIfReadTxPduNotifyStatus = false
          CanIfTxPduIdCanIdType = EXTENDED_CAN
          CanIfTxUserType = PDUR
          CanIfUserTxConfirmation = (unset)
          CanIfCanTxPduHthRef = /switch_node_mpc551x/CanIf/CanIfInitConfiguration/Hoh_1/Hth_1
          PduIdRef = /switch_node_mpc551x/EcuC/PduCollection/LedCommandTx
      CanIfPrivateConfiguration: CanIfDlcCheck=true, CanIfNumberOfTxBuffers=(unset), CanIfSoftwareFilterType=
      CanIfPublicConfiguration:
        CanIfDevErrorDetect = true
        CanIfMultipleDriverSupport = true
        CanIfNumberOfCanHwUnits = 1
        CanIfReadRxPduDataApi = false
        CanIfReadRxPduNotifyStatusApi = false
        CanIfReadTxPduNotifyStatusApi = false
        CanIfSetDynamicTxIdApi = false
        CanIfVersionInfoApi = true
        CanIfWakeupEventApi = false
      CanIfTransceiverDrvConfig: CanIfTrcvWakeupNotification=false
      CHANNEL_0 (CanIfControllerConfig): CanIfWakeupSupport=NO_WAKEUP, CanIfControllerIdRef=/switch_node_mpc551x/Can/CanConfigSet/Can_A
    module config Can: module-description=/ArcCore/Can
      CanConfigSet
        Can_A (CanController):
          CanControllerActivation = true
          CanControllerLoopback = false
          CanControllerBaudRate = 125
          CanHWControllerId = FLEXCAN_A
          CanControllerPropSeg = 4
          CanControllerSeg1 = 4
          CanControllerSeg2 = 4
          Mask_1 (CanFilterMask): CanFilterMaskValue=0
        Tx1 (CanHardwareObject):
          CanIdType = EXTENDED
          CanObjectType = TRANSMIT
          CanMBMask = 4278190080
          CanControllerRef = /switch_node_mpc551x/Can/CanConfigSet/Can_A
          CanFilterMaskRef = /switch_node_mpc551x/Can/CanConfigSet/Can_A/Mask_1
      CanGeneral: CanDevErrorDetection=false, CanMultiplexedTransmission=false, CanVersionInfoApi=false
    module config Com: module-description=/ArcCore/Com
      ComConfig: ComConfigurationId=(unset)
        TxGroup (ComIPduGroup): ComIPduGroupHandleId=(unset)
        LedCommandTx (ComIPdu):
          ComIPduCallout = (unset)
          ComIPduRxHandleId = (unset)
          ComIPduSignalProcessing = DEFERRED
          ComIPduDirection = SEND
          ComIPduGroupRef = /switch_node_mpc551x/Com/ComConfig/TxGroup
          PduIdRef = /switch_node_mpc551x/EcuC/PduCollection/LedCommandTx
          ComIPduSignalRef = /switch_node_mpc551x/Com/ComConfig/SetLedLevelTx
          ComTxIPdu: ComTxIPduMinimumDelayTimeFactor=0, ComTxIPduUnusedAreasDefault=0
            ComTxModeTrue
              ComTxMode: ComTxModeMode=DIRECT, ComTxModeNumberOfRepetitions=0, ComTxModeRepetitionPeriodFactor=0, ComTxModeTimeOffsetFactor=0, ComTxModeTimePeriodFactor=0
        SetLedLevelTx (ComSignal):
          ComBitPosition = 0
          ComBitSize = 16
          ComFirstTimeoutFactor = 0
          ComHandleId = (unset)
          ComNotification = (unset)
          ComSignalEndianess = BIG_ENDIAN
          ComSignalInitValue = 0
          ComSignalLength = (unset)
          ComSignalType = UINT16
          ComTimeoutFactor = 0
          ComTimeoutNotification = (unset)
          ComTransferProperty = TRIGGERED
      ComGeneral: ComConfigurationTimeBase=(unset), ComConfigurationUseDet=false
    module config Port: module-description=/ArcCore/Port
      PortConfigSet
        Adc (PortContainer)
          5 x PortPin, all with PortPinPullMode=PULL_NONE, PortPinDirection=PORT_PIN_IN, PortPinDirectionChangeable=false, PortPinHysteresisEnabled=false, PortPinOpenDrainEnabled=false, PortPinSlewRate=SLEW_RATE_MIN, PortPinLevelValue=PORT_PIN_LEVEL_LOW, PortPinMode=PORT_PIN_MODE_ADC:
            AN[8]/ANW: PortPinId=8
            AN[9]/ANX: PortPinId=9
            AN[10]/ANY: PortPinId=10
            AN[11]/ANZ: PortPinId=11
            AN[12]: PortPinId=12
        Can (PortContainer)
          CNTX_A (PortPin):
            PortPinPullMode = PULL_NONE
            PortPinDirection = PORT_PIN_OUT
            PortPinDirectionChangeable = false
            PortPinHysteresisEnabled = false
            PortPinOpenDrainEnabled = false
            PortPinId = 48
            PortPinSlewRate = SLEW_RATE_MIN
            PortPinLevelValue = PORT_PIN_LEVEL_LOW
            PortPinMode = PORT_PIN_MODE_CAN
          CNRX_A (PortPin):
            PortPinPullMode = PULL_NONE
            PortPinDirection = PORT_PIN_IN
            PortPinDirectionChangeable = false
            PortPinHysteresisEnabled = false
            PortPinOpenDrainEnabled = false
            PortPinId = 49
            PortPinSlewRate = SLEW_RATE_MIN
            PortPinLevelValue = PORT_PIN_LEVEL_LOW
            PortPinMode = PORT_PIN_MODE_CAN
      PortGeneral: PortDevErrorDetect=true, PortSetPinDirectionApi=true, PortSetPinModeApi=false, PortVersionInfoApi=true
