AUTOSAR XML (schema 3.1.0)
package /Simple
  elements ecu-configuration=module=Os:
    module config Os: module-description=/ArcCore/Os
      OsCounter: OsCounterMaxAllowedValue=65535, OsCounterMinCycle=1, OsCounterTicksPerBase=1, OsCounterType=OS-TICK
      OsOS: OsTickFrequency=1000
        OsHooks: OsErrorHook=false, OsPostTaskHook=false, OsPreTaskHook=false, OsProtectionHook=false, OsShutdownHook=false, OsStartupHook=false
      3 x OsTask:
        etask_1: OsTaskPriority=1, OsTaskProcessType=EXTENDED
          OsTaskAutostart
        etask_2: OsTaskPriority=2, OsTaskProcessType=EXTENDED
          OsTaskAutostart
        btask_3: OsTaskPriority=3, OsTaskProcessType=BASIC
      Alarm_1 (OsAlarm): OsAlarmCounterRef=/Simple/Os/OsCounter
        OsAlarmAutostart: OsAlarmAlarmTime=100, OsAlarmAutostartType=RELATIVE, OsAlarmCycleTime=10
        SetEvent (OsAlarmSetEvent): OsAlarmSetEventRef=/Simple/Os/Event_2, OsAlarmSetEventTaskRef=/Simple/Os/etask_1
      3 x OsEvent:
        Event_0
        Event_2: OsEventMask=2
        Event_1: OsEventMask=1
