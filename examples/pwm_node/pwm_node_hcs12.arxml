AUTOSAR XML (schema 3.1.4)
package /pwm_node_hcs12
  ecu configuration pwm_node_hcs12: ecu-sw-composition=SwComposition_pwm_node_hcs12, module=[Port, Pwm, Os]
  ecu sw composition SwComposition_pwm_node_hcs12
  module config Port
    PortConfigSet
      8 x PortContainer:
        II2C
          SDA (PortPin):
            PortPinPullMode = PULL_NONE
            PortPinDirection = PORT_PIN_IN
            PortPinDirectionChangeable = true
            PortPinHysteresisEnabled = false
            PortPinOpenDrainEnabled = false
            ArcReducedDrive = false
            ArcPortPinName = PJ6
            PortPinId = 38
            PortPinLevelValue = PORT_PIN_LEVEL_HIGH
            PortPinMode = 
          SCL (PortPin):
            PortPinPullMode = PULL_NONE
            PortPinDirection = PORT_PIN_OUT
            PortPinDirectionChangeable = false
            PortPinHysteresisEnabled = false
            PortPinOpenDrainEnabled = false
            ArcReducedDrive = false
            ArcPortPinName = PJ7
            PortPinId = 39
            PortPinLevelValue = PORT_PIN_LEVEL_HIGH
            PortPinMode = 
        CAN0
          TXD (PortPin):
            PortPinPullMode = 
            PortPinDirection = PORT_PIN_IN
            PortPinDirectionChangeable = false
            PortPinHysteresisEnabled = false
            PortPinOpenDrainEnabled = false
            ArcReducedDrive = false
            ArcPortPinName = PM1
            PortPinId = 49
            PortPinLevelValue = PORT_PIN_LEVEL_HIGH
            PortPinMode = 
          RXD (PortPin):
            PortPinPullMode = 
            PortPinDirection = PORT_PIN_IN
            PortPinDirectionChangeable = false
            PortPinHysteresisEnabled = false
            PortPinOpenDrainEnabled = false
            ArcReducedDrive = false
            ArcPortPinName = PM0
            PortPinId = 48
            PortPinLevelValue = PORT_PIN_LEVEL_HIGH
            PortPinMode = 
        LEDBAR
          8 x PortPin, all with PortPinPullMode=, PortPinDirection=PORT_PIN_OUT, PortPinDirectionChangeable=false, PortPinHysteresisEnabled=false, PortPinOpenDrainEnabled=false, ArcReducedDrive=false, PortPinLevelValue=PORT_PIN_LEVEL_HIGH, PortPinMode=:
            PB0: ArcPortPinName=PB0, PortPinId=16
            PB1: ArcPortPinName=PB1, PortPinId=17
            PB2: ArcPortPinName=PB2, PortPinId=18
            PB3: ArcPortPinName=PB3, PortPinId=19
            PB4: ArcPortPinName=PB4, PortPinId=20
            PB5: ArcPortPinName=PB5, PortPinId=21
            PB6: ArcPortPinName=PB6, PortPinId=22
            PB7: ArcPortPinName=PB7, PortPinId=23
        DIPSW
          8 x PortPin, all with PortPinPullMode=PULL_UP, PortPinDirection=PORT_PIN_IN, PortPinDirectionChangeable=false, PortPinHysteresisEnabled=false, PortPinOpenDrainEnabled=false, ArcReducedDrive=false, PortPinLevelValue=PORT_PIN_LEVEL_LOW, PortPinMode=:
            PH0: ArcPortPinName=PH0, PortPinId=24
            PH1: ArcPortPinName=PH1, PortPinId=25
            PH2: ArcPortPinName=PH2, PortPinId=26
            PH3: ArcPortPinName=PH3, PortPinId=27
            PH4: ArcPortPinName=PH4, PortPinId=28
            PH5: ArcPortPinName=PH5, PortPinId=29
            PH6: ArcPortPinName=PH6, PortPinId=30
            PH7: ArcPortPinName=PH7, PortPinId=31
        TIMER
          3 x PortPin, all with PortPinPullMode=PULL_NONE, PortPinDirectionChangeable=false, PortPinHysteresisEnabled=false, PortPinOpenDrainEnabled=false, ArcReducedDrive=false, PortPinMode=:
            PT0: PortPinDirection=PORT_PIN_IN, ArcPortPinName=PT0, PortPinId=72, PortPinLevelValue=PORT_PIN_LEVEL_HIGH
            PT1: PortPinDirection=PORT_PIN_IN, ArcPortPinName=PT1, PortPinId=73, PortPinLevelValue=PORT_PIN_LEVEL_HIGH
            BEEPER: PortPinDirection=PORT_PIN_OUT, ArcPortPinName=PT2, PortPinId=74, PortPinLevelValue=PORT_PIN_LEVEL_LOW
        PWM
          PP0 (PortPin):
            PortPinPullMode = PULL_NONE
            PortPinDirection = PORT_PIN_OUT
            PortPinDirectionChangeable = false
            PortPinHysteresisEnabled = false
            PortPinOpenDrainEnabled = false
            ArcReducedDrive = false
            ArcPortPinName = PP0
            PortPinId = 56
            PortPinLevelValue = PORT_PIN_LEVEL_LOW
            PortPinMode = 
          PP1 (PortPin):
            PortPinPullMode = PULL_NONE
            PortPinDirection = PORT_PIN_OUT
            PortPinDirectionChangeable = false
            PortPinHysteresisEnabled = false
            PortPinOpenDrainEnabled = false
            ArcReducedDrive = false
            ArcPortPinName = PP1
            PortPinId = 57
            PortPinLevelValue = PORT_PIN_LEVEL_LOW
            PortPinMode = 
        SCI0
          RXD0 (PortPin):
            PortPinPullMode = PULL_UP
            PortPinDirection = PORT_PIN_IN
            PortPinDirectionChangeable = false
            PortPinHysteresisEnabled = false
            PortPinOpenDrainEnabled = false
            ArcReducedDrive = false
            ArcPortPinName = PS0
            PortPinId = 56
            PortPinLevelValue = PORT_PIN_LEVEL_HIGH
            PortPinMode = 
          TXD0 (PortPin):
            PortPinPullMode = PULL_NONE
            PortPinDirection = PORT_PIN_IN
            PortPinDirectionChangeable = false
            PortPinHysteresisEnabled = false
            PortPinOpenDrainEnabled = false
            ArcReducedDrive = false
            ArcPortPinName = PS1
            PortPinId = 57
            PortPinLevelValue = PORT_PIN_LEVEL_HIGH
            PortPinMode = 
        SCI1
          4 x PortPin, all with PortPinDirection=PORT_PIN_IN, PortPinDirectionChangeable=false, PortPinHysteresisEnabled=false, PortPinOpenDrainEnabled=false, ArcReducedDrive=false, PortPinLevelValue=PORT_PIN_LEVEL_HIGH, PortPinMode=:
            RXD1: PortPinPullMode=PULL_UP, ArcPortPinName=PS2, PortPinId=58
            TXD1: PortPinPullMode=PULL_NONE, ArcPortPinName=PS3, PortPinId=59
            PM6: PortPinPullMode=PULL_NONE, ArcPortPinName=PM6, PortPinId=54
            PM7: PortPinPullMode=PULL_NONE, ArcPortPinName=PM7, PortPinId=55
    PortGeneral: PortDevErrorDetect=true, PortSetPinDirectionApi=false, PortSetPinModeApi=false, PortVersionInfoApi=true
  module config Pwm
    PwmChannelConfigSet
      PWM_CHANNEL_1 (PwmChannel):
        ArcPwmCenterAlign = false
        ArcPwmScaledClockEnable = true
        PwmChannelClass = PWM_VARIABLE_PERIOD
        PwmChannelId = 1
        PwmDutycycleDefault = 24576
        PwmIdleState = PWM_LOW
        PwmNotification = 
        PwmPeriodDefault = 188.0
        PwmPolarity = POLARITY_NORMAL
      PWM_CHANNEL_2 (PwmChannel):
        ArcPwmCenterAlign = false
        ArcPwmScaledClockEnable = true
        PwmChannelClass = PWM_VARIABLE_PERIOD
        PwmChannelId = 0
        PwmDutycycleDefault = 0
        PwmIdleState = PWM_LOW
        PwmNotification = 
        PwmPeriodDefault = 188.0
        PwmPolarity = POLARITY_NORMAL
    PwmConfigurationOfOptApiServices: PwmDeInitApi=false, PwmGetOutputState=true, PwmSetDutyCycle=true, PwmSetOutputToIdle=false, PwmSetPeriodAndDuty=true, PwmVersionInfoApi=false
    PwmGeneral:
      ArcPwmFreezeEnable = false
      PwmDevErorDetect = true
      PwmDutycycleUpdatedEndperiod = true
      PwmIndex = 1
      PwmNotificationSupported = false
      PwmPeriodUpdatedEndperiod = true
      ArcPwmChannelBusPrescalerA = PRESCALER_128
      ArcPwmChannelBusPrescalerB = PRESCALER_2
      ArcPwmChannelPrescalerA = 1
      ArcPwmChannelPrescalerB = 1
  module config Os
    OsOS:
      OsStackMonitoring = true
      OsStatus = EXTENDED
      OsUseGetServiceId = true
      OsUseParameterAccess = true
      OsUseResScheduler = true
      OsTickFrequency = 1000
      OsInterruptStackSize = 512
      OsIdleStackSize = 512
      ArcCoreOsUseDebug = false
      ArcCoreOsDebugTask = true
      ArcCoreOsDebugAlarm = true
      ArcCoreOsDebugResource = true
      ArcCoreOsDebugScheduleTable = true
      ArcCoreOsDebugEvent = true
      OsHooks: OsErrorHook=true, OsPostTaskHook=true, OsPreTaskHook=true, OsProtectionHook=false, OsShutdownHook=true, OsStartupHook=true
    3 x OsTask, all with OsTaskActivation=1, OsTaskProcessType=BASIC, ArcCoreOsTaskStackSize=512, OsTaskSchedule=FULL:
      bTask25: OsTaskPriority=1
      bTask100: OsTaskPriority=2
      Startup: OsTaskPriority=3
        OsTaskAutostart
    OsTick (OsCounter): OsCounterMaxAllowedValue=65535, OsCounterMinCycle=0, OsCounterTicksPerBase=0, OsCounterType=OS_TICK
    Alarm25 (OsAlarm): OsAlarmCounterRef=OsTick
      OsAlarmActivateTask: OsAlarmActivateTaskRef=bTask25
    Alarm100 (OsAlarm): OsAlarmCounterRef=OsTick
      OsAlarmActivateTask: OsAlarmActivateTaskRef=bTask100
