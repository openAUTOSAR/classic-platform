AUTOSAR XML (schema 3.1.0)
package /pwm_node_mpc551x
  elements ecu-configuration=module=[Os, Pwm, Port]:
    module config Os: module-description=/ArcCore/Os
      OsOS: OsTickFrequency=1000
        OsHooks: OsErrorHook=true, OsPostTaskHook=true, OsPreTaskHook=true, OsProtectionHook=true, OsShutdownHook=true, OsStartupHook=true
      3 x OsTask, all with OsTaskProcessType=BASIC:
        bTask25: OsTaskPriority=1
        bTask100: OsTaskPriority=2
        Startup: OsTaskPriority=3
          OsTaskAutostart
      OsTick (OsCounter): OsCounterMaxAllowedValue=65535, OsCounterMinCycle=1, OsCounterTicksPerBase=1, OsCounterType=OS-TICK
      bTask25 (OsAlarm): OsAlarmCounterRef=/pwm_node_mpc551x/Os/OsTick
        ActivateTask (OsAlarmActivateTask): OsAlarmActivateTaskRef=/pwm_node_mpc551x/Os/bTask25
      bTask100 (OsAlarm): OsAlarmCounterRef=/pwm_node_mpc551x/Os/OsTick
        ActivateTask (OsAlarmActivateTask): OsAlarmActivateTaskRef=/pwm_node_mpc551x/Os/bTask100
    module config Pwm: module-description=/ArcCore/Pwm
      PwmChannelConfigSet
        PWM_CHANNEL_1 (PwmChannel):
          PwmChannelClass = PWM_VARIABLE_PERIOD
          PwmChannelId = 13
          PwmDutycycleDefault = 0
          PwmIdleState = PWM_LOW
          PwmArcticCoreChannelPrescaler = PWM_CHANNEL_PRESCALER_1
          PwmNotification = 
          PwmPeriodDefault = 0.0096
          PwmPolarity = PWM_HIGH
        PWM_CHANNEL_2 (PwmChannel):
          PwmChannelClass = PWM_VARIABLE_PERIOD
          PwmChannelId = 12
          PwmDutycycleDefault = 0
          PwmIdleState = PWM_LOW
          PwmArcticCoreChannelPrescaler = PWM_CHANNEL_PRESCALER_1
          PwmNotification = 
          PwmPeriodDefault = 0.0032
          PwmPolarity = PWM_LOW
      PwmConfigurationOfOptApiServices: PwmDeInitApi=false, PwmGetOutputState=true, PwmSetDutyCycle=true, PwmSetOutputToIdle=false, PwmSetPeriodAndDuty=true, PwmVersionInfoApi=false
      PwmGeneral: PwmDevErorDetect=true, PwmDutycycleUpdatedEndperiod=true, PwmIndex=1, PwmNotificationSupported=true, PwmPeriodUpdatedEndperiod=true
    module config Port: module-description=/ArcCore/Port
      PortConfigSet
        PWM (PortContainer)
          eMIOS[12] (PortPin):
            PortPinPullMode = PULL_NONE
            PortPinDirection = PORT_PIN_OUT
            PortPinDirectionChangeable = false
            PortPinHysteresisEnabled = false
            PortPinOpenDrainEnabled = false
            PortPinId = 52
            PortPinSlewRate = SLEW_RATE_MIN
            PortPinLevelValue = PORT_PIN_LEVEL_LOW
            PortPinMode = PORT_PIN_MODE_PWM
          eMIOS[13] (PortPin):
            PortPinPullMode = PULL_NONE
            PortPinDirection = PORT_PIN_OUT
            PortPinDirectionChangeable = false
            PortPinHysteresisEnabled = false
            PortPinOpenDrainEnabled = false
            PortPinId = 53
            PortPinSlewRate = SLEW_RATE_MIN
            PortPinLevelValue = PORT_PIN_LEVEL_LOW
            PortPinMode = PORT_PIN_MODE_PWM
      PortGeneral: PortDevErrorDetect=true, PortSetPinDirectionApi=false, PortSetPinModeApi=false, PortVersionInfoApi=true
