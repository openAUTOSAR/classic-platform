AUTOSAR XML (schema 3.1.2)
# Copyright ArcCore AB 2010
package /pwm_node_mpc5567
  ecu configuration pwm_node_mpc5567: ecu-sw-composition=SwComposition_pwm_node_mpc5567, module=[Port, Pwm, Os]
  module config Port
    PortConfigSet
      PWM (PortContainer)
        EMIOS[10] (PortPin):
          PortPinPullMode = PULL_NONE
          PortPinDirection = PORT_PIN_OUT
          PortPinDirectionChangeable = false
          PortPinHysteresisEnabled = false
          PortPinOpenDrainEnabled = false
          PortPinId = 189
          PortPinSlewRate = SLEW_RATE_MIN
          PortPinLevelValue = PORT_PIN_LEVEL_LOW
          PortPinMode = PORT_PIN_MODE_PWM
        EMIOS[12] (PortPin):
          PortPinPullMode = PULL_NONE
          PortPinDirection = PORT_PIN_OUT
          PortPinDirectionChangeable = false
          PortPinHysteresisEnabled = false
          PortPinOpenDrainEnabled = false
          PortPinId = 191
          PortPinSlewRate = SLEW_RATE_MIN
          PortPinLevelValue = PORT_PIN_LEVEL_LOW
          PortPinMode = PORT_PIN_MODE_PWM
    PortGeneral: PortDevErrorDetect=true, PortSetPinDirectionApi=false, PortSetPinModeApi=false, PortVersionInfoApi=false
  module config Pwm
    PwmChannelConfigSet
      PWM_CHANNEL_1 (PwmChannel):
        PwmChannelClass = PWM_VARIABLE_PERIOD
        PwmChannelId = 10
        PwmDutycycleDefault = 24576
        PwmIdleState = PWM_LOW
        PwmArcticCoreChannelPrescaler = PWM_CHANNEL_PRESCALER_1
        PwmNotification = MyPwmNotificationRoutine
        PwmPeriodDefault = 5.0E-5
        PwmPolarity = PWM_HIGH
      PWM_CHANNEL_2 (PwmChannel):
        PwmChannelClass = PWM_VARIABLE_PERIOD
        PwmChannelId = 12
        PwmDutycycleDefault = 0
        PwmIdleState = PWM_LOW
        PwmArcticCoreChannelPrescaler = PWM_CHANNEL_PRESCALER_1
        PwmNotification = 
        PwmPeriodDefault = 1.5E-4
        PwmPolarity = PWM_LOW
    PwmConfigurationOfOptApiServices: PwmDeInitApi=false, PwmGetOutputState=true, PwmSetDutyCycle=true, PwmSetOutputToIdle=false, PwmSetPeriodAndDuty=true, PwmVersionInfoApi=false
    PwmGeneral: PwmDevErorDetect=true, PwmDutycycleUpdatedEndperiod=true, PwmIndex=1, PwmNotificationSupported=true, PwmPeriodUpdatedEndperiod=true
  module config Os
    OsOS:
      OsStackMonitoring = true
      OsStatus = EXTENDED
      OsUseGetServiceId = true
      OsUseParameterAccess = true
      OsUseResScheduler = true
      OsTickFrequency = 1000
      OsInterruptStackSize = 2048
      OsIdleStackSize = 512
      ArcCoreOsUseDebug = false
      ArcCoreOsDebugTask = true
      ArcCoreOsDebugAlarm = true
      ArcCoreOsDebugResource = true
      ArcCoreOsDebugScheduleTable = true
      ArcCoreOsDebugEvent = true
      OsHooks: OsErrorHook=true, OsPostTaskHook=true, OsPreTaskHook=true, OsProtectionHook=false, OsShutdownHook=true, OsStartupHook=true
    3 x OsTask, all with OsTaskActivation=1, OsTaskProcessType=BASIC, ArcCoreOsTaskStackSize=2048, OsTaskSchedule=FULL:
      bTask25: OsTaskPriority=1
      bTask100: OsTaskPriority=2
      Startup: OsTaskPriority=3
        OsTaskAutostart
    OsTick (OsCounter): OsCounterMaxAllowedValue=65535, OsCounterMinCycle=0, OsCounterTicksPerBase=0, OsCounterType=OS_TICK
    Alarm25 (OsAlarm): OsAlarmCounterRef=OsTick
      OsAlarmActivateTask: OsAlarmActivateTaskRef=bTask25
    Alarm100 (OsAlarm): OsAlarmCounterRef=OsTick
      OsAlarmActivateTask: OsAlarmActivateTaskRef=bTask100
  ecu sw composition SwComposition_pwm_node_mpc5567
