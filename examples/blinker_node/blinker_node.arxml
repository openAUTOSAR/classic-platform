AUTOSAR XML (schema 3.1.0)
package /blinker_node
  elements ecu-configuration=module=Os:
    module config Os: module-description=/ArcCore/Os
      OsTick (OsCounter): OsCounterMaxAllowedValue=65535, OsCounterMinCycle=1, OsCounterTicksPerBase=1, OsCounterType=OS-TICK
      OsOS: OsTickFrequency=1000
        OsHooks: OsErrorHook=true, OsPostTaskHook=true, OsPreTaskHook=true, OsProtectionHook=true, OsShutdownHook=true, OsStartupHook=true
      4 x OsTask, all with OsTaskProcessType=BASIC:
        bTask25: OsTaskPriority=1
        bTask100: OsTaskPriority=2
        bTask10: OsTaskPriority=3
        Startup: OsTaskPriority=4
          OsTaskAutostart
      3 x OsAlarm, all with OsAlarmCounterRef=/blinker_node/Os/OsTick:
        bTask10
          ActivateTask (OsAlarmActivateTask): OsAlarmActivateTaskRef=/blinker_node/Os/bTask10
        bTask25
          ActivateTask (OsAlarmActivateTask): OsAlarmActivateTaskRef=/blinker_node/Os/bTask25
        bTask100
          ActivateTask (OsAlarmActivateTask): OsAlarmActivateTaskRef=/blinker_node/Os/bTask100
