AUTOSAR XML (schema 3.1.4)
package /blinker_node_arm_cm3
  ecu configuration blinker_node_arm_cm3_107: ecu-sw-composition=SwComposition_blinker_node_arm_cm3, module=[Os, Dio, Port, Det, Mcu, EcuM]
  ecu sw composition SwComposition_blinker_node_arm_cm3
  module config Os
    OsOS:
      OsStackMonitoring = true
      OsStatus = EXTENDED
      OsUseGetServiceId = true
      OsUseParameterAccess = true
      OsUseResScheduler = true
      OsTickFrequency = 1000
      OsInterruptStackSize = 2048
      OsIdleStackSize = 512
      ArcCoreOsUseDebug = true
      ArcCoreOsDebugTask = true
      ArcCoreOsDebugAlarm = true
      ArcCoreOsDebugResource = true
      ArcCoreOsDebugScheduleTable = true
      ArcCoreOsDebugEvent = true
      OsHooks: OsErrorHook=true, OsPostTaskHook=true, OsPreTaskHook=true, OsProtectionHook=false, OsShutdownHook=true, OsStartupHook=true
    alarm25 (OsAlarm): OsAlarmCounterRef=OsTick
      OsAlarmActivateTask: OsAlarmActivateTaskRef=bTask25
    OsTick (OsCounter): OsCounterMaxAllowedValue=65535, OsCounterMinCycle=0, OsCounterTicksPerBase=0, OsCounterType=OS_TICK
    4 x OsTask, all with OsTaskActivation=1, OsTaskProcessType=BASIC, ArcCoreOsTaskStackSize=2048, OsTaskSchedule=FULL:
      bTask25: OsTaskPriority=1
      bTask100: OsTaskPriority=1
      bTask10: OsTaskPriority=1
      Startup: OsTaskPriority=2
        OsTaskAutostart
    alarm10 (OsAlarm): OsAlarmCounterRef=OsTick
      OsAlarmActivateTask: OsAlarmActivateTaskRef=bTask10
    alarm100 (OsAlarm): OsAlarmCounterRef=OsTick
      OsAlarmActivateTask: OsAlarmActivateTaskRef=bTask100
  module config Dio
    DioGeneral: DioDevErrorDetect=true, DioVersionInfoApi=true
    LED_PORT (DioPort): DioPortId=0, ArcCoreDioPhysicalPort=D
      4 x DioChannel:
        LED_CHANNEL1: DioChannelId=55
        LED_CHANNEL2: DioChannelId=61
        LED_CHANNEL3: DioChannelId=51
        LED_CHANNEL4: DioChannelId=52
  module config Port
    PortConfigSet
      PortContainer_1 (PortContainer)
        4 x PortPin, all with PortPinPullMode=, PortPinDirection=OUTPUT_10MHz_MODE, PortPinDirectionChangeable=false, PortPinHysteresisEnabled=false, PortPinOpenDrainEnabled=false, ArcReducedDrive=false, ArcPortPinName=, PortPinLevelValue=OUTPUT_HIGH, PortPinMode=OUTPUT_PUSHPULL_CNF:
          D3_LED3: PortPinId=51
          D4_LED4: PortPinId=52
          D7_LED1: PortPinId=55
          D13_LED2: PortPinId=61
    PortGeneral: ArcGpioRemap=, PortDevErrorDetect=true, PortSetPinDirectionApi=true, PortSetPinModeApi=false, PortVersionInfoApi=true
  module config Det
    DetGeneral: DetEnableCallbacks=false, DetUseRamlog=true, DetWrapRamlog=true, DetUseStdErr=false, DetDeInitAPI=false, DetNumberOfCallbacks=5, DetRamlogSize=16
  module config Mcu
    McuGeneralConfiguration: McuDevErrorDetect=true, McuPerformResetApi=true, McuVersionInfoApi=true
    McuModuleConfiguration: McuClockSrcFailureNotification=DISABLED, McuNumberOfMcuModes=0, McuRamSectors=1, McuResetSetting=0
      McuClockSettingConfig:
        ArcAHBClocksEnable = DMA1
        ArcAHBClocksEnable = ETH_MAC
        ArcAHBClocksEnable = ETH_MAC_Tx
        ArcAHBClocksEnable = ETH_MAC_Rx
        ArcAPB1ClocksEnable = TIM2
        ArcAPB1ClocksEnable = CAN1
        ArcAPB2ClocksEnable = ADC1
        ArcAPB2ClocksEnable = GPIOA
        ArcAPB2ClocksEnable = GPIOB
        ArcAPB2ClocksEnable = GPIOC
        ArcAPB2ClocksEnable = GPIOD
        ArcAPB2ClocksEnable = GPIOE
        ArcAPB2ClocksEnable = AFIO
        McuDefaultClockReference = EXT_REF_25MHZ
        EXT_REF_25MHZ (McuClockReferencePoint): McuClockReferencePointFrequency=2.5E7, McuClockReferencePointPllEprediv=9, McuClockReferencePointPllEmfd=8, McuClockReferencePointPllErfd=0
      McuModeSettingConf: McuMode=0
  module config EcuM
    EcuMGeneral: EcuMDevErrorDetect=false, EcuMIncludeNvramMgr=false, EcuMVersionInfoApi=true, EcuMMainFunctionPeriod=0.2
    EcuMConfiguration: EcuMNvramReadallTimeout=10.0, EcuMRunMinimumDuration=10.0, EcuMNvramWriteallTimeout=10.0
