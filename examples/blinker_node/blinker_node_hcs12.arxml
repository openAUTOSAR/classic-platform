AUTOSAR XML (schema 3.1.2)
# Copyright ArcCore AB 2010
package /blinker_node_hcs12
  ecu configuration blinker_node_hcs12: module=Os
  module config Os
    OsOS:
      OsStackMonitoring = true
      OsStatus = EXTENDED
      OsUseGetServiceId = true
      OsUseParameterAccess = true
      OsUseResScheduler = true
      OsTickFrequency = 1000
      OsInterruptStackSize = 512
      OsIdleStackSize = 512
      ArcCoreOsUseDebug = false
      ArcCoreOsDebugTask = true
      ArcCoreOsDebugAlarm = true
      ArcCoreOsDebugResource = true
      ArcCoreOsDebugScheduleTable = true
      ArcCoreOsDebugEvent = true
      OsHooks: OsErrorHook=true, OsPostTaskHook=true, OsPreTaskHook=true, OsProtectionHook=false, OsShutdownHook=true, OsStartupHook=true
    alarm25 (OsAlarm): OsAlarmCounterRef=OsTick
      OsAlarmActivateTask: OsAlarmActivateTaskRef=bTask25
    OsTick (OsCounter): OsCounterMaxAllowedValue=65535, OsCounterMinCycle=0, OsCounterTicksPerBase=0, OsCounterType=OS_TICK
    4 x OsTask, all with OsTaskActivation=1, OsTaskProcessType=BASIC, OsTaskSchedule=FULL:
      bTask25: OsTaskPriority=1, ArcCoreOsTaskStackSize=512
      bTask100: OsTaskPriority=1, ArcCoreOsTaskStackSize=512
      bTask10: OsTaskPriority=1, ArcCoreOsTaskStackSize=512
      Startup: OsTaskPriority=2, ArcCoreOsTaskStackSize=256
        OsTaskAutostart
    alarm10 (OsAlarm): OsAlarmCounterRef=OsTick
      OsAlarmActivateTask: OsAlarmActivateTaskRef=bTask10
    alarm100 (OsAlarm): OsAlarmCounterRef=OsTick
      OsAlarmActivateTask: OsAlarmActivateTaskRef=bTask100
