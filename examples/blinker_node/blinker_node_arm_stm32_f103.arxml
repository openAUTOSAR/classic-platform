AUTOSAR XML (schema 3.1.4)
package /blinker_node_arm_stm32_f103
  ecu configuration blinker_node_arm_stm32_f103: ecu-sw-composition=SwComposition_blinker_node_arm_stm32_f103, module=[Os, Mcu, Det, EcuM, Port, Dio]
  ecu sw composition SwComposition_blinker_node_arm_stm32_f103
  module config Os
    OsOS:
      OsStackMonitoring = true
      OsStatus = EXTENDED
      OsUseGetServiceId = true
      OsUseParameterAccess = true
      OsUseResScheduler = true
      OsTickFrequency = 1000
      OsInterruptStackSize = 2048
      OsIdleStackSize = 512
      ArcCoreOsUseDebug = false
      ArcCoreOsDebugTask = false
      ArcCoreOsDebugAlarm = false
      ArcCoreOsDebugResource = false
      ArcCoreOsDebugScheduleTable = false
      ArcCoreOsDebugEvent = false
      OsHooks: OsErrorHook=true, OsPostTaskHook=true, OsPreTaskHook=true, OsProtectionHook=false, OsShutdownHook=true, OsStartupHook=true
    3 x OsAlarm, all with OsAlarmCounterRef=OsTick:
      alarm25
        OsAlarmActivateTask: OsAlarmActivateTaskRef=bTask25
      alarm10
        OsAlarmActivateTask: OsAlarmActivateTaskRef=bTask10
      alarm100
        OsAlarmActivateTask: OsAlarmActivateTaskRef=bTask100
    4 x OsTask, all with OsTaskActivation=1, OsTaskProcessType=BASIC, ArcCoreOsTaskStackSize=2048, OsTaskSchedule=FULL:
      bTask25: OsTaskPriority=1
      bTask100: OsTaskPriority=1
      bTask10: OsTaskPriority=1
      Startup: OsTaskPriority=2
        OsTaskAutostart
    OsTick (OsCounter): OsCounterMaxAllowedValue=65535, OsCounterMinCycle=0, OsCounterTicksPerBase=0, OsCounterType=OS_TICK
  module config Mcu
    McuGeneralConfiguration: McuDevErrorDetect=true, McuPerformResetApi=true, McuVersionInfoApi=true
    McuModuleConfiguration: McuClockSrcFailureNotification=DISABLED, McuNumberOfMcuModes=0, McuRamSectors=1, McuResetSetting=0
      McuClockSettingConfig:
        ArcAHBClocksEnable = DMA1
        ArcAPB1ClocksEnable = TIM2
        ArcAPB1ClocksEnable = CAN1
        ArcAPB2ClocksEnable = ADC1
        ArcAPB2ClocksEnable = GPIOA
        ArcAPB2ClocksEnable = GPIOB
        ArcAPB2ClocksEnable = GPIOC
        ArcAPB2ClocksEnable = AFIO
        McuDefaultClockReference = EXT_REF_8MHZ
        EXT_REF_8MHZ (McuClockReferencePoint): McuClockReferencePointFrequency=8000000.0, McuClockReferencePointPllEprediv=9, McuClockReferencePointPllEmfd=0, McuClockReferencePointPllErfd=0
      McuModeSettingConf: McuMode=0
  module config Det
    DetGeneral: DetEnableCallbacks=false, DetUseRamlog=true, DetWrapRamlog=true, DetUseStdErr=false, DetDeInitAPI=false, DetNumberOfCallbacks=5, DetRamlogSize=16
  module config EcuM
    EcuMGeneral: EcuMDevErrorDetect=true, EcuMIncludeNvramMgr=false, EcuMVersionInfoApi=true, EcuMMainFunctionPeriod=0.2
    EcuMConfiguration: EcuMNvramReadallTimeout=10.0, EcuMRunMinimumDuration=10.0, EcuMNvramWriteallTimeout=10.0
  module config Port
    PortConfigSet
      PortContainer_1 (PortContainer)
        B13 (PortPin):
          PortPinPullMode = 
          PortPinDirection = OUTPUT_10MHz_MODE
          PortPinDirectionChangeable = false
          PortPinHysteresisEnabled = false
          PortPinOpenDrainEnabled = false
          ArcReducedDrive = false
          PortPinId = 29
          ArcPortPinName = 
          PortPinLevelValue = OUTPUT_HIGH
          PortPinMode = OUTPUT_PUSHPULL_CNF
        B14 (PortPin):
          PortPinPullMode = 
          PortPinDirection = OUTPUT_10MHz_MODE
          PortPinDirectionChangeable = false
          PortPinHysteresisEnabled = false
          PortPinOpenDrainEnabled = false
          ArcReducedDrive = false
          PortPinId = 30
          ArcPortPinName = 
          PortPinLevelValue = OUTPUT_HIGH
          PortPinMode = OUTPUT_PUSHPULL_CNF
    PortGeneral:
      ArcGpioRemap = Remap1_CAN1
      PortDevErrorDetect = true
      PortSetPinDirectionApi = false
      PortSetPinModeApi = false
      PortVersionInfoApi = true
      ArcGpioRemap = PartialRemap2_TIM2
  module config Dio
    DioGeneral: DioDevErrorDetect=true, DioVersionInfoApi=true
    LED_PORT (DioPort): DioPortId=0, ArcCoreDioPhysicalPort=B
      LED_CHANNEL1 (DioChannel): DioChannelId=29
      LED_CHANNEL2 (DioChannel): DioChannelId=30
