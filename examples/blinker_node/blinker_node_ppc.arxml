AUTOSAR XML (schema 3.1.2)
# Copyright ArcCore AB 2010
package /blinker_node_ppc
  ecu configuration blinker_node_ppc: module=Os
  module config Os
    OsOS:
      OsStackMonitoring = true
      OsStatus = EXTENDED
      OsUseGetServiceId = true
      OsUseParameterAccess = true
      OsUseResScheduler = true
      OsTickFrequency = 1000
      OsInterruptStackSize = 2048
      ArcCoreOsUseDebug = true
      ArcCoreOsDebugTask = true
      ArcCoreOsDebugAlarm = true
      ArcCoreOsDebugResource = true
      ArcCoreOsDebugScheduleTable = true
      ArcCoreOsDebugEvent = true
      OsHooks: OsErrorHook=true, OsPostTaskHook=true, OsPreTaskHook=true, OsProtectionHook=false, OsShutdownHook=true, OsStartupHook=true
    4 x OsTask, all with OsTaskActivation=1, OsTaskPriority=1, OsTaskProcessType=BASIC, ArcCoreOsTaskStackSize=2048, OsTaskSchedule=FULL:
      bTask25
      bTask100
      bTask10
      Startup
        OsTaskAutostart
    OsTick (OsCounter): OsCounterMaxAllowedValue=65535, OsCounterMinCycle=0, OsCounterTicksPerBase=0, OsCounterType=OS-TICK
    3 x OsAlarm, all with OsAlarmCounterRef=OsTick:
      alarm25
        OsAlarmActivateTask: OsAlarmActivateTaskRef=bTask25
      alarm10
        OsAlarmActivateTask: OsAlarmActivateTaskRef=bTask10
      alarm100
        OsAlarmActivateTask: OsAlarmActivateTaskRef=bTask100
