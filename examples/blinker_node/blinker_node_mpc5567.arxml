AUTOSAR XML (schema 3.1.4)
package /blinker_node_mpc5567
  ecu configuration blinker_node_mpc5567: ecu-sw-composition=SwComposition_blinker_node_mpc5567, module=[Os, Det, EcuM, Mcu, Port, Dio]
  ecu sw composition SwComposition_blinker_node_mpc5567
  module config Os
    OsOS:
      OsStackMonitoring = true
      OsStatus = EXTENDED
      OsUseGetServiceId = true
      OsUseParameterAccess = true
      OsUseResScheduler = true
      OsTickFrequency = 1000
      OsInterruptStackSize = 2048
      OsIdleStackSize = 512
      ArcCoreOsUseDebug = false
      ArcCoreOsDebugTask = true
      ArcCoreOsDebugAlarm = true
      ArcCoreOsDebugResource = true
      ArcCoreOsDebugScheduleTable = true
      ArcCoreOsDebugEvent = true
      OsHooks: OsErrorHook=true, OsPostTaskHook=true, OsPreTaskHook=true, OsProtectionHook=false, OsShutdownHook=true, OsStartupHook=true
    OsTick (OsCounter): OsCounterMaxAllowedValue=65535, OsCounterMinCycle=0, OsCounterTicksPerBase=0, OsCounterType=OS_TICK
    4 x OsTask, all with OsTaskActivation=1, OsTaskProcessType=BASIC, ArcCoreOsTaskStackSize=2048, OsTaskSchedule=FULL:
      bTask25: OsTaskPriority=1
      bTask100: OsTaskPriority=1
      bTask10: OsTaskPriority=1
      Startup: OsTaskPriority=2
        OsTaskAutostart
    3 x OsAlarm, all with OsAlarmCounterRef=OsTick:
      alarm25
        OsAlarmActivateTask: OsAlarmActivateTaskRef=bTask25
      alarm10
        OsAlarmActivateTask: OsAlarmActivateTaskRef=bTask10
      alarm100
        OsAlarmActivateTask: OsAlarmActivateTaskRef=bTask100
  module config Det
    DetGeneral: DetEnableCallbacks=false, DetUseRamlog=true, DetWrapRamlog=true, DetUseStdErr=false, DetDeInitAPI=false, DetNumberOfCallbacks=5, DetRamlogSize=16
  module config EcuM
    EcuMGeneral: EcuMDevErrorDetect=true, EcuMIncludeNvramMgr=false, EcuMVersionInfoApi=true, EcuMMainFunctionPeriod=0.2
    EcuMConfiguration: EcuMNvramReadallTimeout=10.0, EcuMRunMinimumDuration=10.0, EcuMNvramWriteallTimeout=10.0
      EcuMUserConfig
  module config Mcu
    McuGeneralConfiguration: McuDevErrorDetect=true, McuPerformResetApi=true, McuVersionInfoApi=true
    McuModuleConfiguration: McuClockSrcFailureNotification=DISABLED, McuNumberOfMcuModes=0, McuRamSectors=1, McuResetSetting=0
      McuClockSettingConfig: McuDefaultClockReference=EXT_REF_80MHZ
        EXT_REF_80MHZ (McuClockReferencePoint): McuClockReferencePointFrequency=1.6E7, McuClockReferencePointPllEprediv=2, McuClockReferencePointPllEmfd=11, McuClockReferencePointPllErfd=0
      McuModeSettingConf: McuMode=0
  module config Port
    PortConfigSet
      PortContainer_1 (PortContainer)
        GPIO[125] (PortPin):
          PortPinPullMode = PULL_NONE
          PortPinDirection = PORT_PIN_OUT
          PortPinDirectionChangeable = false
          PortPinHysteresisEnabled = false
          PortPinOpenDrainEnabled = false
          PortPinId = 125
          PortPinSlewRate = SLEW_RATE_MIN
          PortPinLevelValue = PORT_PIN_LEVEL_LOW
          PortPinMode = PORT_PIN_MODE_DIO
    PortGeneral: PortDevErrorDetect=true, PortSetPinDirectionApi=true, PortSetPinModeApi=true, PortVersionInfoApi=true
  module config Dio
    DioGeneral: DioDevErrorDetect=false, DioVersionInfoApi=false
    DioPort_1 (DioPort): DioPortId=0, ArcCoreDioPhysicalPort=DIO_MPC5567_GENERIC_PORT
      LED_K2 (DioChannel): DioChannelId=125
