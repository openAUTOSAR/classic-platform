AUTOSAR XML (schema 3.1.4)
package /config_osek_al
  ecu configuration config_osek_al: ecu-sw-composition=SwComposition_config_osek_al, module=Os
  ecu sw composition SwComposition_config_osek_al
  module config Os
    OsOS:
      OsStackMonitoring = true
      OsStatus = EXTENDED
      OsUseGetServiceId = true
      OsUseParameterAccess = true
      OsUseResScheduler = true
      OsTickFrequency = 1000
      OsInterruptStackSize = 2048
      OsIdleStackSize = 512
      ArcCoreOsUseDebug = false
      ArcCoreOsDebugTask = false
      ArcCoreOsDebugAlarm = false
      ArcCoreOsDebugResource = false
      ArcCoreOsDebugScheduleTable = false
      ArcCoreOsDebugEvent = false
      OsHooks: OsErrorHook=true, OsPostTaskHook=true, OsPreTaskHook=true, OsProtectionHook=false, OsShutdownHook=true, OsStartupHook=true
    act_etask_h_full (OsAlarm): OsAlarmCounterRef=soft1
      OsAlarmActivateTask: OsAlarmActivateTaskRef=etask_h_full
    soft1 (OsCounter): OsCounterMaxAllowedValue=65535, OsCounterMinCycle=2, OsCounterTicksPerBase=0, OsCounterType=SOFTWARE
    etask_m_full (OsTask): OsTaskActivation=1, OsTaskPriority=5, OsTaskProcessType=EXTENDED, ArcCoreOsTaskStackSize=2048, OsTaskSchedule=FULL
      OsTaskAutostart
    etask_h_full (OsTask): OsTaskActivation=1, OsTaskPriority=6, OsTaskProcessType=EXTENDED, ArcCoreOsTaskStackSize=2048, OsTaskSchedule=FULL
    setev_go_etask_h_full (OsAlarm): OsAlarmCounterRef=soft1
      OsAlarmSetEvent: OsAlarmSetEventRef=go, OsAlarmSetEventTaskRef=etask_h_full
    go (OsEvent): OsEventMask=1
    system_tick (OsCounter): OsCounterMaxAllowedValue=65535, OsCounterMinCycle=1, OsCounterTicksPerBase=0, OsCounterType=OS_TICK
    sys_tick_act_etask_h_full (OsAlarm): OsAlarmCounterRef=system_tick
      OsAlarmActivateTask: OsAlarmActivateTaskRef=etask_h_full
    etask_l_non (OsTask): OsTaskActivation=1, OsTaskPriority=4, OsTaskProcessType=EXTENDED, ArcCoreOsTaskStackSize=2048, OsTaskSchedule=NON
    act_etask_l_non (OsAlarm): OsAlarmCounterRef=soft1
      OsAlarmActivateTask: OsAlarmActivateTaskRef=etask_l_non
    go2 (OsEvent): OsEventMask=2
