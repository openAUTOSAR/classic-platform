AUTOSAR XML (schema 3.1.2)
package /testsystem
  ecu configuration testsystem: module=Os
  module config Os
    OsOS:
      OsStackMonitoring = true
      OsStatus = EXTENDED
      OsUseGetServiceId = true
      OsUseParameterAccess = true
      OsUseResScheduler = true
      OsTickFrequency = 1000
      OsInterruptStackSize = 2048
      OsIdleStackSize = 512
      ArcCoreOsUseDebug = true
      ArcCoreOsDebugResource = true
      ArcCoreOsDebugEvent = true
      ArcCoreOsDebugScheduleTable = true
      ArcCoreOsDebugTask = true
      ArcCoreOsDebugAlarm = true
      OsHooks: OsErrorHook=true, OsPostTaskHook=true, OsPreTaskHook=true, OsProtectionHook=false, OsShutdownHook=true, OsStartupHook=true
    int_1 (OsResource): OsResourceProperty=INTERNAL
    7 x OsTask, all with OsTaskActivation=1, ArcCoreOsTaskStackSize=2048, OsTaskSchedule=FULL:
      etask_master: OsTaskPriority=1, OsTaskProcessType=EXTENDED
        OsTaskAutostart
      etask_sup_l: OsTaskPriority=2, OsTaskProcessType=EXTENDED, OsTaskResourceRef=std_prio_3, OsTaskResourceRef=std_prio_4, OsTaskResourceRef=std_prio_5
      etask_sup_m: OsTaskPriority=4, OsTaskProcessType=EXTENDED, OsTaskResourceRef=std_prio_3, OsTaskResourceRef=std_prio_4, OsTaskResourceRef=std_prio_5
      etask_sup_h: OsTaskPriority=6, OsTaskProcessType=EXTENDED, OsTaskResourceRef=std_prio_3, OsTaskResourceRef=std_prio_4, OsTaskResourceRef=std_prio_5
      btask_sup_l: OsTaskPriority=2, OsTaskProcessType=BASIC, OsTaskResourceRef=std_prio_3, OsTaskResourceRef=std_prio_4, OsTaskResourceRef=std_prio_5
      btask_sup_m: OsTaskPriority=4, OsTaskProcessType=BASIC, OsTaskResourceRef=std_prio_3, OsTaskResourceRef=std_prio_4, OsTaskResourceRef=std_prio_5
      btask_sup_h: OsTaskPriority=6, OsTaskProcessType=BASIC, OsTaskResourceRef=std_prio_3, OsTaskResourceRef=std_prio_4, OsTaskResourceRef=std_prio_5
    3 x OsResource, all with OsResourceProperty=STANDARD:
      std_prio_{3..5}
    NOTIF (OsEvent): OsEventMask=1
    KILL (OsEvent): OsEventMask=32768
    0 (OsScheduleTable): OsScheduleTableDuration=15, OsScheduleTableRepeating=false, OsScheduleTableCounterRef=soft_1
      3 x OsScheduleTableExpiryPoint:
        ExpiryPoint: OsScheduleTblExpPointOffset=5
          TaskActivation1 (OsScheduleTableTaskActivation): OsScheduleTableActivateTaskRef=etask_sup_m
        ExpiryPoint1: OsScheduleTblExpPointOffset=7
          EventSetting1 (OsScheduleTableEventSetting): OsScheduleTableSetEventRef=NOTIF, OsScheduleTableSetEventTaskRef=etask_sup_m
        ExpiryPoint2: OsScheduleTblExpPointOffset=11
          EventSetting1 (OsScheduleTableEventSetting): OsScheduleTableSetEventRef=NOTIF, OsScheduleTableSetEventTaskRef=etask_sup_m
          TaskActivation1 (OsScheduleTableTaskActivation): OsScheduleTableActivateTaskRef=etask_sup_m
      OsScheduleTableAutostart: OsScheduleTableAutostartType=ABSOLUTE, ArcCoreOsScheduleTableOffset=1
    OsTick (OsCounter): OsCounterMaxAllowedValue=65535, OsCounterMinCycle=0, OsCounterTicksPerBase=0, OsCounterType=OS_TICK
    soft_1 (OsCounter): OsCounterMaxAllowedValue=65535, OsCounterMinCycle=0, OsCounterTicksPerBase=0, OsCounterType=SOFTWARE
    1 (OsScheduleTable): OsScheduleTableDuration=5, OsScheduleTableRepeating=false, OsScheduleTableCounterRef=soft_1
      ExpiryPoint (OsScheduleTableExpiryPoint): OsScheduleTblExpPointOffset=2
        TaskActivation1 (OsScheduleTableTaskActivation): OsScheduleTableActivateTaskRef=etask_sup_m
    4 x OsAlarm:
      c_sys_activate_btask_h: OsAlarmCounterRef=OsTick
        OsAlarmActivateTask: OsAlarmActivateTaskRef=btask_sup_h
      c_sys_1_setevent_etask_m: OsAlarmCounterRef=OsTick
        OsAlarmSetEvent: OsAlarmSetEventRef=NOTIF, OsAlarmSetEventTaskRef=etask_sup_m
      c_soft_1_setevent_etask_m: OsAlarmCounterRef=soft_1
        OsAlarmSetEvent: OsAlarmSetEventRef=NOTIF, OsAlarmSetEventTaskRef=etask_sup_m
      c_soft_1_inc_counter_2: OsAlarmCounterRef=soft_1
        OsAlarmIncrementCounter: OsAlarmIncrementCounterRef=soft_2
    soft_2 (OsCounter): OsCounterMaxAllowedValue=65535, OsCounterMinCycle=0, OsCounterTicksPerBase=0, OsCounterType=SOFTWARE
