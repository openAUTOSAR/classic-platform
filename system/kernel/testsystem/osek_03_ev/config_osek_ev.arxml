AUTOSAR XML (schema 3.1.4)
standard types defined: UInt8, UInt16, UInt32, SInt8, SInt16
package /config_osek_ev
  ecu configuration config_osek_ev: ecu-sw-composition=SwComposition_config_osek_ev, module=Os
  ecu sw composition SwComposition_config_osek_ev
  module config Os
    OsOS:
      OsStackMonitoring = true
      OsStatus = EXTENDED
      OsUseGetServiceId = true
      OsUseParameterAccess = true
      OsUseResScheduler = true
      OsTickFrequency = 1000
      OsInterruptStackSize = 2048
      OsIdleStackSize = 512
      ArcCoreOsUseDebug = true
      ArcCoreOsDebugTask = true
      ArcCoreOsDebugAlarm = true
      ArcCoreOsDebugResource = true
      ArcCoreOsDebugScheduleTable = true
      ArcCoreOsDebugEvent = true
      OsHooks: OsErrorHook=true, OsPostTaskHook=true, OsPreTaskHook=true, OsProtectionHook=false, OsShutdownHook=true, OsStartupHook=true
    6 x OsTask, all with ArcCoreOsTaskStackSize=2048, OsTaskSchedule=FULL:
      etask_h_full: OsTaskActivation=1, OsTaskPriority=6, OsTaskProcessType=EXTENDED
      etask_m_full: OsTaskActivation=1, OsTaskPriority=5, OsTaskProcessType=EXTENDED, OsTaskResourceRef=std_1
        OsTaskAutostart
      etask_l_full: OsTaskActivation=1, OsTaskPriority=4, OsTaskProcessType=EXTENDED
      btask_h_full: OsTaskActivation=1, OsTaskPriority=6, OsTaskProcessType=BASIC
      btask_m_full: OsTaskActivation=2, OsTaskPriority=5, OsTaskProcessType=BASIC
      btask_l_full: OsTaskActivation=2, OsTaskPriority=4, OsTaskProcessType=BASIC
    go (OsEvent): OsEventMask=1
    Counter1 (OsCounter): OsCounterMaxAllowedValue=65535, OsCounterMinCycle=0, OsCounterTicksPerBase=0, OsCounterType=OS_TICK
    etask_m_non (OsTask): OsTaskActivation=2, OsTaskPriority=5, OsTaskProcessType=EXTENDED, ArcCoreOsTaskStackSize=2048, OsTaskSchedule=NON
    go2 (OsEvent): OsEventMask=2
    btask_ll_non (OsTask): OsTaskActivation=1, OsTaskPriority=3, OsTaskProcessType=BASIC, ArcCoreOsTaskStackSize=2048, OsTaskSchedule=NON
    std_1 (OsResource): OsResourceProperty=STANDARD
