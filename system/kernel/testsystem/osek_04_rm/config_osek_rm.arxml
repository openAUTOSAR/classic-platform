AUTOSAR XML (schema 3.1.4)
package /config_osek_rm
  ecu configuration config_osek_rm: ecu-sw-composition=SwComposition_config_osek_rm, module=Os
  ecu sw composition SwComposition_config_osek_rm
  module config Os
    OsOS:
      OsStackMonitoring = true
      OsStatus = EXTENDED
      OsUseGetServiceId = true
      OsUseParameterAccess = false
      OsUseResScheduler = true
      OsTickFrequency = 1000
      OsInterruptStackSize = 2048
      OsIdleStackSize = 512
      ArcCoreOsUseDebug = true
      ArcCoreOsDebugTask = true
      ArcCoreOsDebugAlarm = true
      ArcCoreOsDebugResource = true
      ArcCoreOsDebugScheduleTable = true
      ArcCoreOsDebugEvent = true
      OsHooks: OsErrorHook=true, OsPostTaskHook=true, OsPreTaskHook=true, OsProtectionHook=false, OsShutdownHook=true, OsStartupHook=true
    7 x OsTask, all with ArcCoreOsTaskStackSize=2048:
      etask_h_full: OsTaskActivation=1, OsTaskPriority=6, OsTaskProcessType=EXTENDED, OsTaskSchedule=FULL
      etask_m_full: OsTaskActivation=1, OsTaskPriority=5, OsTaskProcessType=EXTENDED, OsTaskSchedule=FULL, OsTaskResourceRef=std_1
        OsTaskAutostart
      etask_l_full: OsTaskActivation=1, OsTaskPriority=4, OsTaskProcessType=EXTENDED, OsTaskSchedule=FULL, OsTaskResourceRef=std_h
      btask_h_full: OsTaskActivation=1, OsTaskPriority=6, OsTaskProcessType=BASIC, OsTaskSchedule=FULL, OsTaskResourceRef=std_h
      btask_m_full: OsTaskActivation=2, OsTaskPriority=5, OsTaskProcessType=BASIC, OsTaskSchedule=FULL, OsTaskResourceRef=std_h
      btask_l_full: OsTaskActivation=2, OsTaskPriority=4, OsTaskProcessType=BASIC, OsTaskSchedule=FULL
      btask_ll_non: OsTaskActivation=1, OsTaskPriority=3, OsTaskProcessType=BASIC, OsTaskSchedule=NON
    go (OsEvent): OsEventMask=1
    Counter1 (OsCounter): OsCounterMaxAllowedValue=65535, OsCounterMinCycle=0, OsCounterTicksPerBase=0, OsCounterType=OS_TICK
    btask_m_non (OsTask): OsTaskActivation=2, OsTaskPriority=5, OsTaskProcessType=BASIC, ArcCoreOsTaskStackSize=2048, OsTaskSchedule=NON
    std_1 (OsResource): OsResourceProperty=STANDARD
    std_h (OsResource): OsResourceProperty=STANDARD
    btask_l_non (OsTask): OsTaskActivation=1, OsTaskPriority=4, OsTaskProcessType=BASIC, ArcCoreOsTaskStackSize=2048, OsTaskSchedule=NON, OsTaskResourceRef=std_h
    int_1 (OsResource): OsResourceProperty=INTERNAL
    int_2 (OsResource): OsResourceProperty=INTERNAL
