AUTOSAR XML (schema 3.1.2)
package /suite_02
  ecu configuration suite_02: module=Os
  module config Os
    OsOS:
      OsStackMonitoring = true
      OsStatus = EXTENDED
      OsUseGetServiceId = true
      OsUseParameterAccess = true
      OsUseResScheduler = true
      OsTickFrequency = 1000
      OsInterruptStackSize = 2048
      OsIdleStackSize = 512
      ArcCoreOsUseDebug = true
      ArcCoreOsDebugTask = true
      ArcCoreOsDebugAlarm = true
      ArcCoreOsDebugResource = true
      ArcCoreOsDebugScheduleTable = true
      ArcCoreOsDebugEvent = true
      OsHooks: OsErrorHook=true, OsPostTaskHook=true, OsPreTaskHook=true, OsProtectionHook=false, OsShutdownHook=true, OsStartupHook=true
    btask_2 (OsTask): OsTaskActivation=1, OsTaskPriority=2, OsTaskProcessType=EXTENDED, ArcCoreOsTaskStackSize=2048, OsTaskSchedule=FULL
      OsTaskAutostart
    Alarm1 (OsAlarm): OsAlarmCounterRef=Counter2
      OsAlarmAutostart: OsAlarmAlarmTime=1, OsAlarmAutostartType=ABSOLUTE, OsAlarmCycleTime=0
      OsAlarmSetEvent: OsAlarmSetEventRef=Alarm_1, OsAlarmSetEventTaskRef=etask_master
    Alarm2 (OsAlarm): OsAlarmCounterRef=Counter2
      OsAlarmAutostart: OsAlarmAlarmTime=1, OsAlarmAutostartType=ABSOLUTE, OsAlarmCycleTime=0
      OsAlarmSetEvent: OsAlarmSetEventRef=Alarm_2, OsAlarmSetEventTaskRef=etask_master
    ScheduleTable_1 (OsScheduleTable): OsScheduleTableDuration=10, OsScheduleTableRepeating=false, OsScheduleTableCounterRef=Counter2
      ExpiryPoint (OsScheduleTableExpiryPoint): OsScheduleTblExpPointOffset=0
        EventSetting1 (OsScheduleTableEventSetting): OsScheduleTableSetEventRef=SchTbl_1, OsScheduleTableSetEventTaskRef=etask_master
      OsScheduleTableAutostart: OsScheduleTableAutostartType=ABSOLUTE, ArcCoreOsScheduleTableOffset=1
    ScheduleTable_2 (OsScheduleTable): OsScheduleTableDuration=10, OsScheduleTableRepeating=false, OsScheduleTableCounterRef=Counter2
      ExpiryPoint (OsScheduleTableExpiryPoint): OsScheduleTblExpPointOffset=0
        EventSetting1 (OsScheduleTableEventSetting): OsScheduleTableSetEventRef=SchTbl_2, OsScheduleTableSetEventTaskRef=etask_master
      OsScheduleTableAutostart: OsScheduleTableAutostartType=ABSOLUTE, ArcCoreOsScheduleTableOffset=1
    Counter1 (OsCounter): OsCounterMaxAllowedValue=65535, OsCounterMinCycle=0, OsCounterTicksPerBase=0, OsCounterType=OS_TICK
    Counter2 (OsCounter): OsCounterMaxAllowedValue=65535, OsCounterMinCycle=0, OsCounterTicksPerBase=0, OsCounterType=SOFTWARE
    Event1 (OsEvent): OsEventMask=1
    4 x OsTask, all with OsTaskActivation=1, ArcCoreOsTaskStackSize=2048, OsTaskSchedule=FULL:
      btask_4: OsTaskPriority=4, OsTaskProcessType=BASIC
        OsTaskAutostart
      etask_3: OsTaskPriority=3, OsTaskProcessType=EXTENDED
        OsTaskAutostart
      etask_5: OsTaskPriority=5, OsTaskProcessType=EXTENDED
        OsTaskAutostart
      etask_master: OsTaskPriority=10, OsTaskProcessType=EXTENDED
        OsTaskAutostart
    4 x OsEvent:
      Alarm_1: OsEventMask=1
      Alarm_2: OsEventMask=2
      SchTbl_1: OsEventMask=4
      SchTbl_2: OsEventMask=8
