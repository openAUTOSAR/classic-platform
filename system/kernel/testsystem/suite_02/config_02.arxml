AUTOSAR XML (schema 3.1.2)
package /suite_02
  ecu configuration suite_02: module=Os
  module config Os
    OsOS:
      OsStackMonitoring = true
      OsStatus = EXTENDED
      OsUseGetServiceId = true
      OsUseParameterAccess = true
      OsUseResScheduler = true
      OsTickFrequency = 1000
      OsInterruptStackSize = 2048
      OsIdleStackSize = 512
      ArcCoreOsUseDebug = true
      ArcCoreOsDebugTask = true
      ArcCoreOsDebugAlarm = true
      ArcCoreOsDebugResource = true
      ArcCoreOsDebugScheduleTable = true
      ArcCoreOsDebugEvent = true
      OsHooks: OsErrorHook=true, OsPostTaskHook=true, OsPreTaskHook=true, OsProtectionHook=false, OsShutdownHook=true, OsStartupHook=true
    btask_l (OsTask): OsTaskActivation=1, OsTaskPriority=1, OsTaskProcessType=EXTENDED, ArcCoreOsTaskStackSize=2048, OsTaskSchedule=FULL
    Alarm1 (OsAlarm): OsAlarmCounterRef=(unset)
    Alarm2 (OsAlarm): OsAlarmCounterRef=(unset)
    ScheduleTable_1 (OsScheduleTable): OsScheduleTableDuration=0, OsScheduleTableRepeating=false, OsScheduleTableCounterRef=(unset)
      ExpiryPoint (OsScheduleTableExpiryPoint): OsScheduleTblExpPointOffset=0
        TaskActivation1 (OsScheduleTableTaskActivation): OsScheduleTableActivateTaskRef=(unset)
    ScheduleTable_2 (OsScheduleTable): OsScheduleTableDuration=0, OsScheduleTableRepeating=false, OsScheduleTableCounterRef=(unset)
      ExpiryPoint (OsScheduleTableExpiryPoint): OsScheduleTblExpPointOffset=0
