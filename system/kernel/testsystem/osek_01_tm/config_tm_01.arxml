AUTOSAR XML (schema 3.1.2)
package /config_tm_01
  ecu configuration config_tm_01: module=Os
  module config Os
    OsOS:
      OsStackMonitoring = true
      OsStatus = EXTENDED
      OsUseGetServiceId = true
      OsUseParameterAccess = true
      OsUseResScheduler = true
      OsTickFrequency = 1000
      OsInterruptStackSize = 2048
      OsIdleStackSize = 512
      ArcCoreOsUseDebug = false
      ArcCoreOsDebugTask = true
      ArcCoreOsDebugAlarm = true
      ArcCoreOsDebugResource = true
      ArcCoreOsDebugScheduleTable = true
      ArcCoreOsDebugEvent = true
      OsHooks: OsErrorHook=true, OsPostTaskHook=true, OsPreTaskHook=true, OsProtectionHook=false, OsShutdownHook=true, OsStartupHook=true
    7 x OsTask, all with ArcCoreOsTaskStackSize=2048:
      etask_h_full: OsTaskActivation=1, OsTaskPriority=6, OsTaskProcessType=EXTENDED, OsTaskSchedule=FULL
      etask_m_full: OsTaskActivation=1, OsTaskPriority=5, OsTaskProcessType=EXTENDED, OsTaskSchedule=FULL, OsTaskResourceRef=std_1
        OsTaskAutostart
      etask_l_full: OsTaskActivation=1, OsTaskPriority=4, OsTaskProcessType=EXTENDED, OsTaskSchedule=FULL
      btask_h_full: OsTaskActivation=1, OsTaskPriority=6, OsTaskProcessType=BASIC, OsTaskSchedule=FULL
      btask_m_full: OsTaskActivation=2, OsTaskPriority=5, OsTaskProcessType=BASIC, OsTaskSchedule=FULL
      btask_l_full: OsTaskActivation=2, OsTaskPriority=4, OsTaskProcessType=BASIC, OsTaskSchedule=FULL
      btask_ll_non: OsTaskActivation=1, OsTaskPriority=3, OsTaskProcessType=BASIC, OsTaskSchedule=NON
    go (OsEvent): OsEventMask=1
    Counter1 (OsCounter): OsCounterMaxAllowedValue=65535, OsCounterMinCycle=0, OsCounterTicksPerBase=0, OsCounterType=OS_TICK
    btask_m_non (OsTask): OsTaskActivation=2, OsTaskPriority=1, OsTaskProcessType=BASIC, ArcCoreOsTaskStackSize=2048, OsTaskSchedule=NON
    etask_m_full_2 (OsTask): OsTaskActivation=1, OsTaskPriority=5, OsTaskProcessType=EXTENDED, ArcCoreOsTaskStackSize=2048, OsTaskSchedule=FULL
    std_1 (OsResource): OsResourceProperty=STANDARD
