AUTOSAR XML (schema 3.1.2)
package /config_03
  ecu configuration config_03: module=Os
  module config Os
    OsOS:
      OsStackMonitoring = true
      OsStatus = EXTENDED
      OsUseGetServiceId = true
      OsUseParameterAccess = true
      OsUseResScheduler = true
      OsTickFrequency = 1000
      OsInterruptStackSize = 2048
      OsIdleStackSize = 512
      ArcCoreOsUseDebug = true
      ArcCoreOsDebugTask = true
      ArcCoreOsDebugAlarm = true
      ArcCoreOsDebugResource = true
      ArcCoreOsDebugScheduleTable = true
      ArcCoreOsDebugEvent = true
      OsHooks: OsErrorHook=true, OsPostTaskHook=true, OsPreTaskHook=true, OsProtectionHook=false, OsShutdownHook=true, OsStartupHook=true
    13 x OsTask, all with OsTaskActivation=1, ArcCoreOsTaskStackSize=2048:
      etask_master: OsTaskPriority=1, OsTaskProcessType=EXTENDED, OsTaskSchedule=FULL
        OsTaskAutostart
      etask_l_non: OsTaskPriority=2, OsTaskProcessType=EXTENDED, OsTaskSchedule=NON
      etask_l_full: OsTaskPriority=2, OsTaskProcessType=EXTENDED, OsTaskSchedule=FULL
      etask_m_non: OsTaskPriority=3, OsTaskProcessType=EXTENDED, OsTaskSchedule=NON
      etask_m_full: OsTaskPriority=3, OsTaskProcessType=EXTENDED, OsTaskSchedule=FULL
      etask_h_non: OsTaskPriority=4, OsTaskProcessType=EXTENDED, OsTaskSchedule=NON
      etask_h_full: OsTaskPriority=4, OsTaskProcessType=EXTENDED, OsTaskSchedule=FULL
      btask_l_non: OsTaskPriority=2, OsTaskProcessType=BASIC, OsTaskSchedule=NON
      btask_l_full: OsTaskPriority=2, OsTaskProcessType=BASIC, OsTaskSchedule=FULL
      btask_m_non: OsTaskPriority=3, OsTaskProcessType=BASIC, OsTaskSchedule=NON
      btask_m_full: OsTaskPriority=3, OsTaskProcessType=BASIC, OsTaskSchedule=FULL
      btask_h_non: OsTaskPriority=4, OsTaskProcessType=BASIC, OsTaskSchedule=NON
      btask_h_full: OsTaskPriority=4, OsTaskProcessType=BASIC, OsTaskSchedule=FULL
    Counter1 (OsCounter): OsCounterMaxAllowedValue=65535, OsCounterMinCycle=0, OsCounterTicksPerBase=0, OsCounterType=OS_TICK
    5 x OsEvent:
      master_notif: OsEventMask=1
      notif: OsEventMask=2
      test: OsEventMask=4
      kill: OsEventMask=8
      next: OsEventMask=16
