AUTOSAR XML (schema 3.1.4)
package /config_osek_ip
  ecu configuration config_osek_ip: ecu-sw-composition=SwComposition_NewEcu, module=Os
  ecu sw composition SwComposition_NewEcu
  module config Os
    OsOS:
      OsStackMonitoring = true
      OsStatus = EXTENDED
      OsUseGetServiceId = true
      OsUseParameterAccess = true
      OsUseResScheduler = true
      OsTickFrequency = 1000
      OsInterruptStackSize = 2048
      OsIdleStackSize = 512
      ArcCoreOsUseDebug = false
      ArcCoreOsDebugTask = false
      ArcCoreOsDebugAlarm = false
      ArcCoreOsDebugResource = false
      ArcCoreOsDebugScheduleTable = false
      ArcCoreOsDebugEvent = false
      OsHooks: OsErrorHook=true, OsPostTaskHook=true, OsPreTaskHook=true, OsProtectionHook=false, OsShutdownHook=true, OsStartupHook=true
    5 x OsTask, all with OsTaskActivation=1, ArcCoreOsTaskStackSize=2048:
      etask_m_full: OsTaskPriority=5, OsTaskProcessType=EXTENDED, OsTaskSchedule=FULL
        OsTaskAutostart
      etask_m_non: OsTaskPriority=5, OsTaskProcessType=EXTENDED, OsTaskSchedule=NON
      btask_l_non: OsTaskPriority=4, OsTaskProcessType=BASIC, OsTaskSchedule=NON
      btask_l_full: OsTaskPriority=4, OsTaskProcessType=BASIC, OsTaskSchedule=FULL
      etask_l_full: OsTaskPriority=4, OsTaskProcessType=EXTENDED, OsTaskSchedule=FULL
    go (OsEvent): OsEventMask=1
    go2 (OsEvent): OsEventMask=1
