// wclear

// system.up
 sim.res
 sim.unload 
 // arg 1-blaj
 // arg 2-blaj
 // arg 3-debug : 0 
 
 sim.load mpc55xx_sim.dll 20000 0 0
// sim.load C:\projects\workspace\t32_sim\Release\mpc55xx_sim.dll 20000 0 1

enddo

 name.s p.128 timer0
 name.s p.129 timer1
 name.s p.130 timer2
 name.s p.131 timer3
 name.s p.132 timer4
 name.s p.133 timer5
 name.s p.134 timer6
 name.s p.135 timer7
 name.group g.timer p.timer0 p.timer1 p.timer2 p.timer3 p.timer4 p.timer5 p.timer6 p.timer7
 name.word w.timer g.timer

 per demoport

 enddo


 term.protocol sim
 winpos ,,,,,,, iconic
 term 1 1

 winpos ,,,,,,, iconic
 port.get









