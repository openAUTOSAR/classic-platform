//&cmdline="OS.area dir"
//print &cmdline

screen.always
LOCAL &datafile &file &rfile &data &tmpfile &stop

&stop="no"
&datafile="va1.txt"
&rfile="test_result.txt"
&tdir="&cfg_project_path_g\system\kernel\testsystem"
os cmd /c dir &tdir/B /A:D> &datafile

os cmd /c del &rfile

// Start file at #10 to make space for others to use #1..#9
OPEN #10 &datafile /read
READ #10 &data
WHILE "&data"!=""
( 
	&file="&cfg_project_path_g"+"/binaries/system_kernel_testsystem_"+"&data"+".elf"
  IF OS.FILE("&file")
  (
    &tmpfile=os.tmpfile()
    GOSUB testrun &file "hopp.txt"
    os cmd /c type hopp.txt >> &rfile  
  )
  IF "&stop"=="yes"
  (
    print "Press any key"
    inkey 
  )

  READ #10 &data
) 

CLOSE #10

type "&rfile"

enddo

//-------------------------------------
testrun:
  LOCAL &file &term_file
  ENTRY &file &term_file

  IF ("&file"=="")||!OS.FILE("&file")
    RETURN

  sys.up
  do load load &file
  do term &term_file
  b.s exit
  b.s _exit
  go
  wait !run()
  b.d /all
  term.close
  RETURN





