// Manage T32 terminal   
// 
// args
//   1 - file, if non-empty output is also written to this file.

LOCAL &file
ENtry &file
winclear my_term
WinPOS 50% 50% 50% 50% 1. 1. my_term
term.size 80. 300.
term.scroll on
term.mode vt100

IF CPUFAMILY()=="ARM"
(
  term.METHOD SE e:address.offset(v.address(t32_outport)) e:0
  term.view
)
ELSE
(
  term.view e:address.offset(v.address(t32_outport)) e:address.offset(v.address(t32_inport))
  IF "&file"!=""
    term.write e:address.offset(v.address(t32_outport)) "&file"
)

enddo













