LOCAL &exe_dir &cpu &proj_path

RADIX Hex
AUTOSTORE , HISTORY BOOKMARK

//winclear

// Turn off screen updates.
screen.off
&proj_path=os.pwd()

print "Current project path:" "&proj_path"

do config load

IF ("&cfg_cpu_g"=="")||(CPUFAMILY()!="&cfg_cpu_family_g")
(
  do config dialog_project
)

IF "&cfg_project_path_g"==""
(
  &cfg_project_path_g="&proj_path"
  do config dialog_project
)

&cpu="&cfg_cpu_g"

sys.down

;reset

&exe_dir=os.ppd()
cd &exe_dir

;sys.cpu &cpu
print "Running setup for &cpu"
do setup setup_&cpu
IF SIMULATOR()
(
  do setup setup_sim
)  
// Setup flash

IF CPUFAMILY()=="POWERPC"
(
  do flash init
)

// At least cortex-M is buggy when using "auto" here.
break.implementation program onchip


// Setup how to view variables and code
setup.var %SYMBOL.on %HEX.on %decimal.on %index.on %string.on %location.on %spotlight.on %open.1
setup.tabsize 4.

menu.rp arccore.men
menu.rp orti.men

winpos 0% 70% 50% 30%
area

area.select
IF SIMULATOR()
(
  print "## Welcome to ArcCore simulator environment for T32   ##"
  print ""
)

enddo











































