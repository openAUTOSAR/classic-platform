// t32 Sun May 31 11:33:27 2009

 B::
 
 TOOLBAR ON
 STATUSBAR ON
 WINPAGE.RESET
 
 WINCLEAR
 WINPOS 78.714 50.538 72. 24. 12. 1. W002
 WINTABS 13. 0. 0. 0. 0. 0. 0.
 ws.b.l
 
 WINPOS 146.57 50.692 89. 22. 0. 0. W005
 ws.Var.View %open Det_RamLog
 
 WINPOS 1.8571 50.154 83. 28. 0. 0. W001
 ws.area
 
 WINPOS 2.2857 0.076923 134. 62. 13. 1. W000
 WINTABS 10. 10. 25. 62.
 ws.d.l
 
 WINPAGE.SELECT P000     
 
 ENDDO
