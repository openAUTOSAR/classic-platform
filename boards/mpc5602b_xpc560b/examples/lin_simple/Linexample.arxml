AUTOSAR XML (schema 3-1-5)
package /Linexample
  ecu configuration Linexample: ecu-sw-composition=SwComposition_Linexample, module=[Det, EcuM, Mcu, Os, EcuC, Com, Port, PduR]
  ecu sw composition SwComposition_Linexample
  module config Det
    DetGeneral: DetEnableCallbacks=false, DetUseRamlog=true, DetWrapRamlog=true, DetUseStdErr=false, DetDeInitAPI=false, DetNumberOfCallbacks=5, DetRamlogSize=16
  module config EcuM
    EcuMGeneral: EcuMDevErrorDetect=false, EcuMIncludeNvramMgr=false, EcuMVersionInfoApi=false, EcuMMainFunctionPeriod=0.2
    EcuMConfiguration: EcuMNvramReadallTimeout=10.0, EcuMRunMinimumDuration=10.0, EcuMNvramWriteallTimeout=10.0
      User_1 (EcuMUserConfig)
      EcuMDefaultShutdownTarget: EcuMDefaultState=EcuMStateReset, EcuMDefaultSleepModeRef=(unset)
      SleepMode_1 (EcuMSleepMode): EcuMSleepModeId=0, EcuMSleepModeName=, EcuMSleepModeSuspend=false, EcuMSleepModeMcuModeRef=RUN, EcuMWakeupSourceMask=WakeupSource_1
      WakeupSource_1 (EcuMWakeupSource): EcuMResetReason=0, EcuMValidationTimeout=0.0, EcuMWakeupSourceId=0, EcuMWakeupSourcePolling=false
  module config Mcu
    McuGeneralConfiguration: McuDevErrorDetect=false, McuPerformResetApi=true, McuVersionInfoApi=true
    McuModuleConfiguration: McuClockSrcFailureNotification=DISABLED, McuNumberOfMcuModes=0, McuRamSectors=1, McuResetSetting=0
      McuClockSettingConfig: McuDefaultClockReference=Clock
        Clock (McuClockReferencePoint): McuClockReferencePointFrequency=8000000.0, McuClockReferencePointPllEprediv=0, McuClockReferencePointPllEmfd=64, McuClockReferencePointPllErfd=2
      RUN (McuModeSettingConf): McuMode=0
  module config Os
    OsOS:
      OsStackMonitoring = true
      OsStatus = EXTENDED
      OsUseGetServiceId = true
      OsUseParameterAccess = true
      OsUseResScheduler = true
      OsTickFrequency = 1000
      OsInterruptStackSize = 2048
      OsIdleStackSize = 512
      OsNumberOfCores = 1
      ArcOsIsrMaxCount = 10
      ArcCoreOsUseDebug = false
      ArcCoreOsDebugTask = false
      ArcCoreOsDebugAlarm = false
      ArcCoreOsDebugResource = false
      ArcCoreOsDebugScheduleTable = false
      ArcCoreOsDebugEvent = false
      OsHooks: OsErrorHook=true, OsPostTaskHook=true, OsPreTaskHook=true, OsProtectionHook=false, OsShutdownHook=true, OsStartupHook=true
    Task (OsTask): OsTaskActivation=1, OsTaskPriority=1, OsTaskProcessType=EXTENDED, ArcCoreOsTaskStackSize=2048, OsTaskSchedule=FULL, OsTaskEventRef=Event1
      OsTaskAutostart
    init (OsTask): OsTaskActivation=1, OsTaskPriority=1, OsTaskProcessType=BASIC, ArcCoreOsTaskStackSize=2048, OsTaskSchedule=FULL
      OsTaskAutostart
    Counter1 (OsCounter): OsCounterMaxAllowedValue=65535, OsCounterMinCycle=1, OsCounterTicksPerBase=0, OsCounterType=OS_TICK
    OsApplication1 (OsApplication): ArcOsAppCoreId=0, OsTrusted=false, OsAppCounterRef=Counter1, OsAppTaskRef=init, OsAppAlarmRef=Alarm1, OsAppTaskRef=Task
      OsApplicationHooks: OsAppErrorHook=false, OsAppShutdownHook=false, OsAppStartupHook=false
    Alarm1 (OsAlarm): OsAlarmCounterRef=Counter1
      OsAlarmSetEvent: OsAlarmSetEventRef=Event1, OsAlarmSetEventTaskRef=Task
      OsAlarmAutostart: OsAlarmAlarmTime=5, OsAlarmAutostartType=ABSOLUTE, OsAlarmCycleTime=5
    Event1 (OsEvent): ArcOsEventId=0, ArcOsEventAutoMask=true
  module config EcuC
    PduCollection
      3 x Pdu:
        ENG_TX: PduLength=64
        LAMPS_RX: PduLength=32
        TCM_RX: PduLength=64
  module config Com
    ComConfig: ComConfigurationId=0
      ComPduGroup_Tx_0 (ComIPduGroup): ComIPduGroupHandleId=0
      FR_TX_01 (ComIPdu):
        ComIPduCallout = 
        ComIPduRxHandleId = 0
        ComIPduSignalProcessing = DEFERRED
        ComIPduDirection = SEND
        ComIPduGroupRef = ComPduGroup_Tx_0
        PduIdRef = PduCollection/ENG_TX
        ComIPduSignalRef = Signal_Tx_{1..3}
        ComTxIPdu: ComTxIPduMinimumDelayTimeFactor=0, ComTxIPduUnusedAreasDefault=0
          ComTxModeTrue
            ComTxMode: ComTxModeMode=DIRECT, ComTxModeNumberOfRepetitions=0, ComTxModeRepetitionPeriodFactor=0, ComTxModeTimeOffsetFactor=0, ComTxModeTimePeriodFactor=0
      FR_RX_01 (ComIPdu):
        ComIPduCallout = 
        ComIPduRxHandleId = 0
        ComIPduSignalProcessing = IMMEDIATE
        ComIPduDirection = RECEIVE
        ComIPduGroupRef = ComPduGroup_Rx_0
        PduIdRef = PduCollection/LAMPS_RX
        ComIPduSignalRef = Signal_Rx_1
        ComIPduSignalRef = Signal_Rx_2
        ComTxIPdu: ComTxIPduMinimumDelayTimeFactor=0, ComTxIPduUnusedAreasDefault=0
          ComTxModeTrue
            ComTxMode: ComTxModeMode=DIRECT, ComTxModeNumberOfRepetitions=0, ComTxModeRepetitionPeriodFactor=0, ComTxModeTimeOffsetFactor=0, ComTxModeTimePeriodFactor=0
      5 x ComSignal, all with ComRxDataTimeoutAction=NONE, ComFirstTimeoutFactor=0, ComHandleId=0, ComNotification=, ComSignalEndianess=BIG_ENDIAN, ComSignalInitValue=0, ComSignalLength=0, ComTimeoutFactor=0, ComTimeoutNotification=, ComTransferProperty=PENDING:
        Signal_Tx_1: ComBitPosition=7, ComBitSize=8, ComSignalType=UINT8
        Signal_Tx_2: ComBitPosition=15, ComBitSize=32, ComSignalType=UINT32
        Signal_Tx_3: ComBitPosition=47, ComBitSize=24, ComSignalType=UINT32
        Signal_Rx_1: ComBitPosition=7, ComBitSize=16, ComSignalType=UINT16
        Signal_Rx_2: ComBitPosition=23, ComBitSize=16, ComSignalType=UINT16
      ComPduGroup_Rx_0 (ComIPduGroup): ComIPduGroupHandleId=0
      FR_RX_02 (ComIPdu):
        ComIPduCallout = 
        ComIPduRxHandleId = 0
        ComIPduSignalProcessing = IMMEDIATE
        ComIPduDirection = RECEIVE
        ComIPduGroupRef = ComPduGroup_Rx_0
        PduIdRef = PduCollection/TCM_RX
        ComIPduSignalRef = word_1
        ComIPduSignalRef = word_2
        ComTxIPdu: ComTxIPduMinimumDelayTimeFactor=0, ComTxIPduUnusedAreasDefault=0
          ComTxModeTrue
            ComTxMode: ComTxModeMode=DIRECT, ComTxModeNumberOfRepetitions=0, ComTxModeRepetitionPeriodFactor=0, ComTxModeTimeOffsetFactor=0, ComTxModeTimePeriodFactor=0
      word_1 (ComSignal):
        ComBitPosition = 7
        ComRxDataTimeoutAction = NONE
        ComBitSize = 32
        ComFirstTimeoutFactor = 0
        ComHandleId = 0
        ComNotification = 
        ComSignalEndianess = BIG_ENDIAN
        ComSignalInitValue = 0
        ComSignalLength = 0
        ComSignalType = UINT32
        ComTimeoutFactor = 0
        ComTimeoutNotification = 
        ComTransferProperty = PENDING
      word_2 (ComSignal):
        ComBitPosition = 39
        ComRxDataTimeoutAction = NONE
        ComBitSize = 32
        ComFirstTimeoutFactor = 0
        ComHandleId = 0
        ComNotification = 
        ComSignalEndianess = BIG_ENDIAN
        ComSignalInitValue = 0
        ComSignalLength = 0
        ComSignalType = UINT32
        ComTimeoutFactor = 0
        ComTimeoutNotification = 
        ComTransferProperty = PENDING
    ComGeneral: ComConfigurationTimeBase=0.0, ComConfigurationUseDet=true, ArcComBitPositionVersionAutosar4=false
  module config Port
    PortConfigSet
      4 x PortContainer:
        LEDS
          4 x PortPin, all with PortPinPullMode=PULL_NONE, PortPinDirection=PORT_PIN_OUT, PortPinDirectionChangeable=false, PortPinHysteresisEnabled=false, PortPinOpenDrainEnabled=false, PortPinSlewRate=SLEW_RATE_MIN, PortPinLevelValue=PORT_PIN_LEVEL_LOW, PortPinMode=PORT_PIN_MODE_DIO:
            GPIO[{68..71}]: PortPinId={68..71}
        LIN
          4 x PortPin, all with PortPinDirectionChangeable=false, PortPinHysteresisEnabled=false, PortPinOpenDrainEnabled=false, PortPinSlewRate=SLEW_RATE_MIN, PortPinLevelValue=PORT_PIN_LEVEL_LOW, PortPinMode=PORT_PIN_MODE_LIN:
            LIN0TX: PortPinPullMode=PULL_NONE, PortPinDirection=PORT_PIN_OUT, PortPinId=18
            LIN0RX: PortPinPullMode=PULL_UP, PortPinDirection=PORT_PIN_IN, PortPinId=19
            LIN1TX: PortPinPullMode=PULL_NONE, PortPinDirection=PORT_PIN_OUT, PortPinId=38
            LIN1RX: PortPinPullMode=PULL_NONE, PortPinDirection=PORT_PIN_IN, PortPinId=39
        SPI
          9 x PortPin, all with PortPinPullMode=PULL_NONE, PortPinDirectionChangeable=false, PortPinHysteresisEnabled=false, PortPinOpenDrainEnabled=false, PortPinSlewRate=SLEW_RATE_MIN, PortPinLevelValue=PORT_PIN_LEVEL_LOW:
            SIN1: PortPinDirection=PORT_PIN_IN, PortPinId=112, PortPinMode=PORT_PIN_MODE_SPI
            SOUT1: PortPinDirection=PORT_PIN_OUT, PortPinId=113, PortPinMode=PORT_PIN_MODE_SPI
            SCK_1: PortPinDirection=PORT_PIN_OUT, PortPinId=114, PortPinMode=PORT_PIN_MODE_OTHER0
            CS0_1: PortPinDirection=PORT_PIN_OUT, PortPinId=115, PortPinMode=PORT_PIN_MODE_SPI
            SIN_0: PortPinDirection=PORT_PIN_IN, PortPinId=12, PortPinMode=PORT_PIN_MODE_SPI
            SOUT_0: PortPinDirection=PORT_PIN_OUT, PortPinId=13, PortPinMode=PORT_PIN_MODE_SPI
            SCK_0: PortPinDirection=PORT_PIN_OUT, PortPinId=14, PortPinMode=PORT_PIN_MODE_OTHER
            CS0_0: PortPinDirection=PORT_PIN_OUT, PortPinId=15, PortPinMode=PORT_PIN_MODE_SPI
            CS1_0: PortPinDirection=PORT_PIN_OUT, PortPinId=28, PortPinMode=PORT_PIN_MODE_SPI
        CAN
          4 x PortPin, all with PortPinPullMode=PULL_NONE, PortPinDirectionChangeable=false, PortPinHysteresisEnabled=false, PortPinOpenDrainEnabled=false, PortPinSlewRate=SLEW_RATE_MIN, PortPinLevelValue=PORT_PIN_LEVEL_LOW, PortPinMode=PORT_PIN_MODE_CAN:
            CAN0TX: PortPinDirection=PORT_PIN_OUT, PortPinId=16
            CAN0RX: PortPinDirection=PORT_PIN_IN, PortPinId=17
            CAN1TX: PortPinDirection=PORT_PIN_OUT, PortPinId=42
            CAN1RX: PortPinDirection=PORT_PIN_IN, PortPinId=43
    PortGeneral: PortDevErrorDetect=true, PortSetPinDirectionApi=true, PortSetPinModeApi=true, PortVersionInfoApi=true
  module config PduR
    PduRGeneral:
      PduRCanIfSupport = false
      PduRCanTpSupport = false
      PduRComSupport = true
      PduRDcmSupport = false
      ArcPduRJ1939TpSupport = false
      PduRDevErrorDetect = false
      PduRFifoTxBufferSupport = false
      PduRFrIfSupport = false
      PduRFrTpSupport = false
      PduRGatewayOperation = false
      PduRIPduMSupport = false
      PduRLinIfSupport = true
      PduRLinTpSupport = false
      PduRMemorySize = 0
      PduRMinimumRoutingLoModule = 
      PduRMinimumRoutingLoRxPduId = 0
      PduRMinimumRoutingLoTxPduId = 0
      PduRMinimumRoutingUpModule = 
      PduRMinimumRoutingUpRxPduId = 0
      PduRMinimumRoutingUpTxPduId = 0
      PduRMulticastFromIfSupport = false
      PduRMulticastFromTpSupport = false
      PduRMulticastToIfSupport = false
      PduRMulticastToTpSupport = false
      PduRSbTxBufferSupport = false
      PduRVersionInfoApi = false
      PduRZeroCostOperation = false
    PduRGlobalConfig: PduRConfigurationId=0
      PduRRoutingTable
        3 x PduRRoutingPath, all with TpChunkSize=0:
          ENG_TX: SduLength=64, ArcOverriddenSourceModule=Com
            PduRDestination (PduRDestPdu): ArcOverriddenDestinationModule=LinIf, DataProvision=DIRECT, DestPduRef=PduCollection/ENG_TX
            PduRSrcPdu: HandleId=0, SrcPduRef=PduCollection/ENG_TX
          LAMPS_RX: SduLength=32, ArcOverriddenSourceModule=LinIf
            PduRSrcPdu: HandleId=0, SrcPduRef=PduCollection/LAMPS_RX
            PduRDestination1 (PduRDestPdu): ArcOverriddenDestinationModule=Com, DataProvision=DIRECT, DestPduRef=PduCollection/LAMPS_RX
          TCM_RX: SduLength=64, ArcOverriddenSourceModule=LinIf
            PduRDestination (PduRDestPdu): DataProvision=DIRECT, ArcOverriddenDestinationModule=Com, DestPduRef=PduCollection/TCM_RX
            PduRSrcPdu: HandleId=0, SrcPduRef=PduCollection/TCM_RX
      PduRTpBufferTable: PduRMaxTpBufferNumber=0
