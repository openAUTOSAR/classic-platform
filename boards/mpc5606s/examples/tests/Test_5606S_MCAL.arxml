AUTOSAR XML (schema 3.1.4)
package /Test_5606S_MCAL
  ecu configuration Test_5606S_MCAL: ecu-sw-composition=SwComposition_Test_5606S_MCAL, module=[Can, Dio, Gpt, Mcu, Port, Pwm, Os]
  ecu sw composition SwComposition_Test_5606S_MCAL
  module config Can
    CanConfigSet
      Controller_1 (CanController):
        CanControllerActivation = true
        CanControllerLoopback = false
        CanControllerBaudRate = 125
        CanHWControllerId = FLEXCAN_A
        CanControllerPropSeg = 4
        CanControllerSeg1 = 4
        CanControllerSeg2 = 4
    CanGeneral: CanDevErrorDetection=false, CanMultiplexedTransmission=false, CanVersionInfoApi=false
  module config Dio
    DioGeneral: DioDevErrorDetect=false, DioVersionInfoApi=false
    DioPort_1 (DioPort): DioPortId=0, ArcCoreDioPhysicalPort=DIO_PORT_A
  module config Gpt
    GptChannelConfigSet
      GptChannel_1 (GptChannelConfiguration):
        ArcGptChanneNotificationPriority = 2
        GptChannelClkSrc = 0
        GptChannelId = 0
        ArcCoreGptPhysicalChannel = GPT_CHANNEL_PIT_0
        GptChannelMode = 
        GptChannelPrescale = 0
        GptEnableWakeup = false
        GptNotification = 
    GptConfigurationOfOptApiServices:
      GptDeinitApi = false
      GptEnableDisableNotificationApi = false
      GptTimeElapsedApi = false
      GptTimeRemainingApi = false
      GptVersionInfoApi = false
      GptWakeupFunctionalityApi = false
    GptDriverConfiguration: GptDevErrorDetect=false, GptReportWakeupSource=false
  module config Mcu
    McuGeneralConfiguration: McuDevErrorDetect=false, McuPerformResetApi=true, McuVersionInfoApi=true
    McuModuleConfiguration: McuClockSrcFailureNotification=DISABLED, McuNumberOfMcuModes=0, McuRamSectors=1, McuResetSetting=0
      McuClockSettingConfig: McuDefaultClockReference=(unset)
        Clock (McuClockReferencePoint): McuClockReferencePointFrequency=0.0, McuClockReferencePointPllEprediv=0, McuClockReferencePointPllEmfd=0, McuClockReferencePointPllErfd=0
      McuModeSettingConf: McuMode=0
  module config Port
    PortConfigSet
      PortContainer_1 (PortContainer)
        PA[0] (PortPin):
          PortPinPullMode = PULL_NONE
          PortPinDirection = PORT_PIN_IN
          PortPinDirectionChangeable = false
          PortPinHysteresisEnabled = false
          PortPinOpenDrainEnabled = false
          PortPinId = 0
          PortPinSlewRate = SLEW_RATE_MIN
          PortPinLevelValue = PORT_PIN_LEVEL_LOW
          PortPinMode = PORT_PIN_MODE_DIO
        CNTX_A (PortPin):
          PortPinPullMode = PULL_NONE
          PortPinDirection = PORT_PIN_OUT
          PortPinDirectionChangeable = false
          PortPinHysteresisEnabled = false
          PortPinOpenDrainEnabled = false
          PortPinId = 48
          PortPinSlewRate = SLEW_RATE_MIN
          PortPinLevelValue = PORT_PIN_LEVEL_LOW
          PortPinMode = PORT_PIN_MODE_CAN
    PortGeneral: PortDevErrorDetect=false, PortSetPinDirectionApi=false, PortSetPinModeApi=false, PortVersionInfoApi=false
  module config Pwm
    PwmChannelConfigSet
      PwmChannel_1 (PwmChannel):
        PwmChannelClass = PWM_VARIABLE_PERIOD
        PwmChannelId = 0
        PwmDutycycleDefault = 0
        PwmIdleState = PWM_LOW
        PwmArcticCoreChannelPrescaler = PWM_CHANNEL_PRESCALER_1
        PwmNotification = 
        PwmPeriodDefault = 0.0010
        PwmPolarity = PWM_LOW
    PwmConfigurationOfOptApiServices: PwmDeInitApi=false, PwmGetOutputState=false, PwmSetDutyCycle=true, PwmSetOutputToIdle=false, PwmSetPeriodAndDuty=true, PwmVersionInfoApi=false
    PwmGeneral: PwmDevErorDetect=false, PwmDutycycleUpdatedEndperiod=true, PwmIndex=1, PwmNotificationSupported=false, PwmPeriodUpdatedEndperiod=true
  module config Os
    OsOS:
      OsStackMonitoring = true
      OsStatus = EXTENDED
      OsUseGetServiceId = true
      OsUseParameterAccess = true
      OsUseResScheduler = true
      OsTickFrequency = 1000
      OsInterruptStackSize = 2048
      OsIdleStackSize = 512
      ArcCoreOsUseDebug = false
      ArcCoreOsDebugTask = false
      ArcCoreOsDebugAlarm = false
      ArcCoreOsDebugResource = false
      ArcCoreOsDebugScheduleTable = false
      ArcCoreOsDebugEvent = false
      OsHooks: OsErrorHook=true, OsPostTaskHook=true, OsPreTaskHook=true, OsProtectionHook=false, OsShutdownHook=true, OsStartupHook=true
    Startup_Task (OsTask): OsTaskActivation=1, OsTaskPriority=2, OsTaskProcessType=EXTENDED, ArcCoreOsTaskStackSize=2048, OsTaskSchedule=FULL
      OsTaskAutostart
    Mcal_Test_Task (OsTask): OsTaskActivation=1, OsTaskPriority=1, OsTaskProcessType=EXTENDED, ArcCoreOsTaskStackSize=2048, OsTaskSchedule=FULL
      OsTaskAutostart
    Counter1 (OsCounter): OsCounterMaxAllowedValue=65535, OsCounterMinCycle=1, OsCounterTicksPerBase=0, OsCounterType=OS_TICK
