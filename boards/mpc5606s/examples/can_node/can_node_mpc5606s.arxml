AUTOSAR XML (schema 3.1.4)
standard types defined: UInt8, UInt16, UInt32, SInt8, SInt16, SInt32
package /can_node_mpc5606s
  ecu configuration can_node_mpc5606s: ecu-sw-composition=SwComposition_can_node_mpc5606s, module=[Os, Mcu, Det, Port, Dio, EcuM, Can, CanIf, EcuC, Com, PduR]
  ecu sw composition SwComposition_can_node_mpc5606s
  module config Os
    OsOS:
      OsStackMonitoring = true
      OsStatus = EXTENDED
      OsUseGetServiceId = true
      OsUseParameterAccess = true
      OsUseResScheduler = true
      OsTickFrequency = 1000
      OsInterruptStackSize = 2048
      OsIdleStackSize = 512
      ArcCoreOsUseDebug = false
      ArcCoreOsDebugTask = false
      ArcCoreOsDebugAlarm = false
      ArcCoreOsDebugResource = false
      ArcCoreOsDebugScheduleTable = false
      ArcCoreOsDebugEvent = false
      OsHooks: OsErrorHook=true, OsPostTaskHook=true, OsPreTaskHook=true, OsProtectionHook=false, OsShutdownHook=true, OsStartupHook=true
    3 x OsAlarm, all with OsAlarmCounterRef=OsTick:
      alarm25
        OsAlarmActivateTask: OsAlarmActivateTaskRef=bTask25
      alarm10
        OsAlarmActivateTask: OsAlarmActivateTaskRef=bTask10
      alarm100
        OsAlarmActivateTask: OsAlarmActivateTaskRef=bTask100
    OsTick (OsCounter): OsCounterMaxAllowedValue=65535, OsCounterMinCycle=0, OsCounterTicksPerBase=0, OsCounterType=OS_TICK
    4 x OsTask, all with OsTaskActivation=1, OsTaskProcessType=BASIC, ArcCoreOsTaskStackSize=2048, OsTaskSchedule=FULL:
      bTask25: OsTaskPriority=1
      bTask100: OsTaskPriority=1
      bTask10: OsTaskPriority=1
      Startup: OsTaskPriority=2
        OsTaskAutostart
  module config Mcu
    McuGeneralConfiguration: McuDevErrorDetect=true, McuPerformResetApi=true, McuVersionInfoApi=true
    McuModuleConfiguration: McuClockSrcFailureNotification=DISABLED, McuNumberOfMcuModes=0, McuRamSectors=1, McuResetSetting=0
      McuClockSettingConfig: McuDefaultClockReference=EXT_REF_64MHZ
        EXT_REF_64MHZ (McuClockReferencePoint): McuClockReferencePointFrequency=8000000.0, McuClockReferencePointPllEprediv=0, McuClockReferencePointPllEmfd=64, McuClockReferencePointPllErfd=2
      McuModeSettingConf: McuMode=0
      RamSector_1 (McuRamSectorSettingConf): ArcMcuRamSectionBaseAddressSymbol=0, ArcMcuRamSectionSizeSymbol=0xff, McuRamDefaultValue=0, McuRamSectionBaseAddress=0, McuRamSectionSize=0
  module config Det
    DetGeneral: DetEnableCallbacks=false, DetUseRamlog=true, DetWrapRamlog=true, DetUseStdErr=false, DetDeInitAPI=false, DetNumberOfCallbacks=5, DetRamlogSize=16
  module config Port
    PortConfigSet
      LED_PORT (PortContainer)
        6 x PortPin, all with PortPinPullMode=PULL_NONE, PortPinDirectionChangeable=false, PortPinHysteresisEnabled=false, PortPinOpenDrainEnabled=false, PortPinSlewRate=SLEW_RATE_MIN:
          PE[4]: PortPinDirection=PORT_PIN_OUT, PortPinId=68, PortPinLevelValue=PORT_PIN_LEVEL_HIGH, PortPinMode=PORT_PIN_MODE_DIO
          PE[5]: PortPinDirection=PORT_PIN_OUT, PortPinId=69, PortPinLevelValue=PORT_PIN_LEVEL_HIGH, PortPinMode=PORT_PIN_MODE_DIO
          AN[28]: PortPinDirection=PORT_PIN_IN, PortPinId=16, PortPinLevelValue=PORT_PIN_LEVEL_LOW, PortPinMode=PORT_PIN_MODE_ADC
          AN[29]: PortPinDirection=PORT_PIN_IN, PortPinId=17, PortPinLevelValue=PORT_PIN_LEVEL_LOW, PortPinMode=PORT_PIN_MODE_ADC
          PB[8]: PortPinDirection=PORT_PIN_OUT, PortPinId=24, PortPinLevelValue=PORT_PIN_LEVEL_HIGH, PortPinMode=PORT_PIN_MODE_DIO
          PB[9]: PortPinDirection=PORT_PIN_OUT, PortPinId=25, PortPinLevelValue=PORT_PIN_LEVEL_HIGH, PortPinMode=PORT_PIN_MODE_DIO
    PortGeneral: PortDevErrorDetect=true, PortSetPinDirectionApi=true, PortSetPinModeApi=true, PortVersionInfoApi=true
  module config Dio
    DioGeneral: DioDevErrorDetect=true, DioVersionInfoApi=true
    DioPort_1 (DioPort): DioPortId=0, ArcCoreDioPhysicalPort=DIO_PORT_E
      DioChannel_1 (DioChannel): DioChannelId=68
      DioChannel_2 (DioChannel): DioChannelId=69
  module config EcuM
    EcuMGeneral: EcuMDevErrorDetect=true, EcuMIncludeNvramMgr=false, EcuMVersionInfoApi=true, EcuMMainFunctionPeriod=0.2
    EcuMConfiguration: EcuMNvramReadallTimeout=10.0, EcuMRunMinimumDuration=10.0, EcuMNvramWriteallTimeout=10.0
      EcuMUserConfig
  module config Can
    CanConfigSet
      Controller_A (CanController):
        CanControllerActivation = true
        CanControllerLoopback = false
        CanControllerBaudRate = 125
        CanHWControllerId = FLEXCAN_A
        CanControllerPropSeg = 4
        CanControllerSeg1 = 4
        CanControllerSeg2 = 4
        Mask_1 (CanFilterMask): CanFilterMaskValue=0
      HWObj_1 (CanHardwareObject): CanIdType=EXTENDED, CanObjectType=RECEIVE, CanMBMask=255, CanControllerRef=Controller_A, CanFilterMaskRef=Mask_1
      HWObj_2 (CanHardwareObject): CanIdType=EXTENDED, CanObjectType=TRANSMIT, CanMBMask=65280, CanControllerRef=Controller_A, CanFilterMaskRef=Mask_1
    CanGeneral: CanDevErrorDetection=true, CanMultiplexedTransmission=false, CanVersionInfoApi=true
  module config CanIf
    CanIfDispatchConfig: CanIfBusOffNotification=, CanIfErrorNotificaton=, CanIfWakeupNotification=, CanIfWakeupValidNotification=
    CanIfDriverConfig: CanIfBusoffNotification=true, CanIfReceiveIndication=false, CanIfTransmitCancellation=false, CanIfTxConfirmation=false, CanIfWakeupNotification=true
    CanIfInitConfiguration: CanIfConfigSet=, CanIfNumberOfCanRxPduIds=0, CanIfNumberOfCanTXPduIds=0, CanIfNumberOfDynamicCanTXPduIds=0
      Hoh_1 (CanIfInitHohConfig)
        Hrh_1 (CanIfHrhConfig): CanIfHrhType=BASIC_CAN, CanIfSoftwareFilterHrh=true, CanIfCanControllerHrhIdRef=Channel_1, CanIfHrhIdSymRef=HWObj_1
        Hth_1 (CanIfHthConfig): CanIfHthType=BASIC_CAN, CanIfCanControllerIdRef=Channel_1, CanIfHthIdSymRef=HWObj_2
      Rx_RxPdu1 (CanIfRxPduConfig):
        CanIfCanRxPduCanId = 257
        CanIfCanRxPduDlc = 8
        CanIfCanRxPduId = 0
        CanIfReadRxPduData = false
        CanIfReadRxPduNotifyStatus = false
        CanIfRxPduIdCanIdType = EXTENDED_CAN
        CanIfRxUserType = PDUR
        CanIfUserRxIndication = 
        CanIfCanRxPduHrhRef = Hrh_1
        PduIdRef = PduCollection/RxPdu1
      Rx_RxPdu2 (CanIfRxPduConfig):
        CanIfCanRxPduCanId = 258
        CanIfCanRxPduDlc = 8
        CanIfCanRxPduId = 0
        CanIfReadRxPduData = false
        CanIfReadRxPduNotifyStatus = false
        CanIfRxPduIdCanIdType = EXTENDED_CAN
        CanIfRxUserType = PDUR
        CanIfUserRxIndication = 
        CanIfCanRxPduHrhRef = Hrh_1
        PduIdRef = PduCollection/RxPdu2
      Tx_TxPdu1 (CanIfTxPduConfig):
        CanIfCanTxPduId = 0
        CanIfCanTxPduIdCanId = 513
        CanIfCanTxPduIdDlc = 8
        CanIfCanTxPduType = STATIC
        CanIfReadTxPduNotifyStatus = false
        CanIfTxPduIdCanIdType = EXTENDED_CAN
        CanIfTxUserType = PDUR
        CanIfUserTxConfirmation = 
        CanIfCanTxPduHthRef = Hth_1
        PduIdRef = PduCollection/TxPdu1
      Tx_TxPdu2 (CanIfTxPduConfig):
        CanIfCanTxPduId = 0
        CanIfCanTxPduIdCanId = 514
        CanIfCanTxPduIdDlc = 8
        CanIfCanTxPduType = STATIC
        CanIfReadTxPduNotifyStatus = false
        CanIfTxPduIdCanIdType = EXTENDED_CAN
        CanIfTxUserType = PDUR
        CanIfUserTxConfirmation = 
        CanIfCanTxPduHthRef = Hth_1
        PduIdRef = PduCollection/TxPdu2
    CanIfPrivateConfiguration: CanIfDlcCheck=true, CanIfNumberOfTxBuffers=0, CanIfSoftwareFilterType=
    CanIfPublicConfiguration:
      CanIfDevErrorDetect = false
      ArcCanIfDynamicPduConfiguration = false
      CanIfMultipleDriverSupport = true
      CanIfNumberOfCanHwUnits = 1
      CanIfReadRxPduDataApi = false
      CanIfReadRxPduNotifyStatusApi = false
      CanIfReadTxPduNotifyStatusApi = false
      CanIfSetDynamicTxIdApi = false
      CanIfVersionInfoApi = true
      CanIfWakeupEventApi = false
    Channel_1 (CanIfControllerConfig): CanIfWakeupSupport=NO_WAKEUP, CanIfControllerIdRef=Controller_A
  module config EcuC
    PduCollection
      4 x Pdu, all with PduLength=64:
        RxPdu1
        RxPdu2
        TxPdu1
        TxPdu2
  module config Com
    ComConfig: ComConfigurationId=0
      ComPduGroup (ComIPduGroup): ComIPduGroupHandleId=0
      4 x ComIPdu, all with ComIPduCallout=, ComIPduRxHandleId=0, ComIPduSignalProcessing=DEFERRED, ComIPduGroupRef=ComPduGroup:
        RxPdu1: ComIPduDirection=RECEIVE, PduIdRef=PduCollection/RxPdu1, ComIPduSignalRef=RxPdu1_Signal1
          ComTxIPdu: ComTxIPduMinimumDelayTimeFactor=0, ComTxIPduUnusedAreasDefault=0
            ComTxModeTrue
              ComTxMode: ComTxModeMode=DIRECT, ComTxModeNumberOfRepetitions=0, ComTxModeRepetitionPeriodFactor=0, ComTxModeTimeOffsetFactor=0, ComTxModeTimePeriodFactor=0
        RxPdu2: ComIPduDirection=RECEIVE, PduIdRef=PduCollection/RxPdu2, ComIPduSignalRef=RxPdu2_Signal1
          ComTxIPdu: ComTxIPduMinimumDelayTimeFactor=0, ComTxIPduUnusedAreasDefault=0
            ComTxModeTrue
              ComTxMode: ComTxModeMode=DIRECT, ComTxModeNumberOfRepetitions=0, ComTxModeRepetitionPeriodFactor=0, ComTxModeTimeOffsetFactor=0, ComTxModeTimePeriodFactor=0
        TxPdu1: ComIPduDirection=SEND, PduIdRef=PduCollection/TxPdu1, ComIPduSignalRef=TxPdu1_Signal1
          ComTxIPdu: ComTxIPduMinimumDelayTimeFactor=0, ComTxIPduUnusedAreasDefault=0
            ComTxModeTrue
              ComTxMode: ComTxModeMode=DIRECT, ComTxModeNumberOfRepetitions=0, ComTxModeRepetitionPeriodFactor=0, ComTxModeTimeOffsetFactor=0, ComTxModeTimePeriodFactor=0
        TxPdu2: ComIPduDirection=SEND, PduIdRef=PduCollection/TxPdu2, ComIPduSignalRef=TxPdu2_Signal1, ComIPduSignalGroupRef=TxPdu2_SignalGroup1
          ComTxIPdu: ComTxIPduMinimumDelayTimeFactor=0, ComTxIPduUnusedAreasDefault=0
            ComTxModeTrue
              ComTxMode: ComTxModeMode=DIRECT, ComTxModeNumberOfRepetitions=0, ComTxModeRepetitionPeriodFactor=0, ComTxModeTimeOffsetFactor=0, ComTxModeTimePeriodFactor=0
      4 x ComSignal, all with ComBitPosition=7, ComBitSize=16, ComFirstTimeoutFactor=0, ComHandleId=0, ComNotification=, ComSignalEndianess=BIG_ENDIAN, ComSignalInitValue=0, ComSignalLength=0, ComSignalType=UINT16, ComTimeoutFactor=0, ComTimeoutNotification=, ComTransferProperty=TRIGGERED:
        RxPdu1_Signal1
        RxPdu2_Signal1
        TxPdu1_Signal1
        TxPdu2_Signal1
      TxPdu2_SignalGroup1 (ComSignalGroup):
        ComBitPosition = 0
        ComBitSize = 0
        ComFirstTimeoutFactor = 0
        ComHandleId = 0
        ComNotification = 
        ComRxDataTimeoutAction = 
        ComTimeoutFactor = 0
        ComTimeoutNotification = 
        ComTransferProperty = PENDING
        TxPdu2_SignalGroup1_GroupSignal1 (ComGroupSignal): ComBitPosition=0, ComBitSize=0, ComHandleId=0, ComSignalEndianess=BIG_ENDIAN, ComSignalInitValue=0, ComSignalType=UINT8
    ComGeneral: ComConfigurationTimeBase=0.0, ComConfigurationUseDet=false
  module config PduR
    PduRGeneral:
      PduRCanIfSupport = true
      PduRCanTpSupport = false
      PduRComSupport = true
      PduRDcmSupport = false
      PduRDevErrorDetect = true
      PduRFifoTxBufferSupport = false
      PduRFrIfSupport = false
      PduRFrTpSupport = false
      PduRGatewayOperation = false
      PduRIPduMSupport = false
      PduRLinIfSupport = false
      PduRLinTpSupport = false
      PduRMemorySize = 0
      PduRMinimumRoutingLoModule = 
      PduRMinimumRoutingLoRxPduId = 0
      PduRMinimumRoutingLoTxPduId = 0
      PduRMinimumRoutingUpModule = 
      PduRMinimumRoutingUpRxPduId = 0
      PduRMinimumRoutingUpTxPduId = 0
      PduRMulticastFromIfSupport = false
      PduRMulticastFromTpSupport = false
      PduRMulticastToIfSupport = false
      PduRMulticastToTpSupport = false
      PduRSbTxBufferSupport = false
      PduRSingleIf = CAN_IF
      PduRSingleTp = CAN_TP
      PduRVersionInfoApi = true
      PduRZeroCostOperation = true
    PduRGlobalConfig: PduRConfigurationId=0
      PduRRoutingTable
package /can_node_mpc5606s/GeneratedSystemSignals
  4 x system signal, all with length=16:
    RxPdu1_Signal1: init-value=RxPdu1_Signal1InitValueLiteral
    RxPdu2_Signal1: init-value=RxPdu2_Signal1InitValueLiteral
    TxPdu1_Signal1: init-value=TxPdu1_Signal1InitValueLiteral
    TxPdu2_Signal1: init-value=TxPdu2_Signal1InitValueLiteral
package /can_node_mpc5606s/GeneratedSystemSignals/Data/IntegerLiterals
  4 x constant specification:
    RxPdu1_Signal1InitValue
      value:
        integer literal RxPdu1_Signal1InitValueLiteral: value=0
    RxPdu2_Signal1InitValue
      value:
        integer literal RxPdu2_Signal1InitValueLiteral: value=0
    TxPdu1_Signal1InitValue
      value:
        integer literal TxPdu1_Signal1InitValueLiteral: value=0
    TxPdu2_Signal1InitValue
      value:
        integer literal TxPdu2_Signal1InitValueLiteral: value=0
