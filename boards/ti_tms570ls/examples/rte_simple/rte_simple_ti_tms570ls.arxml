AUTOSAR XML (schema 3-1-5)
standard types defined: UInt8, UInt16, UInt32, SInt8, SInt16, SInt32
package /rte_simple_ti_tms570ls
  ecu configuration rte_simple_ti_tms570ls: ecu-extract=rte_simple_extract, ecu-sw-composition=SwComposition_rte_simple_ti_tms570ls, module=[Can, CanIf, Com, Det, EcuM, Mcu, Os, PduR, Port, Rte, EcuC, Dio]
  ecu sw composition SwComposition_rte_simple_ti_tms570ls: ecu-extract=rte_simple_extract
  module config Can
    CanConfigSet
      Controller_1 (CanController):
        CanControllerActivation = true
        CanControllerLoopback = false
        CanControllerBaudRate = 125
        CanHWControllerId = DCAN1
        CanControllerPropSeg = 5
        CanControllerSeg1 = 6
        CanControllerSeg2 = 5
        Mask_1 (CanFilterMask): CanFilterMaskValue=0
      HWObj_1 (CanHardwareObject): CanIdType=STANDARD, CanObjectType=RECEIVE, CanMBMask=1, CanControllerRef=Controller_1, CanFilterMaskRef=Mask_1
      HWObj_2 (CanHardwareObject): CanIdType=STANDARD, CanObjectType=TRANSMIT, CanMBMask=2, CanControllerRef=Controller_1, CanFilterMaskRef=Mask_1
    CanGeneral: CanDevErrorDetection=false, CanMultiplexedTransmission=false, CanVersionInfoApi=false
  module config CanIf
    CanIfDispatchConfig: CanIfBusOffNotification=, CanIfErrorNotificaton=, CanIfWakeupNotification=, CanIfWakeupValidNotification=
    CanIfDriverConfig: CanIfBusoffNotification=true, CanIfReceiveIndication=false, CanIfTransmitCancellation=false, CanIfTxConfirmation=false, CanIfWakeupNotification=true
    CanIfInitConfiguration: CanIfConfigSet=, CanIfNumberOfCanRxPduIds=0, CanIfNumberOfCanTXPduIds=0, CanIfNumberOfDynamicCanTXPduIds=0
      Hoh_1 (CanIfInitHohConfig)
        Hrh_1 (CanIfHrhConfig): CanIfHrhType=BASIC_CAN, CanIfSoftwareFilterHrh=true, CanIfCanControllerHrhIdRef=Channel_1, CanIfHrhIdSymRef=HWObj_1
        Hth_1 (CanIfHthConfig): CanIfHthType=BASIC_CAN, CanIfCanControllerIdRef=Channel_1, CanIfHthIdSymRef=HWObj_2
      Rx_RX_PDU (CanIfRxPduConfig):
        CanIfCanRxPduCanId = 1
        CanIfCanRxPduDlc = 8
        CanIfCanRxPduId = 0
        CanIfReadRxPduData = false
        CanIfReadRxPduNotifyStatus = false
        CanIfRxPduIdCanIdType = STANDARD_CAN
        CanIfRxUserType = PDUR
        CanIfUserRxIndication = 
        CanIfCanRxPduHrhRef = Hrh_1
        PduIdRef = PduCollection/RX_PDU
      Tx_TX_PDU (CanIfTxPduConfig):
        CanIfCanTxPduId = 0
        CanIfCanTxPduIdCanId = 2
        CanIfCanTxPduIdDlc = 8
        CanIfCanTxPduType = STATIC
        CanIfReadTxPduNotifyStatus = false
        CanIfTxPduIdCanIdType = STANDARD_CAN
        CanIfTxUserType = PDUR
        CanIfUserTxConfirmation = 
        CanIfCanTxPduHthRef = Hth_1
        PduIdRef = PduCollection/TX_PDU
      Rx_FreqReq (CanIfRxPduConfig):
        CanIfCanRxPduCanId = 256
        CanIfCanRxPduDlc = 8
        CanIfCanRxPduId = 0
        CanIfReadRxPduData = false
        CanIfReadRxPduNotifyStatus = false
        CanIfRxPduIdCanIdType = STANDARD_CAN
        CanIfRxUserType = PDUR
        CanIfUserRxIndication = 
        CanIfCanRxPduHrhRef = Hrh_1
        PduIdRef = PduCollection/FreqReq
      Tx_FreqInd (CanIfTxPduConfig):
        CanIfCanTxPduId = 0
        CanIfCanTxPduIdCanId = 258
        CanIfCanTxPduIdDlc = 8
        CanIfCanTxPduType = STATIC
        CanIfReadTxPduNotifyStatus = false
        CanIfTxPduIdCanIdType = STANDARD_CAN
        CanIfTxUserType = PDUR
        CanIfUserTxConfirmation = 
        CanIfCanTxPduHthRef = Hth_1
        PduIdRef = PduCollection/FreqInd
    CanIfPrivateConfiguration: CanIfDlcCheck=true, CanIfNumberOfTxBuffers=0, CanIfSoftwareFilterType=
    CanIfPublicConfiguration:
      CanIfDevErrorDetect = false
      ArcCanIfDynamicPduConfiguration = false
      CanIfMultipleDriverSupport = true
      CanIfNumberOfCanHwUnits = 1
      CanIfReadRxPduDataApi = false
      CanIfReadRxPduNotifyStatusApi = false
      CanIfReadTxPduNotifyStatusApi = false
      CanIfSetDynamicTxIdApi = false
      CanIfVersionInfoApi = true
      CanIfWakeupEventApi = false
    Channel_1 (CanIfControllerConfig): CanIfWakeupSupport=NO_WAKEUP, CanIfControllerIdRef=Controller_1
  module config Com
    ComConfig: ComConfigurationId=0
      ComPduGroup (ComIPduGroup): ComIPduGroupHandleId=0
      RX_PDU (ComIPdu):
        ComIPduCallout = 
        ComIPduRxHandleId = 0
        ComIPduSignalProcessing = DEFERRED
        ComIPduDirection = RECEIVE
        ComIPduGroupRef = ComPduGroup
        PduIdRef = PduCollection/RX_PDU
        ComIPduSignalRef = Arg1
        ComIPduSignalRef = Arg2
        ComTxIPdu: ComTxIPduMinimumDelayTimeFactor=0, ComTxIPduUnusedAreasDefault=0
          ComTxModeTrue
            ComTxMode: ComTxModeMode=DIRECT, ComTxModeNumberOfRepetitions=0, ComTxModeRepetitionPeriodFactor=0, ComTxModeTimeOffsetFactor=0, ComTxModeTimePeriodFactor=0
      TX_PDU (ComIPdu):
        ComIPduCallout = 
        ComIPduRxHandleId = 0
        ComIPduSignalProcessing = DEFERRED
        ComIPduDirection = SEND
        ComIPduGroupRef = ComPduGroup
        PduIdRef = PduCollection/TX_PDU
        ComIPduSignalRef = ResultSig
        ComTxIPdu: ComTxIPduMinimumDelayTimeFactor=0, ComTxIPduUnusedAreasDefault=0
          ComTxModeTrue
            ComTxMode: ComTxModeMode=DIRECT, ComTxModeNumberOfRepetitions=0, ComTxModeRepetitionPeriodFactor=0, ComTxModeTimeOffsetFactor=0, ComTxModeTimePeriodFactor=0
      3 x ComSignal, all with ComBitSize=8, ComFirstTimeoutFactor=0, ComHandleId=0, ComNotification=, ComSignalEndianess=BIG_ENDIAN, ComSignalLength=0, ComSignalType=UINT8, ComTimeoutFactor=0, ComTimeoutNotification=:
        Arg1: ComBitPosition=7, ComSignalInitValue=5, ComTransferProperty=PENDING
        ResultSig: ComBitPosition=7, ComSignalInitValue=0, ComTransferProperty=TRIGGERED
        Arg2: ComBitPosition=15, ComSignalInitValue=3, ComTransferProperty=PENDING
      FreqReq (ComIPdu):
        ComIPduCallout = 
        ComIPduRxHandleId = 0
        ComIPduSignalProcessing = DEFERRED
        ComIPduDirection = RECEIVE
        ComIPduGroupRef = ComPduGroup
        PduIdRef = PduCollection/FreqReq
        ComIPduSignalRef = FreqReqSig
        ComTxIPdu: ComTxIPduMinimumDelayTimeFactor=0, ComTxIPduUnusedAreasDefault=0
          ComTxModeTrue
            ComTxMode: ComTxModeMode=DIRECT, ComTxModeNumberOfRepetitions=0, ComTxModeRepetitionPeriodFactor=0, ComTxModeTimeOffsetFactor=0, ComTxModeTimePeriodFactor=0
      FreqInd (ComIPdu):
        ComIPduCallout = 
        ComIPduRxHandleId = 0
        ComIPduSignalProcessing = DEFERRED
        ComIPduDirection = SEND
        ComIPduGroupRef = ComPduGroup
        PduIdRef = PduCollection/FreqInd
        ComIPduSignalRef = FreqIndSig
        ComTxIPdu: ComTxIPduMinimumDelayTimeFactor=0, ComTxIPduUnusedAreasDefault=0
          ComTxModeTrue
            ComTxMode: ComTxModeMode=DIRECT, ComTxModeNumberOfRepetitions=0, ComTxModeRepetitionPeriodFactor=0, ComTxModeTimeOffsetFactor=0, ComTxModeTimePeriodFactor=0
      FreqIndSig (ComSignal):
        ComBitPosition = 7
        ComBitSize = 32
        ComFirstTimeoutFactor = 0
        ComHandleId = 0
        ComNotification = 
        ComSignalEndianess = BIG_ENDIAN
        ComSignalInitValue = 0
        ComSignalLength = 0
        ComSignalType = UINT32
        ComTimeoutFactor = 0
        ComTimeoutNotification = 
        ComTransferProperty = TRIGGERED
      FreqReqSig (ComSignal):
        ComBitPosition = 7
        ComBitSize = 32
        ComFirstTimeoutFactor = 0
        ComHandleId = 0
        ComNotification = Rte_COMCbk_FreqReqSig
        ComSignalEndianess = BIG_ENDIAN
        ComSignalInitValue = 1000
        ComSignalLength = 0
        ComSignalType = UINT32
        ComTimeoutFactor = 0
        ComTimeoutNotification = 
        ComTransferProperty = PENDING
    ComGeneral: ComConfigurationTimeBase=0.0, ComConfigurationUseDet=true, ArcComBitPositionVersionAutosar4=false
  module config Det
    DetGeneral: DetEnableCallbacks=false, DetUseRamlog=true, DetWrapRamlog=true, DetUseStdErr=false, DetDeInitAPI=false, DetNumberOfCallbacks=5, DetRamlogSize=16
  module config EcuM
    EcuMGeneral: EcuMDevErrorDetect=false, EcuMIncludeNvramMgr=false, EcuMVersionInfoApi=false, EcuMMainFunctionPeriod=0.2
    EcuMConfiguration: EcuMNvramReadallTimeout=10.0, EcuMRunMinimumDuration=10.0, EcuMNvramWriteallTimeout=10.0
      User_1 (EcuMUserConfig)
  module config Mcu
    McuGeneralConfiguration: McuDevErrorDetect=false, McuPerformResetApi=true, McuVersionInfoApi=true
    McuModuleConfiguration: McuClockSrcFailureNotification=DISABLED, McuNumberOfMcuModes=0, McuRamSectors=1, McuResetSetting=0
      McuClockSettingConfig: McuDefaultClockReference=Clock
        Clock (McuClockReferencePoint):
          McuClockReferencePointFrequency = 1.6E7
          McuClockReferencePointRefClkDiv = 4
          McuClockReferencePointPllMult = 100
          McuClockReferencePointOdPll = 2
          McuClockReferencePointPllDiv = 2
      McuModeSettingConf: McuMode=0
  module config Os
    OsOS:
      OsStackMonitoring = true
      OsStatus = EXTENDED
      OsUseGetServiceId = true
      OsUseParameterAccess = true
      OsUseResScheduler = true
      OsTickFrequency = 1000
      OsInterruptStackSize = 2048
      OsIdleStackSize = 512
      OsNumberOfCores = 1
      ArcOsIsrMaxCount = 10
      ArcCoreOsUseDebug = false
      ArcCoreOsDebugTask = false
      ArcCoreOsDebugAlarm = false
      ArcCoreOsDebugResource = false
      ArcCoreOsDebugScheduleTable = false
      ArcCoreOsDebugEvent = false
      OsHooks: OsErrorHook=true, OsPostTaskHook=true, OsPreTaskHook=true, OsProtectionHook=false, OsShutdownHook=true, OsStartupHook=true
    StartupTask (OsTask): OsTaskActivation=1, OsTaskPriority=10, OsTaskProcessType=BASIC, ArcCoreOsTaskStackSize=2048, OsTaskSchedule=FULL
      OsTaskAutostart
    StepTask (OsTask): OsTaskActivation=1, OsTaskPriority=1, OsTaskProcessType=EXTENDED, ArcCoreOsTaskStackSize=2048, OsTaskSchedule=FULL, OsTaskEventRef=StepEvent
      OsTaskAutostart
    StepAlarm (OsAlarm): OsAlarmCounterRef=Counter1
      OsAlarmAutostart: OsAlarmAlarmTime=20, OsAlarmAutostartType=ABSOLUTE, OsAlarmCycleTime=100
      OsAlarmSetEvent: OsAlarmSetEventRef=StepEvent, OsAlarmSetEventTaskRef=StepTask
    Counter1 (OsCounter): OsCounterMaxAllowedValue=65535, OsCounterMinCycle=1, OsCounterTicksPerBase=0, OsCounterType=OS_TICK
    OsApplication1 (OsApplication):
      ArcOsAppCoreId = 0
      OsTrusted = false
      OsAppAlarmRef = StepAlarm
      OsAppCounterRef = Counter1
      OsAppTaskRef = StartupTask
      OsAppTaskRef = StepTask
      OsAppAlarmRef = MainFunctionAlarm
      OsAppTaskRef = MainFunctionTask
      OsAppAlarmRef = BlinkerAlarm
      OsAppTaskRef = BlinkerTask
      OsApplicationHooks: OsAppErrorHook=false, OsAppShutdownHook=false, OsAppStartupHook=false
    StepEvent (OsEvent): ArcOsEventId=0, ArcOsEventAutoMask=true
    MainFunctionTask (OsTask): OsTaskActivation=1, OsTaskPriority=1, OsTaskProcessType=BASIC, ArcCoreOsTaskStackSize=2048, OsTaskSchedule=FULL
    MainFunctionAlarm (OsAlarm): OsAlarmCounterRef=Counter1
      OsAlarmAutostart: OsAlarmAlarmTime=10, OsAlarmAutostartType=ABSOLUTE, OsAlarmCycleTime=10
      OsAlarmActivateTask: OsAlarmActivateTaskRef=MainFunctionTask
    BlinkerTask (OsTask): OsTaskActivation=1, OsTaskPriority=1, OsTaskProcessType=BASIC, ArcCoreOsTaskStackSize=2048, OsTaskSchedule=FULL
    BlinkerAlarm (OsAlarm): OsAlarmCounterRef=Counter1
      OsAlarmAutostart: OsAlarmAlarmTime=100, OsAlarmAutostartType=ABSOLUTE, OsAlarmCycleTime=1000
      OsAlarmActivateTask: OsAlarmActivateTaskRef=BlinkerTask
  module config PduR
    PduRGeneral:
      PduRCanIfSupport = true
      PduRCanTpSupport = false
      PduRComSupport = true
      PduRDcmSupport = false
      ArcPduRSoAdSupport = false
      PduRDevErrorDetect = false
      PduRFifoTxBufferSupport = false
      PduRFrIfSupport = false
      PduRFrTpSupport = false
      PduRGatewayOperation = false
      PduRIPduMSupport = false
      PduRLinIfSupport = false
      PduRLinTpSupport = false
      PduRMemorySize = 0
      PduRMinimumRoutingLoModule = 
      PduRMinimumRoutingLoRxPduId = 0
      PduRMinimumRoutingLoTxPduId = 0
      PduRMinimumRoutingUpModule = 
      PduRMinimumRoutingUpRxPduId = 0
      PduRMinimumRoutingUpTxPduId = 0
      PduRMulticastFromIfSupport = false
      PduRMulticastFromTpSupport = false
      PduRMulticastToIfSupport = false
      PduRMulticastToTpSupport = false
      PduRSbTxBufferSupport = false
      PduRVersionInfoApi = false
      PduRZeroCostOperation = false
      ArcPduRJ1939TpSupport = false
    PduRGlobalConfig: PduRConfigurationId=0
      PduRRoutingTable
        4 x PduRRoutingPath, all with SduLength=0, TpChunkSize=0:
          RX_PDU
            PduRDestination (PduRDestPdu): DestPduRef=PduCollection/RX_PDU
            PduRSrcPdu: HandleId=0, SrcPduRef=PduCollection/RX_PDU
          TX_PDU
            PduRDestination (PduRDestPdu): DestPduRef=PduCollection/TX_PDU
            PduRSrcPdu: HandleId=0, SrcPduRef=PduCollection/TX_PDU
          FreqReq
            PduRDestination (PduRDestPdu): DestPduRef=PduCollection/FreqReq
            PduRSrcPdu: HandleId=0, SrcPduRef=PduCollection/FreqReq
          FreqInd
            PduRDestination (PduRDestPdu): DestPduRef=PduCollection/FreqInd
            PduRSrcPdu: HandleId=0, SrcPduRef=PduCollection/FreqInd
      PduRTpBufferTable: PduRMaxTpBufferNumber=0
  module config Port
    PortConfigSet
      CanPorts (PortContainer)
        DCAN1_TX (PortPin):
          PortPinPullMode = PULL_NONE
          PortPinDirection = PORT_PIN_OUT
          PortPinDirectionChangeable = false
          PortPinHysteresisEnabled = false
          PortPinOpenDrainEnabled = false
          PortPinId = 106
          PortPinSlewRate = SLEW_RATE_MIN
          PortPinLevelValue = PORT_PIN_LEVEL_LOW
          PortPinMode = PORT_PIN_MODE_CAN
        DCAN1_RX (PortPin):
          PortPinPullMode = PULL_NONE
          PortPinDirection = PORT_PIN_IN
          PortPinDirectionChangeable = false
          PortPinHysteresisEnabled = false
          PortPinOpenDrainEnabled = false
          PortPinId = 107
          PortPinSlewRate = SLEW_RATE_MIN
          PortPinLevelValue = PORT_PIN_LEVEL_LOW
          PortPinMode = PORT_PIN_MODE_CAN
      DioPorts (PortContainer)
        GIOA[3] (PortPin):
          PortPinPullMode = PULL_NONE
          PortPinDirection = PORT_PIN_OUT
          PortPinDirectionChangeable = false
          PortPinHysteresisEnabled = false
          PortPinOpenDrainEnabled = false
          PortPinId = 3
          PortPinSlewRate = SLEW_RATE_MIN
          PortPinLevelValue = PORT_PIN_LEVEL_LOW
          PortPinMode = PORT_PIN_MODE_DIO
    PortGeneral: PortDevErrorDetect=false, PortSetPinDirectionApi=false, PortSetPinModeApi=false, PortVersionInfoApi=false
  module config Rte
    RteGeneration:
      RteCalibrationSupport = NONE
      ArcGenerateWeakRunnableStubs = false
      ArcCalibrationFlashStartAddress = 0
      RteGenerationMode = 
      RteMeasurementSupport = false
      RteOptimizationMode = 
      RteVfbTrace = 0
      RteVfbTraceFunction = 
    4 x SwComponentInstance, all with ArcGenerationEnabled=true:
      Calculator_prototypeInstance: ImplementationRef=CalculatorImplementation, SoftwareComponentInstanceRef=Calculator_prototype
        Multiply_RunnableMapping (RunnableEntityMapping): ActivationOffset=0.0, PositionInTask=0, RTEEventRef=InvokeCalculator
      Tester_prototypeInstance: ImplementationRef=TesterImplementation, SoftwareComponentInstanceRef=Tester_prototype
        TesterRunnable_RunnableMapping (RunnableEntityMapping): ActivationOffset=0.0, PositionInTask=0, RTEEventRef=StepTester, MappedToTaskRef=StepTask, UsedOsEventRef=StepEvent
        FreqReqRunnable_RunnableMapping (RunnableEntityMapping): ActivationOffset=0.0, PositionInTask=0, RTEEventRef=RecFreqReq
      Logger_prototypeInstance: ImplementationRef=LoggerImplementation, SoftwareComponentInstanceRef=Logger_prototype
        LoggerRunnable_RunnableMapping (RunnableEntityMapping): ActivationOffset=0.0, PositionInTask=2, RTEEventRef=StepLogger, MappedToTaskRef=StepTask, UsedOsEventRef=StepEvent
      Logger2_prototypeInstance: ImplementationRef=Logger2Implementation, SoftwareComponentInstanceRef=Logger2_prototype
        Logger2Runnable_RunnableMapping (RunnableEntityMapping): ActivationOffset=0.0, PositionInTask=1, RTEEventRef=StepLogger2, MappedToTaskRef=StepTask, UsedOsEventRef=StepEvent
  module config EcuC
    PduCollection
      4 x Pdu, all with PduLength=64:
        RX_PDU
        TX_PDU
        FreqReq
        FreqInd
  module config Dio
    DioGeneral: DioDevErrorDetect=false, DioVersionInfoApi=false
    LED_PORT (DioPort): DioPortId=0, ArcCoreDioPhysicalPort=DIO_PORT_A
      LED_CHANNEL (DioChannel): DioChannelId=3
package /rte_simple_ti_tms570ls/GeneratedSystemSignals
  5 x system signal:
    Arg1: init-value=Arg1InitValueLiteral, length=8
    ResultSig: init-value=ResultSigInitValueLiteral, length=8
    Arg2: init-value=Arg2InitValueLiteral, length=8
    FreqIndSig: init-value=FreqIndSigInitValueLiteral, length=32
    FreqReqSig: init-value=FreqReqSigInitValueLiteral, length=32
package /rte_simple_ti_tms570ls/GeneratedSystemSignals/Data/IntegerLiterals
  5 x constant specification:
    Arg1InitValue
      value:
        integer literal Arg1InitValueLiteral: value=5
    ResultSigInitValue
      value:
        integer literal ResultSigInitValueLiteral: value=0
    Arg2InitValue
      value:
        integer literal Arg2InitValueLiteral: value=3
    FreqIndSigInitValue
      value:
        integer literal FreqIndSigInitValueLiteral: value=0
    FreqReqSigInitValue
      value:
        integer literal FreqReqSigInitValueLiteral: value=1000
