AUTOSAR XML (schema 3-1-5)
standard types defined: UInt8, UInt16, UInt32, SInt8, SInt16, SInt32
package /blinker_hcs12_card12
  ecu configuration blinker_hcs12_card12: ecu-sw-composition=SwComposition_blinker_hcs12_card12, module=[Can, CanIf, Com, EcuM, Dio, Det, Os, Port, PduR, Mcu, EcuC]
  ecu sw composition SwComposition_blinker_hcs12_card12
  module config Can
    CanConfigSet
      CAN0 (CanController):
        CanControllerActivation = false
        CanControllerLoopback = false
        CanControllerBaudRate = 125
        CanHWControllerId = CAN_CTRL_0
        CanControllerPropSeg = 0
        CanControllerSeg1 = 12
        CanControllerSeg2 = 1
        Mask (CanFilterMask): ArcCanHcs12IdamMaskType=CAN_ARC_IDAM_2_32BIT, ArcCanHcs12ArcIdmrValue=18446744073709551615, ArcCanHcs12ArcIdarValue=0
      TxBox (CanHardwareObject): CanIdType=STANDARD, CanObjectType=TRANSMIT, CanMBMask=0, CanControllerRef=CAN0, CanFilterMaskRef=Mask
      RxBox (CanHardwareObject): CanIdType=STANDARD, CanObjectType=RECEIVE, CanMBMask=0, CanControllerRef=CAN0, CanFilterMaskRef=Mask
    CanGeneral: CanDevErrorDetection=false, CanMultiplexedTransmission=false, CanVersionInfoApi=false
  module config CanIf
    CanIfDispatchConfig: CanIfBusOffNotification=, CanIfErrorNotificaton=, CanIfWakeupNotification=, CanIfWakeupValidNotification=
    CanIfDriverConfig: CanIfBusoffNotification=true, CanIfReceiveIndication=false, CanIfTransmitCancellation=false, CanIfTxConfirmation=false, CanIfWakeupNotification=true
    CanIfInitConfiguration: CanIfConfigSet=, CanIfNumberOfCanRxPduIds=0, CanIfNumberOfCanTXPduIds=0, CanIfNumberOfDynamicCanTXPduIds=0
      HardwareObject (CanIfInitHohConfig)
        RxBox (CanIfHrhConfig): CanIfHrhType=BASIC_CAN, CanIfSoftwareFilterHrh=true, CanIfCanControllerHrhIdRef=Channel0, CanIfHrhIdSymRef=CanConfigSet/RxBox
        TxBox (CanIfHthConfig): CanIfHthType=BASIC_CAN, CanIfCanControllerIdRef=Channel0, CanIfHthIdSymRef=CanConfigSet/TxBox
      Rx_FreqReq (CanIfRxPduConfig):
        CanIfCanRxPduCanId = 256
        CanIfCanRxPduDlc = 8
        CanIfCanRxPduId = 0
        CanIfReadRxPduData = false
        CanIfReadRxPduNotifyStatus = false
        CanIfRxPduIdCanIdType = STANDARD_CAN
        CanIfRxUserType = PDUR
        CanIfUserRxIndication = 
        CanIfCanRxPduHrhRef = HardwareObject/RxBox
        PduIdRef = PduCollection/FreqReq
      Tx_FreqInd (CanIfTxPduConfig):
        CanIfCanTxPduId = 0
        CanIfCanTxPduIdCanId = 258
        CanIfCanTxPduIdDlc = 8
        CanIfCanTxPduType = STATIC
        CanIfReadTxPduNotifyStatus = false
        CanIfTxPduIdCanIdType = STANDARD_CAN
        CanIfTxUserType = PDUR
        CanIfUserTxConfirmation = 
        CanIfCanTxPduHthRef = HardwareObject/TxBox
        PduIdRef = PduCollection/FreqInd
    CanIfPrivateConfiguration: CanIfDlcCheck=true, CanIfNumberOfTxBuffers=0, CanIfSoftwareFilterType=TABLE
    CanIfPublicConfiguration:
      CanIfDevErrorDetect = false
      ArcCanIfDynamicPduConfiguration = false
      CanIfMultipleDriverSupport = true
      CanIfNumberOfCanHwUnits = 1
      CanIfReadRxPduDataApi = false
      CanIfReadRxPduNotifyStatusApi = false
      CanIfReadTxPduNotifyStatusApi = false
      CanIfSetDynamicTxIdApi = false
      CanIfVersionInfoApi = true
      CanIfWakeupEventApi = false
    Channel0 (CanIfControllerConfig): CanIfWakeupSupport=NO_WAKEUP, CanIfControllerIdRef=CAN0
  module config Com
    ComConfig: ComConfigurationId=0
      ComPduGroup (ComIPduGroup): ComIPduGroupHandleId=0
      FreqReq (ComIPdu):
        ComIPduCallout = 
        ComIPduRxHandleId = 0
        ComIPduSignalProcessing = DEFERRED
        ComIPduDirection = RECEIVE
        ComIPduGroupRef = ComPduGroup
        PduIdRef = PduCollection/FreqReq
        ComIPduSignalRef = FreqReqSig
        ComTxIPdu: ComTxIPduMinimumDelayTimeFactor=0, ComTxIPduUnusedAreasDefault=0
          ComTxModeTrue
            ComTxMode: ComTxModeMode=DIRECT, ComTxModeNumberOfRepetitions=0, ComTxModeRepetitionPeriodFactor=0, ComTxModeTimeOffsetFactor=0, ComTxModeTimePeriodFactor=0
      FreqInd (ComIPdu):
        ComIPduCallout = 
        ComIPduRxHandleId = 0
        ComIPduSignalProcessing = DEFERRED
        ComIPduDirection = SEND
        ComIPduGroupRef = ComPduGroup
        PduIdRef = PduCollection/FreqInd
        ComIPduSignalRef = FreqIndSig
        ComTxIPdu: ComTxIPduMinimumDelayTimeFactor=0, ComTxIPduUnusedAreasDefault=0
          ComTxModeTrue
            ComTxMode: ComTxModeMode=PERIODIC, ComTxModeNumberOfRepetitions=0, ComTxModeRepetitionPeriodFactor=0, ComTxModeTimeOffsetFactor=0, ComTxModeTimePeriodFactor=10
      FreqIndSig (ComSignal):
        ComBitPosition = 7
        ComBitSize = 32
        ComFirstTimeoutFactor = 0
        ComHandleId = 0
        ComNotification = 
        ComSignalEndianess = BIG_ENDIAN
        ComSignalInitValue = 0
        ComSignalLength = 0
        ComSignalType = UINT32
        ComTimeoutFactor = 0
        ComTimeoutNotification = 
        ComTransferProperty = PENDING
        ComRxDataTimeoutAction = NONE
      FreqReqSig (ComSignal):
        ComBitPosition = 7
        ComBitSize = 32
        ComFirstTimeoutFactor = 0
        ComHandleId = 0
        ComNotification = IncommingFreqReq
        ComSignalEndianess = BIG_ENDIAN
        ComSignalInitValue = 1000
        ComSignalLength = 0
        ComSignalType = UINT32
        ComTimeoutFactor = 0
        ComTimeoutNotification = 
        ComTransferProperty = PENDING
        ComRxDataTimeoutAction = NONE
    ComGeneral: ComConfigurationTimeBase=0.0, ComConfigurationUseDet=false, ArcComBitPositionVersionAutosar4=false
  module config EcuM
    EcuMGeneral: EcuMDevErrorDetect=false, EcuMIncludeNvramMgr=false, EcuMVersionInfoApi=false, EcuMMainFunctionPeriod=0.2
    EcuMConfiguration: EcuMNvramReadallTimeout=10.0, EcuMRunMinimumDuration=10.0, EcuMNvramWriteallTimeout=10.0
      User_1 (EcuMUserConfig)
      EcuMDefaultShutdownTarget: EcuMDefaultState=EcuMStateReset, EcuMDefaultSleepModeRef=(unset)
      EcuMSleepMode: EcuMSleepModeId=0, EcuMSleepModeSuspend=false, EcuMSleepModeMcuModeRef=McuModeSettingConf, EcuMWakeupSourceMask=EcuMWakeupSource
      EcuMWakeupSource: EcuMResetReason=0, EcuMValidationTimeout=0.0, EcuMWakeupSourceId=0, EcuMWakeupSourcePolling=false
  module config Dio
    DioGeneral: DioDevErrorDetect=false, DioVersionInfoApi=false
    HPort (DioPort): DioPortId=0, ArcCoreDioPhysicalPort=DIO_PORT_H
      LED_CHANNEL (DioChannel): DioChannelId=31
  module config Det
    DetGeneral: DetEnableCallbacks=false, DetUseRamlog=true, DetWrapRamlog=true, DetUseStdErr=false, DetDeInitAPI=false, DetNumberOfCallbacks=5, DetRamlogSize=16
  module config Os
    OsOS:
      OsStackMonitoring = true
      OsStatus = EXTENDED
      OsUseGetServiceId = true
      OsUseParameterAccess = true
      OsUseResScheduler = true
      OsTickFrequency = 1000
      OsInterruptStackSize = 512
      OsIdleStackSize = 512
      OsNumberOfCores = 1
      ArcOsIsrMaxCount = 10
      ArcCoreOsUseDebug = false
      ArcCoreOsDebugTask = false
      ArcCoreOsDebugAlarm = false
      ArcCoreOsDebugResource = false
      ArcCoreOsDebugScheduleTable = false
      ArcCoreOsDebugEvent = false
      OsHooks: OsErrorHook=true, OsPostTaskHook=false, OsPreTaskHook=false, OsProtectionHook=false, OsShutdownHook=false, OsStartupHook=false
    MainAlarm (OsAlarm): OsAlarmCounterRef=MainCounter
      OsAlarmActivateTask: OsAlarmActivateTaskRef=BlinkerTask
      OsAlarmAutostart: OsAlarmAlarmTime=1, OsAlarmAutostartType=ABSOLUTE, OsAlarmCycleTime=100
    MainCounter (OsCounter): OsCounterMaxAllowedValue=65535, OsCounterMinCycle=1, OsCounterTicksPerBase=0, OsCounterType=OS_TICK
    MainApplication (OsApplication):
      ArcOsAppCoreId = 0
      OsTrusted = false
      OsAppAlarmRef = MainAlarm
      OsAppCounterRef = MainCounter
      OsAppTaskRef = BlinkerTask
      OsAppTaskRef = ComTask
      OsAppTaskRef = ComReceiveTask
      OsAppAlarmRef = ComAlarm
      OsAppTaskRef = StartTask
      OsApplicationHooks: OsAppErrorHook=false, OsAppShutdownHook=false, OsAppStartupHook=false
    3 x OsTask, all with OsTaskActivation=1, ArcCoreOsTaskStackSize=512, OsTaskSchedule=FULL:
      BlinkerTask: OsTaskPriority=1, OsTaskProcessType=BASIC
      ComTask: OsTaskPriority=4, OsTaskProcessType=BASIC
      ComReceiveTask: OsTaskPriority=1, OsTaskProcessType=EXTENDED, OsTaskEventRef=FreqReciveEvent
        OsTaskAutostart
    FreqReciveEvent (OsEvent): ArcOsEventId=0, ArcOsEventAutoMask=true
    ComAlarm (OsAlarm): OsAlarmCounterRef=MainCounter
      OsAlarmAutostart: OsAlarmAlarmTime=50, OsAlarmAutostartType=ABSOLUTE, OsAlarmCycleTime=100
      OsAlarmActivateTask: OsAlarmActivateTaskRef=ComTask
    StartTask (OsTask): OsTaskActivation=1, OsTaskPriority=1, OsTaskProcessType=BASIC, ArcCoreOsTaskStackSize=512, OsTaskSchedule=FULL
      OsTaskAutostart
  module config Port
    PortConfigSet
      DIO_Container (PortContainer)
        PH7 (PortPin):
          PortPinPullMode = PULL_NONE
          PortPinDirection = PORT_PIN_OUT
          PortPinDirectionChangeable = false
          PortPinHysteresisEnabled = false
          PortPinOpenDrainEnabled = false
          ArcReducedDrive = false
          ArcPortPinName = PH7
          PortPinId = 31
          PortPinLevelValue = PORT_PIN_LEVEL_LOW
          PortPinMode = 
    PortGeneral: PortDevErrorDetect=false, PortSetPinDirectionApi=false, PortSetPinModeApi=false, PortVersionInfoApi=false
  module config PduR
    PduRGeneral:
      PduRCanIfSupport = true
      PduRCanTpSupport = false
      PduRComSupport = true
      PduRDcmSupport = false
      ArcPduRSoAdSupport = false
      PduRDevErrorDetect = false
      PduRFifoTxBufferSupport = false
      PduRFrIfSupport = false
      PduRFrTpSupport = false
      PduRGatewayOperation = false
      PduRIPduMSupport = false
      PduRLinIfSupport = false
      PduRLinTpSupport = false
      PduRMemorySize = 0
      PduRMinimumRoutingLoModule = 
      PduRMinimumRoutingLoRxPduId = 0
      PduRMinimumRoutingLoTxPduId = 0
      PduRMinimumRoutingUpModule = 
      PduRMinimumRoutingUpRxPduId = 0
      PduRMinimumRoutingUpTxPduId = 0
      PduRMulticastFromIfSupport = false
      PduRMulticastFromTpSupport = false
      PduRMulticastToIfSupport = false
      PduRMulticastToTpSupport = false
      PduRSbTxBufferSupport = false
      PduRSingleIf = CAN_IF
      PduRSingleTp = CAN_TP
      PduRVersionInfoApi = false
      PduRZeroCostOperation = true
      ArcPduRJ1939TpSupport = false
    PduRGlobalConfig: PduRConfigurationId=0
      PduRRoutingTable
      PduRTpBufferTable: PduRMaxTpBufferNumber=0
  module config Mcu
    McuGeneralConfiguration: McuDevErrorDetect=false, McuPerformResetApi=false, McuVersionInfoApi=true
    McuModuleConfiguration: McuClockSrcFailureNotification=DISABLED, McuNumberOfMcuModes=0, McuRamSectors=1, McuResetSetting=0
      McuClockSettingConfig: McuDefaultClockReference=EXT_REF_16MHZ
        EXT_REF_16MHZ (McuClockReferencePoint): McuClockReferencePointFrequency=1.6E7, McuClockReferencePointPllClock=48000000
      McuModeSettingConf: McuMode=0
  module config EcuC
    PduCollection
      FreqReq (Pdu): PduLength=64
      FreqInd (Pdu): PduLength=64
package /blinker_hcs12_card12/GeneratedSystemSignals
  system signal FreqIndSig: init-value=FreqIndSigInitValueLiteral, length=32
  system signal FreqReqSig: init-value=FreqReqSigInitValueLiteral, length=32
package /blinker_hcs12_card12/GeneratedSystemSignals/Data/IntegerLiterals
  constant specification FreqIndSigInitValue
    value:
      integer literal FreqIndSigInitValueLiteral: value=0
  constant specification FreqReqSigInitValue
    value:
      integer literal FreqReqSigInitValueLiteral: value=1000
