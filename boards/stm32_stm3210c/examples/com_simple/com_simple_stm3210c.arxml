AUTOSAR XML (schema 3-1-5)
standard types defined: UInt8, UInt16, UInt32, SInt8, SInt16, SInt32
package /com_simple_stm3210c
  ecu configuration com_simple_stm3210c: ecu-sw-composition=SwComposition_com_simple_stm3210c, module=[CanIf, Com, Det, EcuC, EcuM, Os, PduR, Mcu, Port, Can]
  ecu sw composition SwComposition_com_simple_stm3210c
  module config CanIf
    CanIfDispatchConfig: CanIfBusOffNotification=, CanIfErrorNotificaton=, CanIfWakeupNotification=, CanIfWakeupValidNotification=
    CanIfDriverConfig: CanIfBusoffNotification=true, CanIfReceiveIndication=false, CanIfTransmitCancellation=false, CanIfTxConfirmation=false, CanIfWakeupNotification=true
    CanIfInitConfiguration: CanIfConfigSet=, CanIfNumberOfCanRxPduIds=0, CanIfNumberOfCanTXPduIds=0, CanIfNumberOfDynamicCanTXPduIds=0
      Hoh (CanIfInitHohConfig)
        Hrh (CanIfHrhConfig): CanIfHrhType=BASIC_CAN, CanIfSoftwareFilterHrh=true, CanIfCanControllerHrhIdRef=Controller_A, CanIfHrhIdSymRef=HWObj_1
        Hth (CanIfHthConfig): CanIfHthType=BASIC_CAN, CanIfCanControllerIdRef=Controller_A, CanIfHthIdSymRef=HWObj_2
      CanDB_Message_1 (CanIfRxPduConfig):
        CanIfCanRxPduCanId = 256
        CanIfCanRxPduDlc = 8
        CanIfCanRxPduId = 0
        CanIfReadRxPduData = false
        CanIfReadRxPduNotifyStatus = false
        CanIfRxPduIdCanIdType = STANDARD_CAN
        CanIfRxUserType = PDUR
        CanIfUserRxIndication = 
        CanIfCanRxPduHrhRef = Hrh
        PduIdRef = PduCollection/CanDB_Message_1
      CanDB_Message_2 (CanIfTxPduConfig):
        CanIfCanTxPduId = 0
        CanIfCanTxPduIdCanId = 512
        CanIfCanTxPduIdDlc = 8
        CanIfCanTxPduType = STATIC
        CanIfReadTxPduNotifyStatus = false
        CanIfTxPduIdCanIdType = STANDARD_CAN
        CanIfTxUserType = PDUR
        CanIfUserTxConfirmation = 
        CanIfCanTxPduHthRef = Hth
        PduIdRef = PduCollection/CanDB_Message_2
    CanIfPrivateConfiguration: CanIfDlcCheck=true, CanIfNumberOfTxBuffers=0, CanIfSoftwareFilterType=
    CanIfPublicConfiguration:
      CanIfDevErrorDetect = false
      ArcCanIfDynamicPduConfiguration = false
      CanIfMultipleDriverSupport = true
      CanIfNumberOfCanHwUnits = 1
      CanIfReadRxPduDataApi = false
      CanIfReadRxPduNotifyStatusApi = false
      CanIfReadTxPduNotifyStatusApi = false
      CanIfSetDynamicTxIdApi = false
      CanIfVersionInfoApi = true
      CanIfWakeupEventApi = false
    Controller_A (CanIfControllerConfig): CanIfWakeupSupport=NO_WAKEUP, CanIfControllerIdRef=Controller_1
  module config Com
    ComConfig: ComConfigurationId=0
      ComPduGroup (ComIPduGroup): ComIPduGroupHandleId=0
      CanDbImportedPdus (ComIPduGroup): ComIPduGroupHandleId=0
      CanDB_Message_1 (ComIPdu):
        ComIPduCallout = 
        ComIPduRxHandleId = 0
        ComIPduSignalProcessing = DEFERRED
        ComIPduDirection = RECEIVE
        ComIPduGroupRef = CanDbImportedPdus
        PduIdRef = PduCollection/CanDB_Message_1
        ComIPduSignalRef = CanDB_Signal_32_21_BE_Tester
        ComIPduSignalRef = CanDB_Signal_1_4_LE_Tester
        ComIPduSignalRef = CanDB_Signal_45_12_LE_Tester
        ComIPduSignalRef = CanDB_Signal_29_12_BE_Tester
        ComTxIPdu: ComTxIPduMinimumDelayTimeFactor=0, ComTxIPduUnusedAreasDefault=0
          ComTxModeTrue
            ComTxMode: ComTxModeMode=DIRECT, ComTxModeNumberOfRepetitions=0, ComTxModeRepetitionPeriodFactor=0, ComTxModeTimeOffsetFactor=0, ComTxModeTimePeriodFactor=0
      4 x ComSignal, all with ComFirstTimeoutFactor=0, ComHandleId=0, ComNotification=, ComSignalInitValue=0, ComSignalLength=0, ComTimeoutFactor=0, ComTimeoutNotification=, ComTransferProperty=PENDING, ComRxDataTimeoutAction=NONE:
        CanDB_Signal_32_21_BE_Tester: ComBitPosition=20, ComBitSize=21, ComSignalEndianess=BIG_ENDIAN, ComSignalType=UINT32
        CanDB_Signal_1_4_LE_Tester: ComBitPosition=1, ComBitSize=4, ComSignalEndianess=LITTLE_ENDIAN, ComSignalType=UINT8
        CanDB_Signal_45_12_LE_Tester: ComBitPosition=45, ComBitSize=12, ComSignalEndianess=LITTLE_ENDIAN, ComSignalType=SINT16
        CanDB_Signal_29_12_BE_Tester: ComBitPosition=0, ComBitSize=12, ComSignalEndianess=BIG_ENDIAN, ComSignalType=SINT16
      CanDB_Message_2 (ComIPdu):
        ComIPduCallout = 
        ComIPduRxHandleId = 0
        ComIPduSignalProcessing = DEFERRED
        ComIPduDirection = SEND
        ComIPduGroupRef = CanDbImportedPdus
        PduIdRef = PduCollection/CanDB_Message_2
        ComIPduSignalRef = CanDB_Signal_32_21_BE
        ComIPduSignalRef = CanDB_Signal_1_4_LE
        ComIPduSignalRef = CanDB_Signal_45_12_LE
        ComIPduSignalRef = CanDB_Signal_29_12_BE
        ComTxIPdu: ComTxIPduMinimumDelayTimeFactor=0, ComTxIPduUnusedAreasDefault=0
          ComTxModeTrue
            ComTxMode: ComTxModeMode=DIRECT, ComTxModeNumberOfRepetitions=0, ComTxModeRepetitionPeriodFactor=0, ComTxModeTimeOffsetFactor=0, ComTxModeTimePeriodFactor=0
      4 x ComSignal, all with ComFirstTimeoutFactor=0, ComHandleId=0, ComNotification=, ComSignalInitValue=0, ComSignalLength=0, ComTimeoutFactor=0, ComTimeoutNotification=, ComTransferProperty=TRIGGERED, ComRxDataTimeoutAction=NONE:
        CanDB_Signal_32_21_BE: ComBitPosition=20, ComBitSize=21, ComSignalEndianess=BIG_ENDIAN, ComSignalType=UINT32
        CanDB_Signal_1_4_LE: ComBitPosition=1, ComBitSize=4, ComSignalEndianess=LITTLE_ENDIAN, ComSignalType=UINT8
        CanDB_Signal_45_12_LE: ComBitPosition=45, ComBitSize=12, ComSignalEndianess=LITTLE_ENDIAN, ComSignalType=SINT16
        CanDB_Signal_29_12_BE: ComBitPosition=0, ComBitSize=12, ComSignalEndianess=BIG_ENDIAN, ComSignalType=SINT16
    ComGeneral: ComConfigurationTimeBase=0.0, ComConfigurationUseDet=false, ArcComBitPositionVersionAutosar4=false
  module config Det
    DetGeneral: DetEnableCallbacks=false, DetUseRamlog=true, DetWrapRamlog=true, DetUseStdErr=false, DetDeInitAPI=false, DetNumberOfCallbacks=5, DetRamlogSize=16
  module config EcuC
    PduCollection
      CanDB_Message_1 (Pdu): PduLength=64
      CanDB_Message_2 (Pdu): PduLength=64
  module config EcuM
    EcuMGeneral: EcuMDevErrorDetect=false, EcuMIncludeNvramMgr=false, EcuMVersionInfoApi=false, EcuMMainFunctionPeriod=0.2
    EcuMConfiguration: EcuMNvramReadallTimeout=10.0, EcuMRunMinimumDuration=10.0, EcuMNvramWriteallTimeout=10.0
      User_1 (EcuMUserConfig)
      EcuMDefaultShutdownTarget: EcuMDefaultState=EcuMStateReset, EcuMDefaultSleepModeRef=(unset)
      EcuMSleepMode: EcuMSleepModeId=0, EcuMSleepModeSuspend=false, EcuMSleepModeMcuModeRef=SLEEP, EcuMWakeupSourceMask=EcuMWakeupSource
      EcuMWakeupSource: EcuMResetReason=0, EcuMValidationTimeout=0.0, EcuMWakeupSourceId=0, EcuMWakeupSourcePolling=false
  module config Os
    OsOS:
      OsStackMonitoring = true
      OsStatus = EXTENDED
      OsUseGetServiceId = true
      OsUseParameterAccess = true
      OsUseResScheduler = true
      OsTickFrequency = 100
      OsInterruptStackSize = 2048
      OsIdleStackSize = 512
      OsNumberOfCores = 1
      ArcOsIsrMaxCount = 100
      ArcCoreOsUseDebug = false
      ArcCoreOsDebugTask = false
      ArcCoreOsDebugAlarm = false
      ArcCoreOsDebugResource = false
      ArcCoreOsDebugScheduleTable = false
      ArcCoreOsDebugEvent = false
      OsHooks: OsErrorHook=true, OsPostTaskHook=true, OsPreTaskHook=true, OsProtectionHook=false, OsShutdownHook=true, OsStartupHook=true
    OsApplication1 (OsApplication): ArcOsAppCoreId=0, OsTrusted=false, OsAppAlarmRef=Alarm1, OsAppCounterRef=Counter1, OsAppTaskRef=Task1, OsAppTaskRef=Task2
      OsApplicationHooks: OsAppErrorHook=false, OsAppShutdownHook=false, OsAppStartupHook=false
    Alarm1 (OsAlarm): OsAlarmCounterRef=Counter1
      OsAlarmAutostart: OsAlarmAlarmTime=100, OsAlarmAutostartType=ABSOLUTE, OsAlarmCycleTime=100
      OsAlarmActivateTask: OsAlarmActivateTaskRef=Task2
    Counter1 (OsCounter): OsCounterMaxAllowedValue=65535, OsCounterMinCycle=1, OsCounterTicksPerBase=0, OsCounterType=OS_TICK
    Task1 (OsTask): OsTaskActivation=1, OsTaskPriority=5, OsTaskProcessType=BASIC, ArcCoreOsTaskStackSize=2048, OsTaskSchedule=FULL
      OsTaskAutostart
    Task2 (OsTask): OsTaskActivation=1, OsTaskPriority=1, OsTaskProcessType=BASIC, ArcCoreOsTaskStackSize=2048, OsTaskSchedule=FULL
  module config PduR
    PduRGeneral:
      PduRCanIfSupport = true
      PduRCanTpSupport = false
      PduRComSupport = true
      PduRDcmSupport = false
      ArcPduRSoAdSupport = false
      PduRDevErrorDetect = false
      PduRFifoTxBufferSupport = false
      PduRFrIfSupport = false
      PduRFrTpSupport = false
      PduRGatewayOperation = false
      PduRIPduMSupport = false
      PduRLinIfSupport = false
      PduRLinTpSupport = false
      PduRMemorySize = 0
      PduRMinimumRoutingLoModule = 
      PduRMinimumRoutingLoRxPduId = 0
      PduRMinimumRoutingLoTxPduId = 0
      PduRMinimumRoutingUpModule = 
      PduRMinimumRoutingUpRxPduId = 0
      PduRMinimumRoutingUpTxPduId = 0
      PduRMulticastFromIfSupport = false
      PduRMulticastFromTpSupport = false
      PduRMulticastToIfSupport = false
      PduRMulticastToTpSupport = false
      PduRSbTxBufferSupport = false
      PduRVersionInfoApi = false
      PduRZeroCostOperation = false
      ArcPduRJ1939TpSupport = false
    PduRGlobalConfig: PduRConfigurationId=0
      PduRRoutingTable
        CanDB_Message_1 (PduRRoutingPath): SduLength=8, TpChunkSize=0
          PduRDestination (PduRDestPdu): DataProvision=DIRECT, DestPduRef=PduCollection/CanDB_Message_1
          PduRSrcPdu: HandleId=0, SrcPduRef=PduCollection/CanDB_Message_1
        CanDB_Message_2 (PduRRoutingPath): SduLength=8, TpChunkSize=0
          PduRDestination (PduRDestPdu): DataProvision=DIRECT, DestPduRef=PduCollection/CanDB_Message_2
          PduRSrcPdu: HandleId=0, SrcPduRef=PduCollection/CanDB_Message_2
      PduRTpBufferTable: PduRMaxTpBufferNumber=0
  module config Mcu
    McuGeneralConfiguration: McuDevErrorDetect=true, McuPerformResetApi=true, McuVersionInfoApi=true
    McuModuleConfiguration: McuClockSrcFailureNotification=DISABLED, McuNumberOfMcuModes=0, McuRamSectors=1, McuResetSetting=0
      McuClockSettingConfig:
        ArcAHBClocksEnable = DMA1
        ArcAHBClocksEnable = ETH_MAC
        ArcAHBClocksEnable = ETH_MAC_Tx
        ArcAHBClocksEnable = ETH_MAC_Rx
        ArcAPB1ClocksEnable = TIM2
        ArcAPB1ClocksEnable = CAN1
        ArcAPB2ClocksEnable = ADC1
        ArcAPB2ClocksEnable = GPIOA
        ArcAPB2ClocksEnable = GPIOB
        ArcAPB2ClocksEnable = GPIOC
        ArcAPB2ClocksEnable = GPIOD
        ArcAPB2ClocksEnable = GPIOE
        ArcAPB2ClocksEnable = AFIO
        McuDefaultClockReference = EXT_REF_25MHZ
        EXT_REF_25MHZ (McuClockReferencePoint): McuClockReferencePointFrequency=2.5E7, McuClockReferencePointPllEprediv=9, McuClockReferencePointPllEmfd=8, McuClockReferencePointPllErfd=0
      RUN (McuModeSettingConf): McuMode=0
      SLEEP (McuModeSettingConf): McuMode=0
  module config Port
    PortConfigSet
      PortContainer_1 (PortContainer)
        D0 (PortPin):
          PortPinPullMode = 
          PortPinDirection = INPUT_MODE
          PortPinDirectionChangeable = false
          PortPinHysteresisEnabled = false
          PortPinOpenDrainEnabled = false
          ArcReducedDrive = false
          PortPinId = 48
          ArcPortPinName = 
          PortPinLevelValue = OUTPUT_LOW
          PortPinMode = INPUT_PULLUP_CNF
        D1 (PortPin):
          PortPinPullMode = 
          PortPinDirection = OUTPUT_10MHz_MODE
          PortPinDirectionChangeable = false
          PortPinHysteresisEnabled = false
          PortPinOpenDrainEnabled = false
          ArcReducedDrive = false
          PortPinId = 49
          ArcPortPinName = 
          PortPinLevelValue = OUTPUT_LOW
          PortPinMode = ALT_PUSHPULL_CNF
    PortGeneral:
      PortDevErrorDetect = false
      PortSetPinDirectionApi = false
      PortSetPinModeApi = false
      PortVersionInfoApi = false
      ArcGpioRemap = Remap2_CAN1
      ArcGpioRemap = Remap_ETH
      ArcGpioRemap = Remap_CAN2
  module config Can
    CanConfigSet
      Controller_1 (CanController):
        CanControllerActivation = true
        CanControllerLoopback = false
        CanControllerBaudRate = 125
        CanHWControllerId = CAN_CTRL_1
        CanControllerPropSeg = 0
        CanControllerSeg1 = 12
        CanControllerSeg2 = 1
        Mask_1 (CanFilterMask): CanFilterMaskValue=0
      HWObj_1 (CanHardwareObject): CanIdType=STANDARD, CanObjectType=RECEIVE, CanMBMask=0, CanControllerRef=Controller_1, CanFilterMaskRef=Mask_1
      HWObj_2 (CanHardwareObject): CanIdType=STANDARD, CanObjectType=TRANSMIT, CanMBMask=0, CanControllerRef=Controller_1, CanFilterMaskRef=Mask_1
    CanGeneral: CanDevErrorDetection=false, CanMultiplexedTransmission=false, CanVersionInfoApi=false
package /com_simple_stm3210c/GeneratedSystemSignals
  8 x system signal:
    CanDB_Signal_32_21_BE_Tester: init-value=CanDB_Signal_32_21_BE_TesterInitValueLiteral, length=21
    CanDB_Signal_1_4_LE_Tester: init-value=CanDB_Signal_1_4_LE_TesterInitValueLiteral, length=4
    CanDB_Signal_45_12_LE_Tester: init-value=CanDB_Signal_45_12_LE_TesterInitValueLiteral, length=12
    CanDB_Signal_29_12_BE_Tester: init-value=CanDB_Signal_29_12_BE_TesterInitValueLiteral, length=12
    CanDB_Signal_32_21_BE: init-value=CanDB_Signal_32_21_BEInitValueLiteral, length=21
    CanDB_Signal_1_4_LE: init-value=CanDB_Signal_1_4_LEInitValueLiteral, length=4
    CanDB_Signal_45_12_LE: init-value=CanDB_Signal_45_12_LEInitValueLiteral, length=12
    CanDB_Signal_29_12_BE: init-value=CanDB_Signal_29_12_BEInitValueLiteral, length=12
package /com_simple_stm3210c/GeneratedSystemSignals/Data/IntegerLiterals
  8 x constant specification:
    CanDB_Signal_32_21_BE_TesterInitValue
      value:
        integer literal CanDB_Signal_32_21_BE_TesterInitValueLiteral: value=0
    CanDB_Signal_1_4_LE_TesterInitValue
      value:
        integer literal CanDB_Signal_1_4_LE_TesterInitValueLiteral: value=0
    CanDB_Signal_45_12_LE_TesterInitValue
      value:
        integer literal CanDB_Signal_45_12_LE_TesterInitValueLiteral: value=0
    CanDB_Signal_29_12_BE_TesterInitValue
      value:
        integer literal CanDB_Signal_29_12_BE_TesterInitValueLiteral: value=0
    CanDB_Signal_32_21_BEInitValue
      value:
        integer literal CanDB_Signal_32_21_BEInitValueLiteral: value=0
    CanDB_Signal_1_4_LEInitValue
      value:
        integer literal CanDB_Signal_1_4_LEInitValueLiteral: value=0
    CanDB_Signal_45_12_LEInitValue
      value:
        integer literal CanDB_Signal_45_12_LEInitValueLiteral: value=0
    CanDB_Signal_29_12_BEInitValue
      value:
        integer literal CanDB_Signal_29_12_BEInitValueLiteral: value=0
