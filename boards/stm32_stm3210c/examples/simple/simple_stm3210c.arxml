AUTOSAR XML (schema 3-1-5)
package /simple_stm3210c
  ecu configuration simple_stm3210c: ecu-sw-composition=SwComposition_simple_stm3210c, module=Os
  ecu sw composition SwComposition_simple_stm3210c
  module config Os
    OsOS:
      OsStackMonitoring = true
      OsStatus = EXTENDED
      OsUseGetServiceId = true
      OsUseParameterAccess = true
      OsUseResScheduler = true
      OsTickFrequency = 1000
      OsInterruptStackSize = 2048
      OsIdleStackSize = 512
      ArcCoreOsUseDebug = false
      ArcCoreOsDebugTask = false
      ArcCoreOsDebugAlarm = false
      ArcCoreOsDebugResource = false
      ArcCoreOsDebugScheduleTable = false
      ArcCoreOsDebugEvent = false
      ArcOsIsrMaxCount = 10
      OsNumberOfCores = 1
      OsHooks: OsErrorHook=true, OsPostTaskHook=true, OsPreTaskHook=true, OsProtectionHook=false, OsShutdownHook=true, OsStartupHook=true
    Alarm1 (OsAlarm): OsAlarmCounterRef=Counter1
      OsAlarmAction
        OsAlarmSetEvent: OsAlarmSetEventRef=Event2, OsAlarmSetEventTaskRef=eTask1
      OsAlarmAutostart: OsAlarmAlarmTime=100, OsAlarmAutostartType=RELATIVE, OsAlarmCycleTime=100
    Counter1 (OsCounter): OsCounterMaxAllowedValue=65535, OsCounterMinCycle=1, OsCounterTicksPerBase=0, OsCounterType=OS_TICK
    3 x OsTask, all with OsTaskActivation=1, OsTaskPriority=1, ArcCoreOsTaskStackSize=2048, OsTaskSchedule=FULL:
      bTask3: OsTaskProcessType=BASIC
      eTask1: OsTaskProcessType=EXTENDED, OsTaskEventRef=Event2
        OsTaskAutostart
      eTask2: OsTaskProcessType=EXTENDED, OsTaskEventRef=Event1
        OsTaskAutostart
    Event1 (OsEvent): OsEventMask=1, ArcOsEventAutoMask=true, ArcOsEventId=0
    Event2 (OsEvent): OsEventMask=2, ArcOsEventAutoMask=true, ArcOsEventId=0
    OsApplication1 (OsApplication): ArcOsAppCoreId=0, OsTrusted=false, OsAppAlarmRef=Alarm1, OsAppCounterRef=Counter1, OsAppTaskRef=bTask3, OsAppTaskRef=eTask1, OsAppTaskRef=eTask2
      OsApplicationHooks: OsAppErrorHook=false, OsAppShutdownHook=false, OsAppStartupHook=false
