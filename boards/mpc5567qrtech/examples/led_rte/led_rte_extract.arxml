AUTOSAR XML (schema 3-1-5)
package /led_rte_mpc5567_extract
  system led_rte_mpc5567_extract
    mapping led_rte_mpc5567_extract_mapping
      sw-impl-mappings:
        swc to impl mapping Blinker_prototypeImplMapping: component-implementation=BlinkerImplementation, component=led_rte_mpc5567_extract_softwareComposition.Blinker_prototype.Blinker_prototype
        swc to impl mapping led_rte_ecuc_mpc5567_IoHwAbComponentType_prototypeImplMapping: component-implementation=led_rte_ecuc_mpc5567_IoHwAbImplementation, component=led_rte_mpc5567_extract_softwareComposition.led_rte_ecuc_mpc5567_IoHwAbComponentType_prototype.led_rte_ecuc_mpc5567_IoHwAbComponentType_prototype
    software composition led_rte_mpc5567_extract_softwareComposition: software-composition=led_rte_mpc5567_extract_toplevelcomposition
  composition type led_rte_mpc5567_extract_toplevelcomposition
    component Blinker_prototype: type=Blinker
    component led_rte_ecuc_mpc5567_IoHwAbComponentType_prototype: type=led_rte_ecuc_mpc5567_IoHwAbComponentType
    connect led_rte_ecuc_mpc5567_IoHwAbComponentType_prototype.RED_LED -> Blinker_prototype.LED_Port
