AUTOSAR XML (schema 3-1-5)
package /led_rte_ecuc_mpc5567
  ecu configuration led_rte_ecuc_mpc5567: ecu-extract=led_rte_mpc5567_extract, ecu-sw-composition=SwComposition_led_rte_ecuc_mpc5567, module=[EcuM, Os, Port, Mcu, Dio, IoHwAb, Rte]
  ecu sw composition SwComposition_led_rte_ecuc_mpc5567: ecu-extract=led_rte_mpc5567_extract
  module config EcuM
    EcuMGeneral: EcuMDevErrorDetect=false, EcuMIncludeNvramMgr=false, EcuMVersionInfoApi=false, EcuMMainFunctionPeriod=0.2
    EcuMConfiguration: EcuMNvramReadallTimeout=10.0, EcuMRunMinimumDuration=10.0, EcuMNvramWriteallTimeout=10.0
      User_1 (EcuMUserConfig)
  module config Os
    OsOS:
      OsStackMonitoring = true
      OsStatus = EXTENDED
      OsUseGetServiceId = true
      OsUseParameterAccess = true
      OsUseResScheduler = true
      OsTickFrequency = 100
      OsInterruptStackSize = 2048
      OsIdleStackSize = 512
      OsNumberOfCores = 1
      ArcOsIsrMaxCount = 10
      ArcCoreOsUseDebug = false
      ArcCoreOsDebugTask = false
      ArcCoreOsDebugAlarm = false
      ArcCoreOsDebugResource = false
      ArcCoreOsDebugScheduleTable = false
      ArcCoreOsDebugEvent = false
      OsHooks: OsErrorHook=true, OsPostTaskHook=true, OsPreTaskHook=true, OsProtectionHook=false, OsShutdownHook=true, OsStartupHook=true
    Startup (OsTask): OsTaskActivation=1, OsTaskPriority=1, OsTaskProcessType=BASIC, ArcCoreOsTaskStackSize=2048, OsTaskSchedule=FULL
      OsTaskAutostart
    Scheduled (OsTask): OsTaskActivation=1, OsTaskPriority=1, OsTaskProcessType=EXTENDED, ArcCoreOsTaskStackSize=2048, OsTaskSchedule=FULL, OsTaskEventRef=ScheduleEvent
      OsTaskAutostart
    OsTick (OsCounter): OsCounterMaxAllowedValue=65535, OsCounterMinCycle=1, OsCounterTicksPerBase=0, OsCounterType=OS_TICK
    OsApplication1 (OsApplication): ArcOsAppCoreId=0, OsTrusted=false, OsAppCounterRef=OsTick, OsAppTaskRef=Startup, OsAppTaskRef=Scheduled, OsAppAlarmRef=Alarm1
      OsApplicationHooks: OsAppErrorHook=false, OsAppShutdownHook=false, OsAppStartupHook=false
    Alarm1 (OsAlarm): OsAlarmCounterRef=OsTick
      OsAlarmAutostart: OsAlarmAlarmTime=50, OsAlarmAutostartType=ABSOLUTE, OsAlarmCycleTime=50
      OsAlarmSetEvent: OsAlarmSetEventRef=ScheduleEvent, OsAlarmSetEventTaskRef=Scheduled
    ScheduleEvent (OsEvent): ArcOsEventId=0, ArcOsEventAutoMask=true
  module config Port
    PortConfigSet
      PortContainer_1 (PortContainer)
        GPIO[125] (PortPin):
          PortPinPullMode = PULL_NONE
          PortPinDirection = PORT_PIN_OUT
          PortPinDirectionChangeable = false
          PortPinHysteresisEnabled = false
          PortPinOpenDrainEnabled = false
          PortPinId = 125
          PortPinSlewRate = SLEW_RATE_MIN
          PortPinLevelValue = PORT_PIN_LEVEL_LOW
          PortPinMode = PORT_PIN_MODE_DIO
    PortGeneral: PortDevErrorDetect=false, PortSetPinDirectionApi=false, PortSetPinModeApi=false, PortVersionInfoApi=false
  module config Mcu
    McuGeneralConfiguration: McuDevErrorDetect=false, McuPerformResetApi=true, McuVersionInfoApi=true
    McuModuleConfiguration: McuClockSrcFailureNotification=DISABLED, McuNumberOfMcuModes=0, McuRamSectors=1, McuResetSetting=0
      McuClockSettingConfig: McuDefaultClockReference=Clock
        Clock (McuClockReferencePoint): McuClockReferencePointFrequency=1.6E7, McuClockReferencePointPllEprediv=2, McuClockReferencePointPllEmfd=11, McuClockReferencePointPllErfd=0
      McuModeSettingConf: McuMode=0
  module config Dio
    DioGeneral: DioDevErrorDetect=false, DioVersionInfoApi=false
    Generic (DioPort): DioPortId=0, ArcCoreDioPhysicalPort=DIO_MPC5567_GENERIC_PORT
      RED_LED (DioChannel): DioChannelId=125
  module config IoHwAb
  module config Rte
    RteGeneration:
      RteCalibrationSupport = NONE
      ArcGenerateWeakRunnableStubs = false
      ArcCalibrationFlashStartAddress = 0
      RteGenerationMode = 
      RteMeasurementSupport = false
      RteOptimizationMode = 
      RteVfbTrace = 0
      RteVfbTraceFunction = 
    Blinker_prototypeInstance (SwComponentInstance): ArcGenerationEnabled=true, ImplementationRef=BlinkerImplementation, SoftwareComponentInstanceRef=Blinker_prototype
      BlinkerRunnable_RunnableMapping (RunnableEntityMapping): ActivationOffset=0.0, PositionInTask=0, RTEEventRef=Blinker_timingEvent, MappedToTaskRef=Scheduled, UsedOsEventRef=ScheduleEvent
    led_rte_ecuc_mpc5567_IoHwAbComponentType_prototypeInstance (SwComponentInstance):
      ArcGenerationEnabled = true
      ImplementationRef = led_rte_ecuc_mpc5567_IoHwAbImplementation
      SoftwareComponentInstanceRef = led_rte_ecuc_mpc5567_IoHwAbComponentType_prototype
      IoHwAb_Write_RED_LED_RunnableMapping (RunnableEntityMapping): ActivationOffset=0.0, PositionInTask=0, RTEEventRef=IoHwAbOpEvent_RED_LED_Write
      IoHwAb_Read_RED_LED_RunnableMapping (RunnableEntityMapping): ActivationOffset=0.0, PositionInTask=0, RTEEventRef=IoHwAbOpEvent_RED_LED_Read
package /led_rte_ecuc_mpc5567/GeneratedIoHardwareAbstraction
  ecu abstraction component type led_rte_ecuc_mpc5567_IoHwAbComponentType
    provide port RED_LED: provided-interface=DigitalInterface
  internal behavior led_rte_ecuc_mpc5567_IoHwAbBehavior: component=led_rte_ecuc_mpc5567_IoHwAbComponentType
    operation invoked event IoHwAbOpEvent_RED_LED_Write: start-on-event=IoHwAb_Write_RED_LED, operation=RED_LED.Write
    operation invoked event IoHwAbOpEvent_RED_LED_Read: start-on-event=IoHwAb_Read_RED_LED, operation=RED_LED.Read
    runnable IoHwAb_Write_RED_LED: can-be-invoked-concurrently=true
    runnable IoHwAb_Read_RED_LED: can-be-invoked-concurrently=true
  swc implementation led_rte_ecuc_mpc5567_IoHwAbImplementation: behavior=led_rte_ecuc_mpc5567_IoHwAbBehavior
package /led_rte_ecuc_mpc5567/GeneratedIoHardwareAbstraction/DataTypes
  boolean type BooleanType
package /led_rte_ecuc_mpc5567/GeneratedIoHardwareAbstraction/Interfaces
  client server interface DigitalInterface
    operation Write
      arg Value: type=BooleanType, direction=IN
    operation Read
      arg Value: type=BooleanType, direction=OUT
