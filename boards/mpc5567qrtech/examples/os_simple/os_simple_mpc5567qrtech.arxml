AUTOSAR XML (schema 3-1-5)
package /os_simple_mpc5567qrtech
  ecu configuration os_simple_mpc5567qrtech: ecu-sw-composition=SwComposition_os_simple_mpc5567qrtech, module=[Os, Dio, Mcu, Port, Det, EcuM]
  ecu sw composition SwComposition_os_simple_mpc5567qrtech
  module config Os
    OsOS:
      OsStackMonitoring = true
      OsStatus = EXTENDED
      OsUseGetServiceId = true
      OsUseParameterAccess = true
      OsUseResScheduler = true
      OsTickFrequency = 1000
      OsInterruptStackSize = 2048
      OsIdleStackSize = 512
      ArcCoreOsUseDebug = false
      ArcCoreOsDebugTask = false
      ArcCoreOsDebugAlarm = false
      ArcCoreOsDebugResource = false
      ArcCoreOsDebugScheduleTable = false
      ArcCoreOsDebugEvent = false
      ArcOsIsrMaxCount = 10
      OsNumberOfCores = 1
      OsHooks: OsErrorHook=true, OsPostTaskHook=true, OsPreTaskHook=true, OsProtectionHook=false, OsShutdownHook=true, OsStartupHook=true
    Alarm1 (OsAlarm): OsAlarmCounterRef=Counter1
      OsAlarmAction
        OsAlarmSetEvent: OsAlarmSetEventRef=Event1, OsAlarmSetEventTaskRef=eTask2
      OsAlarmAutostart: OsAlarmAlarmTime=100, OsAlarmAutostartType=RELATIVE, OsAlarmCycleTime=100
      OsAlarmSetEvent: OsAlarmSetEventRef=Event1, OsAlarmSetEventTaskRef=eTask1
    3 x OsTask, all with OsTaskActivation=1, OsTaskPriority=1, ArcCoreOsTaskStackSize=2048, OsTaskSchedule=FULL:
      bTask3: OsTaskProcessType=BASIC
      eTask1: OsTaskProcessType=EXTENDED, OsTaskEventRef=Event1
        OsTaskAutostart
      eTask2: OsTaskProcessType=EXTENDED, OsTaskEventRef=Event2
        OsTaskAutostart
    Event1 (OsEvent): OsEventMask=1, ArcOsEventAutoMask=true, ArcOsEventId=0
    Event2 (OsEvent): OsEventMask=2, ArcOsEventAutoMask=true, ArcOsEventId=0
    OsApplication1 (OsApplication): ArcOsAppCoreId=0, OsTrusted=false, OsAppAlarmRef=Alarm1, OsAppTaskRef=bTask3, OsAppTaskRef=eTask1, OsAppTaskRef=eTask2, OsAppCounterRef=Counter1
      OsApplicationHooks: OsAppErrorHook=false, OsAppShutdownHook=false, OsAppStartupHook=false
    Counter1 (OsCounter): OsCounterMaxAllowedValue=65535, OsCounterMinCycle=1, OsCounterTicksPerBase=0, OsCounterType=OS_TICK
  module config Dio
    DioGeneral: DioDevErrorDetect=false, DioVersionInfoApi=false
    DioPort_1 (DioPort): DioPortId=0, ArcCoreDioPhysicalPort=DIO_MPC5567_GENERIC_PORT
      LED_K2 (DioChannel): DioChannelId=125
  module config Mcu
    McuGeneralConfiguration: McuDevErrorDetect=true, McuPerformResetApi=true, McuVersionInfoApi=true
    McuModuleConfiguration: McuClockSrcFailureNotification=DISABLED, McuNumberOfMcuModes=0, McuRamSectors=1, McuResetSetting=0
      McuClockSettingConfig: McuDefaultClockReference=EXT_REF_80MHZ
        EXT_REF_80MHZ (McuClockReferencePoint): McuClockReferencePointFrequency=1.6E7, McuClockReferencePointPllEprediv=2, McuClockReferencePointPllEmfd=11, McuClockReferencePointPllErfd=0
      McuModeSettingConf: McuMode=0
  module config Port
    PortConfigSet
      PortContainer_1 (PortContainer)
        GPIO[125] (PortPin):
          PortPinPullMode = PULL_NONE
          PortPinDirection = PORT_PIN_OUT
          PortPinDirectionChangeable = false
          PortPinHysteresisEnabled = false
          PortPinOpenDrainEnabled = false
          PortPinId = 125
          PortPinSlewRate = SLEW_RATE_MIN
          PortPinLevelValue = PORT_PIN_LEVEL_LOW
          PortPinMode = PORT_PIN_MODE_DIO
    PortGeneral: PortDevErrorDetect=true, PortSetPinDirectionApi=true, PortSetPinModeApi=true, PortVersionInfoApi=true
  module config Det
    DetGeneral: DetEnableCallbacks=false, DetUseRamlog=true, DetWrapRamlog=true, DetUseStdErr=false, DetDeInitAPI=false, DetNumberOfCallbacks=5, DetRamlogSize=16
  module config EcuM
    EcuMGeneral: EcuMDevErrorDetect=true, EcuMIncludeNvramMgr=false, EcuMVersionInfoApi=true, EcuMMainFunctionPeriod=0.2
    EcuMConfiguration: EcuMNvramReadallTimeout=10.0, EcuMRunMinimumDuration=10.0, EcuMNvramWriteallTimeout=10.0
      EcuMUserConfig
