AUTOSAR XML (schema 3-1-5)
package /board_mpc5606s_xpc560s
  ecu configuration board_mpc5606s_xpc560s: ecu-sw-composition=SwComposition_board_mpc5606s_xpc560s
  ecu sw composition SwComposition_board_mpc5606s_xpc560s
