AUTOSAR XML (schema 3.1.4)
package /tboard_config
  ecu configuration tboard_config: ecu-sw-composition=SwComposition_tboard_config, module=[Mcu, Port, Dio, Adc, Pwm, Gpt, Can]
  ecu sw composition SwComposition_tboard_config
  module config Mcu
    McuGeneralConfiguration: McuDevErrorDetect=true, McuPerformResetApi=false, McuVersionInfoApi=true
    McuModuleConfiguration: McuClockSrcFailureNotification=DISABLED, McuNumberOfMcuModes=0, McuRamSectors=1, McuResetSetting=0
      McuClockSettingConfig: McuDefaultClockReference=Clock
        Clock (McuClockReferencePoint): McuClockReferencePointFrequency=1.6E7, McuClockReferencePointPllClock=48000000
      McuModeSettingConf: McuMode=0
  module config Port
    PortConfigSet
      8 x PortContainer:
        II2C
          SDA (PortPin):
            PortPinPullMode = PULL_NONE
            PortPinDirection = PORT_PIN_IN
            PortPinDirectionChangeable = true
            PortPinHysteresisEnabled = false
            PortPinOpenDrainEnabled = false
            ArcReducedDrive = false
            ArcPortPinName = PJ6
            PortPinId = 38
            PortPinLevelValue = PORT_PIN_LEVEL_HIGH
            PortPinMode = 
          SCL (PortPin):
            PortPinPullMode = PULL_NONE
            PortPinDirection = PORT_PIN_OUT
            PortPinDirectionChangeable = false
            PortPinHysteresisEnabled = false
            PortPinOpenDrainEnabled = false
            ArcReducedDrive = false
            ArcPortPinName = PJ7
            PortPinId = 39
            PortPinLevelValue = PORT_PIN_LEVEL_HIGH
            PortPinMode = 
        CAN0
          TXD (PortPin):
            PortPinPullMode = 
            PortPinDirection = PORT_PIN_IN
            PortPinDirectionChangeable = false
            PortPinHysteresisEnabled = false
            PortPinOpenDrainEnabled = false
            ArcReducedDrive = false
            ArcPortPinName = PM1
            PortPinId = 49
            PortPinLevelValue = PORT_PIN_LEVEL_HIGH
            PortPinMode = 
          RXD (PortPin):
            PortPinPullMode = 
            PortPinDirection = PORT_PIN_IN
            PortPinDirectionChangeable = false
            PortPinHysteresisEnabled = false
            PortPinOpenDrainEnabled = false
            ArcReducedDrive = false
            ArcPortPinName = PM0
            PortPinId = 48
            PortPinLevelValue = PORT_PIN_LEVEL_HIGH
            PortPinMode = 
        LEDBAR
          8 x PortPin, all with PortPinPullMode=, PortPinDirection=PORT_PIN_OUT, PortPinDirectionChangeable=false, PortPinHysteresisEnabled=false, PortPinOpenDrainEnabled=false, ArcReducedDrive=false, PortPinLevelValue=PORT_PIN_LEVEL_HIGH, PortPinMode=:
            PB0: ArcPortPinName=PB0, PortPinId=16
            PB1: ArcPortPinName=PB1, PortPinId=17
            PB2: ArcPortPinName=PB2, PortPinId=18
            PB3: ArcPortPinName=PB3, PortPinId=19
            PB4: ArcPortPinName=PB4, PortPinId=20
            PB5: ArcPortPinName=PB5, PortPinId=21
            PB6: ArcPortPinName=PB6, PortPinId=22
            PB7: ArcPortPinName=PB7, PortPinId=23
        DIPSW
          8 x PortPin, all with PortPinPullMode=PULL_UP, PortPinDirection=PORT_PIN_IN, PortPinDirectionChangeable=false, PortPinHysteresisEnabled=false, PortPinOpenDrainEnabled=false, ArcReducedDrive=false, PortPinLevelValue=PORT_PIN_LEVEL_LOW, PortPinMode=:
            PH0: ArcPortPinName=PH0, PortPinId=24
            PH1: ArcPortPinName=PH1, PortPinId=25
            PH2: ArcPortPinName=PH2, PortPinId=26
            PH3: ArcPortPinName=PH3, PortPinId=27
            PH4: ArcPortPinName=PH4, PortPinId=28
            PH5: ArcPortPinName=PH5, PortPinId=29
            PH6: ArcPortPinName=PH6, PortPinId=30
            PH7: ArcPortPinName=PH7, PortPinId=31
        TIMER
          3 x PortPin, all with PortPinPullMode=PULL_NONE, PortPinDirectionChangeable=false, PortPinHysteresisEnabled=false, PortPinOpenDrainEnabled=false, ArcReducedDrive=false, PortPinMode=:
            PT0: PortPinDirection=PORT_PIN_IN, ArcPortPinName=PT0, PortPinId=72, PortPinLevelValue=PORT_PIN_LEVEL_HIGH
            PT1: PortPinDirection=PORT_PIN_IN, ArcPortPinName=PT1, PortPinId=73, PortPinLevelValue=PORT_PIN_LEVEL_HIGH
            BEEPER: PortPinDirection=PORT_PIN_OUT, ArcPortPinName=PT2, PortPinId=74, PortPinLevelValue=PORT_PIN_LEVEL_LOW
        PWM
          PP0 (PortPin):
            PortPinPullMode = PULL_NONE
            PortPinDirection = PORT_PIN_OUT
            PortPinDirectionChangeable = false
            PortPinHysteresisEnabled = false
            PortPinOpenDrainEnabled = false
            ArcReducedDrive = false
            ArcPortPinName = PP0
            PortPinId = 56
            PortPinLevelValue = PORT_PIN_LEVEL_LOW
            PortPinMode = 
          PP1 (PortPin):
            PortPinPullMode = PULL_NONE
            PortPinDirection = PORT_PIN_OUT
            PortPinDirectionChangeable = false
            PortPinHysteresisEnabled = false
            PortPinOpenDrainEnabled = false
            ArcReducedDrive = false
            ArcPortPinName = PP1
            PortPinId = 57
            PortPinLevelValue = PORT_PIN_LEVEL_LOW
            PortPinMode = 
        SCI0
          RXD0 (PortPin):
            PortPinPullMode = PULL_UP
            PortPinDirection = PORT_PIN_IN
            PortPinDirectionChangeable = false
            PortPinHysteresisEnabled = false
            PortPinOpenDrainEnabled = false
            ArcReducedDrive = false
            ArcPortPinName = PS0
            PortPinId = 56
            PortPinLevelValue = PORT_PIN_LEVEL_HIGH
            PortPinMode = 
          TXD0 (PortPin):
            PortPinPullMode = PULL_NONE
            PortPinDirection = PORT_PIN_IN
            PortPinDirectionChangeable = false
            PortPinHysteresisEnabled = false
            PortPinOpenDrainEnabled = false
            ArcReducedDrive = false
            ArcPortPinName = PS1
            PortPinId = 57
            PortPinLevelValue = PORT_PIN_LEVEL_HIGH
            PortPinMode = 
        SCI1
          4 x PortPin, all with PortPinDirection=PORT_PIN_IN, PortPinDirectionChangeable=false, PortPinHysteresisEnabled=false, PortPinOpenDrainEnabled=false, ArcReducedDrive=false, PortPinLevelValue=PORT_PIN_LEVEL_HIGH, PortPinMode=:
            RXD1: PortPinPullMode=PULL_UP, ArcPortPinName=PS2, PortPinId=58
            TXD1: PortPinPullMode=PULL_NONE, ArcPortPinName=PS3, PortPinId=59
            PM6: PortPinPullMode=PULL_NONE, ArcPortPinName=PM6, PortPinId=54
            PM7: PortPinPullMode=PULL_NONE, ArcPortPinName=PM7, PortPinId=55
    PortGeneral: PortDevErrorDetect=true, PortSetPinDirectionApi=false, PortSetPinModeApi=false, PortVersionInfoApi=true
  module config Dio
    DioGeneral: DioDevErrorDetect=false, DioVersionInfoApi=false
    3 x DioPort, all with DioPortId=0:
      DipSwitch: ArcCoreDioPhysicalPort=DIO_PORT_H
        4 x DioChannel:
          DI_PH0: DioChannelId=24
          DI_PH1: DioChannelId=25
          DI_PH2: DioChannelId=26
          DI_PH3: DioChannelId=27
        DI_DIP (DioChannelGroup): DioPortMask=255, DioPortOffset=0
        4 x DioChannel:
          DI_PH4: DioChannelId=28
          DI_PH5: DioChannelId=29
          DI_PH6: DioChannelId=30
          DI_PH7: DioChannelId=31
      LEDBar: ArcCoreDioPhysicalPort=DIO_PORT_B
        8 x DioChannel:
          DO_PB0: DioChannelId=16
          DO_PB1: DioChannelId=17
          DO_PB2: DioChannelId=18
          DO_PB3: DioChannelId=19
          DO_PB4: DioChannelId=20
          DO_PB5: DioChannelId=21
          DO_PB6: DioChannelId=22
          DO_PB7: DioChannelId=23
        DO_LEDBAR (DioChannelGroup): DioPortMask=255, DioPortOffset=0
      Timer: ArcCoreDioPhysicalPort=DIO_PORT_T
        3 x DioChannel:
          DI_PT0: DioChannelId=72
          DI_PT1: DioChannelId=73
          DO_PT2: DioChannelId=74
  module config Adc
    AdcConfigSet
      ATD_BLOCK (AdcHwUnit): ArcAdcResolution=10_BIT, ArcAdcConvTime=4_CLOCKS, ArcAdcPrescaleDivideFactor=8
        ATD (AdcChannel): AdcChannelConvTime=0, ArcAdcChannelId=ADC_CH2, AdcChannelRefVoltsrcHigh=0, AdcChannelRefVoltsrcLow=0, AdcChannelResolution=0, AdcChannelSampTime=0
        ATDGroup (AdcGroup):
          AdcGroupAccessMode = 
          AdcGroupConversionMode = ADC_CONV_MODE_CONTINUOUS
          AdcGroupId = 0
          AdcGroupPriority = 0
          AdcGroupReplacement = 
          AdcGroupTriggSrc = ADC_TRIGG_SRC_HW
          AdcHwTrigSignal = 
          AdcHwTrigTimer = 0
          AdcNotification = ATDCallback
          AdcResultBufferPointer = 
          AdcStreamingBufferMode = 
          AdcStreamingNumSamples = 1
          AdcGroupDefinition = ATD
    AdcGeneral:
      AdcDeInitApi = false
      AdcDevErrorDetect = true
      AdcEnableQueuing = false
      AdcEnableStartStopGroupApi = false
      AdcGrpNotifCapability = false
      AdcHwTriggerApi = false
      AdcPriorityImplementation = ADC_PRIORITY_NONE
      AdcReadGroupApi = true
      AdcVersionInfoApi = false
    AdcPublishedInformation: AdcChannelValueSigned=false, AdcGroupFirstChannelFixed=false, AdcMaxChannelResolution=0
  module config Pwm
    PwmChannelConfigSet
      GreenLED (PwmChannel):
        ArcPwmCenterAlign = false
        ArcPwmScaledClockEnable = true
        PwmChannelClass = PWM_VARIABLE_PERIOD
        PwmChannelId = 1
        PwmDutycycleDefault = 4096
        PwmIdleState = PWM_LOW
        PwmNotification = 
        PwmPeriodDefault = 188.0
        PwmPolarity = POLARITY_NORMAL
      RedLED (PwmChannel):
        ArcPwmCenterAlign = false
        ArcPwmScaledClockEnable = true
        PwmChannelClass = PWM_VARIABLE_PERIOD
        PwmChannelId = 0
        PwmDutycycleDefault = 24576
        PwmIdleState = PWM_LOW
        PwmNotification = 
        PwmPeriodDefault = 188.0
        PwmPolarity = POLARITY_NORMAL
    PwmConfigurationOfOptApiServices: PwmDeInitApi=false, PwmGetOutputState=false, PwmSetDutyCycle=true, PwmSetOutputToIdle=false, PwmSetPeriodAndDuty=true, PwmVersionInfoApi=false
    PwmGeneral:
      ArcPwmFreezeEnable = false
      PwmDevErorDetect = true
      PwmDutycycleUpdatedEndperiod = true
      PwmIndex = 1
      PwmNotificationSupported = false
      PwmPeriodUpdatedEndperiod = true
      ArcPwmChannelBusPrescalerA = PRESCALER_128
      ArcPwmChannelBusPrescalerB = PRESCALER_2
      ArcPwmChannelPrescalerA = 1
      ArcPwmChannelPrescalerB = 1
  module config Gpt
    GptChannelConfigSet
    GptConfigurationOfOptApiServices:
      GptDeinitApi = false
      GptEnableDisableNotificationApi = false
      GptTimeElapsedApi = false
      GptTimeRemainingApi = false
      GptVersionInfoApi = false
      GptWakeupFunctionalityApi = false
    GptDriverConfiguration: GptDevErrorDetect=false, GptReportWakeupSource=false
  module config Can
    CanConfigSet
      CAN0 (CanController):
        CanControllerActivation = true
        CanControllerLoopback = false
        CanControllerBaudRate = 125
        CanHWControllerId = CAN_CTRL_0
        CanControllerPropSeg = 0
        CanControllerSeg1 = 12
        CanControllerSeg2 = 1
        Mask_1 (CanFilterMask): ArcCanHcs12IdamMaskType=CAN_ARC_IDAM_2_32BIT, ArcCanHcs12ArcIdmrValue=18446744073709551615, ArcCanHcs12ArcIdarValue=0
      RxBox (CanHardwareObject): CanIdType=EXTENDED, CanObjectType=RECEIVE, CanMBMask=0, CanControllerRef=CanConfigSet/CAN0, CanFilterMaskRef=Mask_1
      TxBox (CanHardwareObject): CanIdType=EXTENDED, CanObjectType=TRANSMIT, CanMBMask=0, CanControllerRef=CanConfigSet/CAN0, CanFilterMaskRef=Mask_1
    CanGeneral: CanDevErrorDetection=false, CanMultiplexedTransmission=false, CanVersionInfoApi=false
