AUTOSAR XML (schema 3-1-5)
package /os_simple_hcs12x_tboard
  ecu configuration os_simple_hcs12x_tboard: ecu-sw-composition=SwComposition_os_simple_hcs12x_tboard
  ecu sw composition SwComposition_os_simple_hcs12x_tboard
