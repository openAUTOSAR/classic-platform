VERSION ""

NS_ :

BS_:

BU_: tester led_master

BO_ 258 LedMasterStatus: 8 led_master
 SG_ LedPeriodStatus : 7|32@0+ (1,0) [0|0] "" Vector__XXX

BO_ 256 SetLedPeriodFrame: 8 tester
 SG_ LedPeriod : 7|32@0+ (1,0) [0|100000] "" Vector__XXX

BA_DEF_  "BusType" STRING ;
BA_DEF_DEF_  "BusType" "CAN";
