AUTOSAR XML (schema 3-1-5)
standard types defined: UInt8, UInt16, UInt32, SInt8, SInt16, SInt32
package /ledmaster_hcs12x_tboard
  ecu configuration ledmaster_hcs12x_tboard: ecu-sw-composition=SwComposition_ledmaster_hcs12x_tboard, module=[Det, Mcu, Pwm, Dio, Port, Os, EcuM, EcuC, Can, CanIf, Com, PduR, Adc]
  ecu sw composition SwComposition_ledmaster_hcs12x_tboard
  module config Det
    DetGeneral: DetEnableCallbacks=false, DetUseRamlog=true, DetWrapRamlog=true, DetUseStdErr=false, DetDeInitAPI=false, DetNumberOfCallbacks=5, DetRamlogSize=16
  module config Mcu
    McuGeneralConfiguration: McuDevErrorDetect=false, McuPerformResetApi=false, McuVersionInfoApi=true
    McuModuleConfiguration: McuClockSrcFailureNotification=DISABLED, McuNumberOfMcuModes=0, McuRamSectors=1, McuResetSetting=0
      McuClockSettingConfig: McuDefaultClockReference=EXT_REF_16MHZ
        EXT_REF_16MHZ (McuClockReferencePoint): McuClockReferencePointFrequency=1.6E7, McuClockReferencePointPllClock=48000000
      McuModeSettingConf: McuMode=0
  module config Pwm
    PwmChannelConfigSet
      GreenLED (PwmChannel):
        ArcPwmCenterAlign = false
        ArcPwmScaledClockEnable = true
        PwmChannelClass = PWM_VARIABLE_PERIOD
        PwmChannelId = 1
        PwmDutycycleDefault = 4096
        PwmIdleState = PWM_LOW
        PwmNotification = 
        PwmPeriodDefault = 188.0
        PwmPolarity = POLARITY_NORMAL
    PwmConfigurationOfOptApiServices: PwmDeInitApi=false, PwmGetOutputState=false, PwmSetDutyCycle=true, PwmSetOutputToIdle=false, PwmSetPeriodAndDuty=true, PwmVersionInfoApi=false
    PwmGeneral:
      ArcPwmFreezeEnable = false
      PwmDevErorDetect = true
      PwmDutycycleUpdatedEndperiod = true
      PwmIndex = 1
      PwmNotificationSupported = false
      PwmPeriodUpdatedEndperiod = true
      ArcPwmChannelBusPrescalerA = PRESCALER_128
      ArcPwmChannelBusPrescalerB = PRESCALER_2
      ArcPwmChannelPrescalerA = 1
      ArcPwmChannelPrescalerB = 1
  module config Dio
    DioGeneral: DioDevErrorDetect=false, DioVersionInfoApi=false
    4 x DioPort, all with DioPortId=0:
      DipSwitch: ArcCoreDioPhysicalPort=DIO_PORT_H
        4 x DioChannel:
          DI_PH0: DioChannelId=24
          DI_PH1: DioChannelId=25
          DI_PH2: DioChannelId=26
          DI_PH3: DioChannelId=27
        DI_DIP (DioChannelGroup): DioPortMask=255, DioPortOffset=0
        4 x DioChannel:
          DI_PH4: DioChannelId=28
          DI_PH5: DioChannelId=29
          DI_PH6: DioChannelId=30
          DI_PH7: DioChannelId=31
      LEDBar: ArcCoreDioPhysicalPort=DIO_PORT_B
        8 x DioChannel:
          DO_PB0: DioChannelId=16
          DO_PB1: DioChannelId=17
          DO_PB2: DioChannelId=18
          DO_PB3: DioChannelId=19
          DO_PB4: DioChannelId=20
          DO_PB5: DioChannelId=21
          DO_PB6: DioChannelId=22
          DO_PB7: DioChannelId=23
        DO_LEDBAR (DioChannelGroup): DioPortMask=255, DioPortOffset=0
      Timer: ArcCoreDioPhysicalPort=DIO_PORT_T
        3 x DioChannel:
          DI_PT0: DioChannelId=72
          DI_PT1: DioChannelId=73
          DO_PT2: DioChannelId=74
      PWMPort: ArcCoreDioPhysicalPort=DIO_PORT_P
        RedLED (DioChannel): DioChannelId=56
  module config Port
    PortConfigSet
      8 x PortContainer:
        II2C
          SDA (PortPin):
            PortPinPullMode = PULL_NONE
            PortPinDirection = PORT_PIN_IN
            PortPinDirectionChangeable = true
            PortPinHysteresisEnabled = false
            PortPinOpenDrainEnabled = false
            ArcReducedDrive = false
            ArcPortPinName = PJ6
            PortPinId = 38
            PortPinLevelValue = PORT_PIN_LEVEL_HIGH
            PortPinMode = 
          SCL (PortPin):
            PortPinPullMode = PULL_NONE
            PortPinDirection = PORT_PIN_OUT
            PortPinDirectionChangeable = false
            PortPinHysteresisEnabled = false
            PortPinOpenDrainEnabled = false
            ArcReducedDrive = false
            ArcPortPinName = PJ7
            PortPinId = 39
            PortPinLevelValue = PORT_PIN_LEVEL_HIGH
            PortPinMode = 
        CAN0
          TXD (PortPin):
            PortPinPullMode = 
            PortPinDirection = PORT_PIN_IN
            PortPinDirectionChangeable = false
            PortPinHysteresisEnabled = false
            PortPinOpenDrainEnabled = false
            ArcReducedDrive = false
            ArcPortPinName = PM1
            PortPinId = 49
            PortPinLevelValue = PORT_PIN_LEVEL_HIGH
            PortPinMode = 
          RXD (PortPin):
            PortPinPullMode = 
            PortPinDirection = PORT_PIN_IN
            PortPinDirectionChangeable = false
            PortPinHysteresisEnabled = false
            PortPinOpenDrainEnabled = false
            ArcReducedDrive = false
            ArcPortPinName = PM0
            PortPinId = 48
            PortPinLevelValue = PORT_PIN_LEVEL_HIGH
            PortPinMode = 
        LEDBAR
          8 x PortPin, all with PortPinPullMode=, PortPinDirection=PORT_PIN_OUT, PortPinDirectionChangeable=false, PortPinHysteresisEnabled=false, PortPinOpenDrainEnabled=false, ArcReducedDrive=false, PortPinLevelValue=PORT_PIN_LEVEL_HIGH, PortPinMode=:
            PB0: ArcPortPinName=PB0, PortPinId=16
            PB1: ArcPortPinName=PB1, PortPinId=17
            PB2: ArcPortPinName=PB2, PortPinId=18
            PB3: ArcPortPinName=PB3, PortPinId=19
            PB4: ArcPortPinName=PB4, PortPinId=20
            PB5: ArcPortPinName=PB5, PortPinId=21
            PB6: ArcPortPinName=PB6, PortPinId=22
            PB7: ArcPortPinName=PB7, PortPinId=23
        DIPSW
          8 x PortPin, all with PortPinPullMode=PULL_UP, PortPinDirection=PORT_PIN_IN, PortPinDirectionChangeable=false, PortPinHysteresisEnabled=false, PortPinOpenDrainEnabled=false, ArcReducedDrive=false, PortPinLevelValue=PORT_PIN_LEVEL_LOW, PortPinMode=:
            PH0: ArcPortPinName=PH0, PortPinId=24
            PH1: ArcPortPinName=PH1, PortPinId=25
            PH2: ArcPortPinName=PH2, PortPinId=26
            PH3: ArcPortPinName=PH3, PortPinId=27
            PH4: ArcPortPinName=PH4, PortPinId=28
            PH5: ArcPortPinName=PH5, PortPinId=29
            PH6: ArcPortPinName=PH6, PortPinId=30
            PH7: ArcPortPinName=PH7, PortPinId=31
        TIMER
          3 x PortPin, all with PortPinPullMode=PULL_NONE, PortPinDirectionChangeable=false, PortPinHysteresisEnabled=false, PortPinOpenDrainEnabled=false, ArcReducedDrive=false, PortPinMode=:
            PT0: PortPinDirection=PORT_PIN_IN, ArcPortPinName=PT0, PortPinId=72, PortPinLevelValue=PORT_PIN_LEVEL_HIGH
            PT1: PortPinDirection=PORT_PIN_IN, ArcPortPinName=PT1, PortPinId=73, PortPinLevelValue=PORT_PIN_LEVEL_HIGH
            BEEPER: PortPinDirection=PORT_PIN_OUT, ArcPortPinName=PT2, PortPinId=74, PortPinLevelValue=PORT_PIN_LEVEL_LOW
        PWM
          PP0 (PortPin):
            PortPinPullMode = PULL_NONE
            PortPinDirection = PORT_PIN_OUT
            PortPinDirectionChangeable = false
            PortPinHysteresisEnabled = false
            PortPinOpenDrainEnabled = false
            ArcReducedDrive = false
            ArcPortPinName = PP0
            PortPinId = 56
            PortPinLevelValue = PORT_PIN_LEVEL_LOW
            PortPinMode = 
          PP1 (PortPin):
            PortPinPullMode = PULL_NONE
            PortPinDirection = PORT_PIN_OUT
            PortPinDirectionChangeable = false
            PortPinHysteresisEnabled = false
            PortPinOpenDrainEnabled = false
            ArcReducedDrive = false
            ArcPortPinName = PP1
            PortPinId = 57
            PortPinLevelValue = PORT_PIN_LEVEL_LOW
            PortPinMode = 
        SCI0
          RXD0 (PortPin):
            PortPinPullMode = PULL_UP
            PortPinDirection = PORT_PIN_IN
            PortPinDirectionChangeable = false
            PortPinHysteresisEnabled = false
            PortPinOpenDrainEnabled = false
            ArcReducedDrive = false
            ArcPortPinName = PS0
            PortPinId = 56
            PortPinLevelValue = PORT_PIN_LEVEL_HIGH
            PortPinMode = 
          TXD0 (PortPin):
            PortPinPullMode = PULL_NONE
            PortPinDirection = PORT_PIN_IN
            PortPinDirectionChangeable = false
            PortPinHysteresisEnabled = false
            PortPinOpenDrainEnabled = false
            ArcReducedDrive = false
            ArcPortPinName = PS1
            PortPinId = 57
            PortPinLevelValue = PORT_PIN_LEVEL_HIGH
            PortPinMode = 
        SCI1
          4 x PortPin, all with PortPinDirection=PORT_PIN_IN, PortPinDirectionChangeable=false, PortPinHysteresisEnabled=false, PortPinOpenDrainEnabled=false, ArcReducedDrive=false, PortPinLevelValue=PORT_PIN_LEVEL_HIGH, PortPinMode=:
            RXD1: PortPinPullMode=PULL_UP, ArcPortPinName=PS2, PortPinId=58
            TXD1: PortPinPullMode=PULL_NONE, ArcPortPinName=PS3, PortPinId=59
            PM6: PortPinPullMode=PULL_NONE, ArcPortPinName=PM6, PortPinId=54
            PM7: PortPinPullMode=PULL_NONE, ArcPortPinName=PM7, PortPinId=55
    PortGeneral: PortDevErrorDetect=true, PortSetPinDirectionApi=false, PortSetPinModeApi=false, PortVersionInfoApi=true
  module config Os
    OsOS:
      OsStackMonitoring = true
      OsStatus = EXTENDED
      OsUseGetServiceId = true
      OsUseParameterAccess = true
      OsUseResScheduler = true
      OsTickFrequency = 1000
      OsInterruptStackSize = 512
      OsIdleStackSize = 512
      OsNumberOfCores = 1
      ArcOsIsrMaxCount = 10
      ArcCoreOsUseDebug = false
      ArcCoreOsDebugTask = false
      ArcCoreOsDebugAlarm = false
      ArcCoreOsDebugResource = false
      ArcCoreOsDebugScheduleTable = false
      ArcCoreOsDebugEvent = false
      OsHooks: OsErrorHook=true, OsPostTaskHook=true, OsPreTaskHook=true, OsProtectionHook=false, OsShutdownHook=true, OsStartupHook=true
    MainApplication (OsApplication):
      ArcOsAppCoreId = 0
      OsTrusted = false
      OsAppAlarmRef = LedAlarm
      OsAppAlarmRef = DipAlarm
      OsAppCounterRef = MainCounter
      OsAppTaskRef = LedTask
      OsAppTaskRef = DipTask
      OsAppTaskRef = StartTask
      OsAppTaskRef = ComTask
      OsAppTaskRef = ComReceiveTask
      OsAppAlarmRef = ComAlarm
      OsApplicationHooks: OsAppErrorHook=false, OsAppShutdownHook=false, OsAppStartupHook=false
    MainCounter (OsCounter): OsCounterMaxAllowedValue=65535, OsCounterMinCycle=1, OsCounterTicksPerBase=0, OsCounterType=OS_TICK
    LedAlarm (OsAlarm): OsAlarmCounterRef=MainCounter
      OsAlarmAutostart: OsAlarmAlarmTime=50, OsAlarmAutostartType=ABSOLUTE, OsAlarmCycleTime=100
      OsAlarmActivateTask: OsAlarmActivateTaskRef=LedTask
    DipAlarm (OsAlarm): OsAlarmCounterRef=MainCounter
      OsAlarmAutostart: OsAlarmAlarmTime=1, OsAlarmAutostartType=ABSOLUTE, OsAlarmCycleTime=100
      OsAlarmActivateTask: OsAlarmActivateTaskRef=DipTask
    3 x OsTask, all with OsTaskActivation=1, OsTaskProcessType=BASIC, ArcCoreOsTaskStackSize=512, OsTaskSchedule=FULL:
      LedTask: OsTaskPriority=5
      DipTask: OsTaskPriority=1
      StartTask: OsTaskPriority=1
        OsTaskAutostart
    FreqReciveEvent (OsEvent): ArcOsEventId=0, ArcOsEventAutoMask=true
    ComTask (OsTask): OsTaskActivation=1, OsTaskPriority=4, OsTaskProcessType=BASIC, ArcCoreOsTaskStackSize=512, OsTaskSchedule=FULL
    ComReceiveTask (OsTask): OsTaskActivation=1, OsTaskPriority=5, OsTaskProcessType=EXTENDED, ArcCoreOsTaskStackSize=512, OsTaskSchedule=FULL, OsTaskEventRef=FreqReciveEvent
      OsTaskAutostart
    ComAlarm (OsAlarm): OsAlarmCounterRef=MainCounter
      OsAlarmAutostart: OsAlarmAlarmTime=50, OsAlarmAutostartType=ABSOLUTE, OsAlarmCycleTime=100
      OsAlarmActivateTask: OsAlarmActivateTaskRef=ComTask
  module config EcuM
    EcuMGeneral: EcuMDevErrorDetect=false, EcuMIncludeNvramMgr=false, EcuMVersionInfoApi=false, EcuMMainFunctionPeriod=0.2
    EcuMConfiguration: EcuMNvramReadallTimeout=10.0, EcuMRunMinimumDuration=10.0, EcuMNvramWriteallTimeout=10.0
      User_1 (EcuMUserConfig)
      EcuMDefaultShutdownTarget: EcuMDefaultState=EcuMStateReset, EcuMDefaultSleepModeRef=(unset)
      EcuMSleepMode: EcuMSleepModeId=0, EcuMSleepModeSuspend=false, EcuMSleepModeMcuModeRef=McuModeSettingConf, EcuMWakeupSourceMask=EcuMWakeupSource
      EcuMWakeupSource: EcuMResetReason=0, EcuMValidationTimeout=0.0, EcuMWakeupSourceId=0, EcuMWakeupSourcePolling=false
  module config EcuC
    PduCollection
      FreqReq (Pdu): PduLength=64
      FreqInd (Pdu): PduLength=64
  module config Can
    CanConfigSet
      CAN0 (CanController):
        CanControllerActivation = false
        CanControllerLoopback = false
        CanControllerBaudRate = 125
        CanHWControllerId = CAN_CTRL_0
        CanControllerPropSeg = 0
        CanControllerSeg1 = 12
        CanControllerSeg2 = 1
        Mask (CanFilterMask): ArcCanHcs12IdamMaskType=CAN_ARC_IDAM_2_32BIT, ArcCanHcs12ArcIdmrValue=18446744073709551615, ArcCanHcs12ArcIdarValue=0
      TxBox (CanHardwareObject): CanIdType=STANDARD, CanObjectType=TRANSMIT, CanMBMask=0, CanControllerRef=CanConfigSet/CAN0, CanFilterMaskRef=Mask
      RxBox (CanHardwareObject): CanIdType=STANDARD, CanObjectType=RECEIVE, CanMBMask=0, CanControllerRef=CanConfigSet/CAN0, CanFilterMaskRef=Mask
    CanGeneral: CanDevErrorDetection=false, CanMultiplexedTransmission=false, CanVersionInfoApi=false
  module config CanIf
    CanIfDispatchConfig: CanIfBusOffNotification=, CanIfErrorNotificaton=, CanIfWakeupNotification=, CanIfWakeupValidNotification=
    CanIfDriverConfig: CanIfBusoffNotification=true, CanIfReceiveIndication=false, CanIfTransmitCancellation=false, CanIfTxConfirmation=false, CanIfWakeupNotification=true
    CanIfInitConfiguration: CanIfConfigSet=, CanIfNumberOfCanRxPduIds=0, CanIfNumberOfCanTXPduIds=0, CanIfNumberOfDynamicCanTXPduIds=0
      HardwareObject (CanIfInitHohConfig)
        RxBox (CanIfHrhConfig): CanIfHrhType=BASIC_CAN, CanIfSoftwareFilterHrh=true, CanIfCanControllerHrhIdRef=Channel0, CanIfHrhIdSymRef=CanConfigSet/RxBox
        TxBox (CanIfHthConfig): CanIfHthType=BASIC_CAN, CanIfCanControllerIdRef=Channel0, CanIfHthIdSymRef=CanConfigSet/TxBox
      Rx_FreqReq (CanIfRxPduConfig):
        CanIfCanRxPduCanId = 256
        CanIfCanRxPduDlc = 8
        CanIfCanRxPduId = 0
        CanIfReadRxPduData = false
        CanIfReadRxPduNotifyStatus = false
        CanIfRxPduIdCanIdType = STANDARD_CAN
        CanIfRxUserType = PDUR
        CanIfUserRxIndication = 
        CanIfCanRxPduHrhRef = HardwareObject/RxBox
        PduIdRef = PduCollection/FreqReq
      Tx_FreqInd (CanIfTxPduConfig):
        CanIfCanTxPduId = 0
        CanIfCanTxPduIdCanId = 258
        CanIfCanTxPduIdDlc = 8
        CanIfCanTxPduType = STATIC
        CanIfReadTxPduNotifyStatus = false
        CanIfTxPduIdCanIdType = STANDARD_CAN
        CanIfTxUserType = PDUR
        CanIfUserTxConfirmation = 
        CanIfCanTxPduHthRef = HardwareObject/TxBox
        PduIdRef = PduCollection/FreqInd
    CanIfPrivateConfiguration: CanIfDlcCheck=true, CanIfNumberOfTxBuffers=0, CanIfSoftwareFilterType=TABLE
    CanIfPublicConfiguration:
      CanIfDevErrorDetect = false
      ArcCanIfDynamicPduConfiguration = false
      CanIfMultipleDriverSupport = true
      CanIfNumberOfCanHwUnits = 1
      CanIfReadRxPduDataApi = false
      CanIfReadRxPduNotifyStatusApi = false
      CanIfReadTxPduNotifyStatusApi = false
      CanIfSetDynamicTxIdApi = false
      CanIfVersionInfoApi = true
      CanIfWakeupEventApi = false
    Channel0 (CanIfControllerConfig): CanIfWakeupSupport=NO_WAKEUP, CanIfControllerIdRef=CanConfigSet/CAN0
  module config Com
    ComConfig: ComConfigurationId=0
      ComPduGroup (ComIPduGroup): ComIPduGroupHandleId=0
      FreqReq (ComIPdu):
        ComIPduCallout = 
        ComIPduRxHandleId = 0
        ComIPduSignalProcessing = DEFERRED
        ComIPduDirection = RECEIVE
        ComIPduGroupRef = ComPduGroup
        PduIdRef = PduCollection/FreqReq
        ComIPduSignalRef = FreqReqSig
        ComTxIPdu: ComTxIPduMinimumDelayTimeFactor=0, ComTxIPduUnusedAreasDefault=0
          ComTxModeTrue
            ComTxMode: ComTxModeMode=DIRECT, ComTxModeNumberOfRepetitions=0, ComTxModeRepetitionPeriodFactor=0, ComTxModeTimeOffsetFactor=0, ComTxModeTimePeriodFactor=0
      FreqInd (ComIPdu):
        ComIPduCallout = 
        ComIPduRxHandleId = 0
        ComIPduSignalProcessing = DEFERRED
        ComIPduDirection = SEND
        ComIPduGroupRef = ComPduGroup
        PduIdRef = PduCollection/FreqInd
        ComIPduSignalRef = FreqIndSig
        ComTxIPdu: ComTxIPduMinimumDelayTimeFactor=0, ComTxIPduUnusedAreasDefault=0
          ComTxModeTrue
            ComTxMode: ComTxModeMode=PERIODIC, ComTxModeNumberOfRepetitions=0, ComTxModeRepetitionPeriodFactor=0, ComTxModeTimeOffsetFactor=0, ComTxModeTimePeriodFactor=10
      FreqIndSig (ComSignal):
        ComBitPosition = 7
        ComBitSize = 32
        ComFirstTimeoutFactor = 0
        ComHandleId = 0
        ComNotification = 
        ComSignalEndianess = BIG_ENDIAN
        ComSignalInitValue = 0
        ComSignalLength = 0
        ComSignalType = UINT32
        ComTimeoutFactor = 0
        ComTimeoutNotification = 
        ComTransferProperty = PENDING
        ComRxDataTimeoutAction = NONE
      FreqReqSig (ComSignal):
        ComBitPosition = 7
        ComBitSize = 32
        ComFirstTimeoutFactor = 0
        ComHandleId = 0
        ComNotification = IncommingFreqReq
        ComSignalEndianess = BIG_ENDIAN
        ComSignalInitValue = 1000
        ComSignalLength = 0
        ComSignalType = UINT32
        ComTimeoutFactor = 0
        ComTimeoutNotification = 
        ComTransferProperty = PENDING
        ComRxDataTimeoutAction = NONE
    ComGeneral: ComConfigurationTimeBase=0.0, ComConfigurationUseDet=false, ArcComBitPositionVersionAutosar4=false
  module config PduR
    PduRGeneral:
      PduRCanIfSupport = true
      PduRCanTpSupport = false
      PduRComSupport = true
      PduRDcmSupport = false
      ArcPduRSoAdSupport = false
      PduRDevErrorDetect = false
      PduRFifoTxBufferSupport = false
      PduRFrIfSupport = false
      PduRFrTpSupport = false
      PduRGatewayOperation = false
      PduRIPduMSupport = false
      PduRLinIfSupport = false
      PduRLinTpSupport = false
      PduRMemorySize = 0
      PduRMinimumRoutingLoModule = 
      PduRMinimumRoutingLoRxPduId = 0
      PduRMinimumRoutingLoTxPduId = 0
      PduRMinimumRoutingUpModule = 
      PduRMinimumRoutingUpRxPduId = 0
      PduRMinimumRoutingUpTxPduId = 0
      PduRMulticastFromIfSupport = false
      PduRMulticastFromTpSupport = false
      PduRMulticastToIfSupport = false
      PduRMulticastToTpSupport = false
      PduRSbTxBufferSupport = false
      PduRSingleIf = CAN_IF
      PduRSingleTp = CAN_TP
      PduRVersionInfoApi = false
      PduRZeroCostOperation = true
      ArcPduRJ1939TpSupport = false
    PduRGlobalConfig: PduRConfigurationId=0
      PduRRoutingTable
      PduRTpBufferTable: PduRMaxTpBufferNumber=0
  module config Adc
    AdcConfigSet
      ADCMainUnit (AdcHwUnit): ArcAdcResolution=8_BIT, ArcAdcConvTime=16_CLOCKS, ArcAdcPrescaleDivideFactor=30
        PotChannel (AdcChannel): AdcChannelConvTime=0, ArcAdcChannelId=ADC_CH2, AdcChannelRefVoltsrcHigh=0, AdcChannelRefVoltsrcLow=0, AdcChannelResolution=0, AdcChannelSampTime=0
        MainGroup (AdcGroup):
          AdcGroupAccessMode = 
          AdcGroupConversionMode = ADC_CONV_MODE_CONTINUOUS
          AdcGroupId = 0
          AdcGroupPriority = 0
          AdcGroupReplacement = 
          AdcGroupTriggSrc = ADC_TRIGG_SRC_HW
          AdcHwTrigSignal = 
          AdcHwTrigTimer = 0
          AdcNotification = 
          AdcResultBufferPointer = 
          AdcStreamingBufferMode = 
          AdcStreamingNumSamples = 1
          AdcGroupDefinition = PotChannel
    AdcGeneral:
      AdcDeInitApi = false
      AdcDevErrorDetect = false
      AdcEnableQueuing = false
      AdcEnableStartStopGroupApi = true
      AdcGrpNotifCapability = false
      AdcHwTriggerApi = false
      AdcPriorityImplementation = 
      AdcReadGroupApi = true
      AdcVersionInfoApi = false
    AdcPublishedInformation: AdcChannelValueSigned=false, AdcGroupFirstChannelFixed=false, AdcMaxChannelResolution=0
package /ledmaster_hcs12x_tboard/GeneratedSystemSignals
  system signal FreqIndSig: init-value=FreqIndSigInitValueLiteral, length=32
  system signal FreqReqSig: init-value=FreqReqSigInitValueLiteral, length=32
package /ledmaster_hcs12x_tboard/GeneratedSystemSignals/Data/IntegerLiterals
  constant specification FreqIndSigInitValue
    value:
      integer literal FreqIndSigInitValueLiteral: value=0
  constant specification FreqReqSigInitValue
    value:
      integer literal FreqReqSigInitValueLiteral: value=1000
