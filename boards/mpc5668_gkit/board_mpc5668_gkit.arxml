AUTOSAR XML (schema 3-1-5)
package /board_mpc5668_gkit
  ecu configuration board_mpc5668_gkit: ecu-sw-composition=SwComposition_board_mpc5668_gkit, module=[Port, Mcu]
  ecu sw composition SwComposition_board_mpc5668_gkit
  module config Port
    PortConfigSet
      PortContainer_1 (PortContainer)
    PortGeneral: PortDevErrorDetect=false, PortSetPinDirectionApi=false, PortSetPinModeApi=false, PortVersionInfoApi=true
  module config Mcu
    McuGeneralConfiguration: McuDevErrorDetect=false, McuPerformResetApi=true, McuVersionInfoApi=true
    McuModuleConfiguration: McuClockSrcFailureNotification=DISABLED, McuNumberOfMcuModes=0, McuRamSectors=1, McuResetSetting=0
      McuClockSettingConfig: McuDefaultClockReference=EXT_REF_112MHZ
        EXT_REF_112MHZ (McuClockReferencePoint): McuClockReferencePointFrequency=4.0E7, McuClockReferencePointPllEprediv=9, McuClockReferencePointPllEmfd=40, McuClockReferencePointPllErfd=1
      McuModeSettingConf: McuMode=0
