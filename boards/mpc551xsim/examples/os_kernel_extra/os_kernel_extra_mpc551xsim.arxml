AUTOSAR XML (schema 3-1-5)
package /os_kernel_extra_mpc551xsim
  ecu configuration os_kernel_extra_mpc551xsim: ecu-sw-composition=SwComposition_os_kernel_extra_mpc551xsim, module=[Mcu, Os]
  ecu sw composition SwComposition_os_kernel_extra_mpc551xsim
  module config Mcu
    McuGeneralConfiguration: McuDevErrorDetect=true, McuPerformResetApi=true, McuVersionInfoApi=true
    McuModuleConfiguration: McuClockSrcFailureNotification=DISABLED, McuNumberOfMcuModes=0, McuRamSectors=1, McuResetSetting=0
      McuClockSettingConfig: McuDefaultClockReference=EXT_REF_80MHZ
        EXT_REF_80MHZ (McuClockReferencePoint): McuClockReferencePointFrequency=8000000.0, McuClockReferencePointPllEprediv=1, McuClockReferencePointPllEmfd=104, McuClockReferencePointPllErfd=5
        EXT_REF_66MHZ (McuClockReferencePoint): McuClockReferencePointFrequency=1.6E7, McuClockReferencePointPllEprediv=3, McuClockReferencePointPllEmfd=83, McuClockReferencePointPllErfd=5
      McuModeSettingConf: McuMode=0
  module config Os
    OsOS:
      OsStackMonitoring = true
      OsStatus = EXTENDED
      OsUseGetServiceId = true
      OsUseParameterAccess = true
      OsUseResScheduler = true
      OsTickFrequency = 1000
      OsInterruptStackSize = 2048
      OsIdleStackSize = 512
      ArcCoreOsUseDebug = false
      ArcCoreOsDebugTask = false
      ArcCoreOsDebugAlarm = false
      ArcCoreOsDebugResource = false
      ArcCoreOsDebugScheduleTable = false
      ArcCoreOsDebugEvent = false
      ArcOsIsrMaxCount = 10
      OsNumberOfCores = 1
      OsHooks: OsErrorHook=true, OsPostTaskHook=true, OsPreTaskHook=true, OsProtectionHook=false, OsShutdownHook=true, OsStartupHook=true
    LossOfLock (OsIsr): OsIsrCategory=CATEGORY_1, ArcOsIsrVector=PLL_SYNSR_LOLF, ArcOsIsrCallbackName=Mcu_LossOfLock, ArcOsIsrPriority=5
    eTask1 (OsTask):
      OsTaskActivation = 1
      OsTaskPriority = 1
      OsTaskProcessType = EXTENDED
      ArcCoreOsTaskStackSize = 1024
      OsTaskSchedule = FULL
      OsTaskEventRef = Event1
      OsTaskResourceRef = Resource1
      OsTaskAutostart
    Alarm1 (OsAlarm): OsAlarmCounterRef=Counter1
      OsAlarmAction
        OsAlarmActivateTask: OsAlarmActivateTaskRef=bTask
    Counter1 (OsCounter): OsCounterMaxAllowedValue=65535, OsCounterMinCycle=1, OsCounterTicksPerBase=0, OsCounterType=OS_TICK
    Event1 (OsEvent): OsEventMask=1, ArcOsEventAutoMask=false, ArcOsEventId=0
    LossOfClock (OsIsr): OsIsrCategory=CATEGORY_1, ArcOsIsrVector=PLL_SYNSR_LOCF, ArcOsIsrCallbackName=Mcu_LossOfClock, ArcOsIsrPriority=5
    bTask (OsTask):
      OsTaskActivation = 1
      OsTaskPriority = 2
      OsTaskProcessType = BASIC
      ArcCoreOsTaskStackSize = 1024
      OsTaskSchedule = FULL
      OsTaskEventRef = Event2
      OsTaskEventRef = Event1
      OsTaskResourceRef = Resource1
    Event2 (OsEvent): OsEventMask=1, ArcOsEventAutoMask=false, ArcOsEventId=0
    TickTrigg (OsIsr): OsIsrCategory=CATEGORY_2, ArcOsIsrVector=INTC_SSCIR0_CLR7, ArcOsIsrCallbackName=OsTick, ArcOsIsrPriority=6, OsIsrResourceRef=Resource1
    Resource1 (OsResource): OsResourceProperty=STANDARD
    OsApplication1 (OsApplication):
      ArcOsAppCoreId = 0
      OsTrusted = false
      OsAppAlarmRef = Alarm1
      OsAppCounterRef = Counter1
      OsAppIsrRef = LossOfLock
      OsAppIsrRef = LossOfClock
      OsAppIsrRef = TickTrigg
      OsAppResourceRef = Resource1
      OsAppTaskRef = eTask1
      OsAppTaskRef = bTask
      OsApplicationHooks: OsAppErrorHook=false, OsAppShutdownHook=false, OsAppStartupHook=false
