AUTOSAR XML (schema 3-1-5)
package /schedule_table
  ecu configuration schedule_table: ecu-sw-composition=SwComposition_schedule_table, module=Os
  ecu sw composition SwComposition_schedule_table
  module config Os
    OsOS:
      OsStackMonitoring = true
      OsStatus = EXTENDED
      OsUseGetServiceId = true
      OsUseParameterAccess = true
      OsUseResScheduler = true
      OsTickFrequency = 100
      OsInterruptStackSize = 2048
      OsIdleStackSize = 512
      ArcCoreOsUseDebug = false
      ArcCoreOsDebugTask = false
      ArcCoreOsDebugAlarm = false
      ArcCoreOsDebugResource = false
      ArcCoreOsDebugScheduleTable = false
      ArcCoreOsDebugEvent = false
      ArcOsIsrMaxCount = 10
      OsNumberOfCores = 1
      OsHooks: OsErrorHook=true, OsPostTaskHook=true, OsPreTaskHook=true, OsProtectionHook=false, OsShutdownHook=true, OsStartupHook=true
    OsApplication1 (OsApplication):
      ArcOsAppCoreId = 0
      OsTrusted = false
      OsAppCounterRef = Counter1
      OsAppScheduleTableRef = ScheduleTable_1
      OsAppTaskRef = eTask1
      OsAppTaskRef = eTask2
      OsAppTaskRef = bTask3
      OsApplicationHooks: OsAppErrorHook=false, OsAppShutdownHook=false, OsAppStartupHook=false
    Counter1 (OsCounter): OsCounterMaxAllowedValue=65535, OsCounterMinCycle=1, OsCounterTicksPerBase=0, OsCounterType=OS_TICK
    Event1 (OsEvent): OsEventMask=16, ArcOsEventAutoMask=false, ArcOsEventId=0
    Event2 (OsEvent): OsEventMask=1, ArcOsEventAutoMask=true, ArcOsEventId=0
    ScheduleTable_1 (OsScheduleTable): OsScheduleTableDuration=10, OsScheduleTableRepeating=true, OsScheduleTableCounterRef=Counter1
      3 x OsScheduleTableExpiryPoint:
        ExpiryPoint: OsScheduleTblExpPointOffset=2
          TaskActivation1 (OsScheduleTableTaskActivation): OsScheduleTableActivateTaskRef=bTask3
        ExpiryPoint1: OsScheduleTblExpPointOffset=4
          EventSetting1 (OsScheduleTableEventSetting): OsScheduleTableSetEventRef=Event1, OsScheduleTableSetEventTaskRef=eTask1
        ExpiryPoint2: OsScheduleTblExpPointOffset=8
          EventSetting1 (OsScheduleTableEventSetting): OsScheduleTableSetEventRef=Event2, OsScheduleTableSetEventTaskRef=eTask2
      OsScheduleTableAutostart: OsScheduleTableAutostartType=ABSOLUTE, ArcCoreOsScheduleTableOffset=10
    3 x OsTask, all with OsTaskActivation=1, OsTaskPriority=1, ArcCoreOsTaskStackSize=2048, OsTaskSchedule=FULL:
      eTask1: OsTaskProcessType=EXTENDED, OsTaskEventRef=Event1
        OsTaskAutostart
      eTask2: OsTaskProcessType=EXTENDED, OsTaskEventRef=Event2
        OsTaskAutostart
      bTask3: OsTaskProcessType=BASIC
