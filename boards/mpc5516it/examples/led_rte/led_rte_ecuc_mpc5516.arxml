AUTOSAR XML (schema 3-1-5)
package /led_rte_ecuc_mpc5516
  ecu configuration led_rte_ecuc_mpc5516: ecu-extract=led_rte_extract, ecu-sw-composition=SwComposition_led_rte_ecuc_mpc5516, module=[EcuM, IoHwAb, Os, Port, Dio, Mcu, Rte]
  ecu sw composition SwComposition_led_rte_ecuc_mpc5516: ecu-extract=led_rte_extract
  module config EcuM
    EcuMGeneral: EcuMDevErrorDetect=false, EcuMIncludeNvramMgr=false, EcuMVersionInfoApi=false, EcuMMainFunctionPeriod=0.2
    EcuMConfiguration: EcuMNvramReadallTimeout=10.0, EcuMRunMinimumDuration=10.0, EcuMNvramWriteallTimeout=10.0
      User_1 (EcuMUserConfig)
  module config IoHwAb
  module config Os
    OsOS:
      OsStackMonitoring = true
      OsStatus = EXTENDED
      OsUseGetServiceId = true
      OsUseParameterAccess = true
      OsUseResScheduler = true
      OsTickFrequency = 100
      OsInterruptStackSize = 2048
      OsIdleStackSize = 512
      OsNumberOfCores = 1
      ArcOsIsrMaxCount = 10
      ArcCoreOsUseDebug = false
      ArcCoreOsDebugTask = false
      ArcCoreOsDebugAlarm = false
      ArcCoreOsDebugResource = false
      ArcCoreOsDebugScheduleTable = false
      ArcCoreOsDebugEvent = false
      OsHooks: OsErrorHook=true, OsPostTaskHook=true, OsPreTaskHook=true, OsProtectionHook=false, OsShutdownHook=true, OsStartupHook=true
    Startup (OsTask): OsTaskActivation=1, OsTaskPriority=1, OsTaskProcessType=BASIC, ArcCoreOsTaskStackSize=2048, OsTaskSchedule=FULL
      OsTaskAutostart
    Scheduled (OsTask): OsTaskActivation=1, OsTaskPriority=1, OsTaskProcessType=EXTENDED, ArcCoreOsTaskStackSize=2048, OsTaskSchedule=FULL, OsTaskEventRef=ScheduleEvent
      OsTaskAutostart
    OsTick (OsCounter): OsCounterMaxAllowedValue=65535, OsCounterMinCycle=1, OsCounterTicksPerBase=0, OsCounterType=OS_TICK
    OsApplication1 (OsApplication): ArcOsAppCoreId=0, OsTrusted=false, OsAppCounterRef=OsTick, OsAppTaskRef=Startup, OsAppTaskRef=Scheduled, OsAppAlarmRef=Alarm1
      OsApplicationHooks: OsAppErrorHook=false, OsAppShutdownHook=false, OsAppStartupHook=false
    Alarm1 (OsAlarm): OsAlarmCounterRef=OsTick
      OsAlarmAutostart: OsAlarmAlarmTime=50, OsAlarmAutostartType=ABSOLUTE, OsAlarmCycleTime=50
      OsAlarmSetEvent: OsAlarmSetEventRef=ScheduleEvent, OsAlarmSetEventTaskRef=Scheduled
    ScheduleEvent (OsEvent): ArcOsEventId=0, ArcOsEventAutoMask=true
  module config Port
    PortConfigSet
      LED_PORT (PortContainer)
        PD[4] (PortPin):
          PortPinPullMode = PULL_NONE
          PortPinDirection = PORT_PIN_OUT
          PortPinDirectionChangeable = false
          PortPinHysteresisEnabled = false
          PortPinOpenDrainEnabled = false
          PortPinId = 52
          PortPinSlewRate = SLEW_RATE_MIN
          PortPinLevelValue = PORT_PIN_LEVEL_LOW
          PortPinMode = PORT_PIN_MODE_DIO
        PD[5] (PortPin):
          PortPinPullMode = PULL_NONE
          PortPinDirection = PORT_PIN_OUT
          PortPinDirectionChangeable = false
          PortPinHysteresisEnabled = false
          PortPinOpenDrainEnabled = false
          PortPinId = 53
          PortPinSlewRate = SLEW_RATE_MIN
          PortPinLevelValue = PORT_PIN_LEVEL_LOW
          PortPinMode = PORT_PIN_MODE_DIO
    PortGeneral: PortDevErrorDetect=true, PortSetPinDirectionApi=true, PortSetPinModeApi=true, PortVersionInfoApi=true
  module config Dio
    DioGeneral: DioDevErrorDetect=true, DioVersionInfoApi=true
    LED_PORT (DioPort): DioPortId=0, ArcCoreDioPhysicalPort=DIO_PORT_D
      LEDS_LED4 (DioChannel): DioChannelId=52
      LEDS_LED5 (DioChannel): DioChannelId=53
  module config Mcu
    McuGeneralConfiguration: McuDevErrorDetect=true, McuPerformResetApi=true, McuVersionInfoApi=true
    McuModuleConfiguration: McuClockSrcFailureNotification=DISABLED, McuNumberOfMcuModes=0, McuRamSectors=1, McuResetSetting=0
      McuClockSettingConfig: McuDefaultClockReference=EXT_REF_80MHZ
        EXT_REF_80MHZ (McuClockReferencePoint): McuClockReferencePointFrequency=8000000.0, McuClockReferencePointPllEprediv=1, McuClockReferencePointPllEmfd=104, McuClockReferencePointPllErfd=5
        EXT_REF_66MHZ (McuClockReferencePoint): McuClockReferencePointFrequency=1.6E7, McuClockReferencePointPllEprediv=3, McuClockReferencePointPllEmfd=83, McuClockReferencePointPllErfd=5
      McuModeSettingConf: McuMode=0
  module config Rte
    RteGeneration:
      RteCalibrationSupport = NONE
      ArcGenerateWeakRunnableStubs = true
      ArcCalibrationFlashStartAddress = 0
      RteGenerationMode = 
      RteMeasurementSupport = false
      RteOptimizationMode = 
      RteVfbTrace = 0
      RteVfbTraceFunction = 
    Blinker_prototypeInstance (SwComponentInstance): ArcGenerationEnabled=true, ImplementationRef=BlinkerImplementation, SoftwareComponentInstanceRef=Blinker_prototype
      BlinkerRunnable_RunnableMapping (RunnableEntityMapping): ActivationOffset=0.0, PositionInTask=0, RTEEventRef=Blinker_timingEvent, MappedToTaskRef=Scheduled, UsedOsEventRef=ScheduleEvent
    led_rte_ecuc_mpc5516_IoHwAbComponentType_prototypeInstance (SwComponentInstance):
      ArcGenerationEnabled = true
      ImplementationRef = led_rte_ecuc_mpc5516_IoHwAbImplementation
      SoftwareComponentInstanceRef = led_rte_ecuc_mpc5516_IoHwAbComponentType_prototype
      4 x RunnableEntityMapping, all with ActivationOffset=0.0, PositionInTask=0:
        IoHwAb_Write_LEDS_LED4_RunnableMapping: RTEEventRef=IoHwAbOpEvent_LEDS_LED4_Write
        IoHwAb_Read_LEDS_LED4_RunnableMapping: RTEEventRef=IoHwAbOpEvent_LEDS_LED4_Read
        IoHwAb_Write_LEDS_LED5_RunnableMapping: RTEEventRef=IoHwAbOpEvent_LEDS_LED5_Write
        IoHwAb_Read_LEDS_LED5_RunnableMapping: RTEEventRef=IoHwAbOpEvent_LEDS_LED5_Read
package /led_rte_ecuc_mpc5516/GeneratedIoHardwareAbstraction
  ecu abstraction component type led_rte_ecuc_mpc5516_IoHwAbComponentType
    provide port LEDS_LED4: provided-interface=DigitalInterface
    provide port LEDS_LED5: provided-interface=DigitalInterface
  internal behavior led_rte_ecuc_mpc5516_IoHwAbBehavior: component=led_rte_ecuc_mpc5516_IoHwAbComponentType
    4 x operation invoked event:
      IoHwAbOpEvent_LEDS_LED4_Write: start-on-event=IoHwAb_Write_LEDS_LED4, operation=LEDS_LED4.Write
      IoHwAbOpEvent_LEDS_LED4_Read: start-on-event=IoHwAb_Read_LEDS_LED4, operation=LEDS_LED4.Read
      IoHwAbOpEvent_LEDS_LED5_Write: start-on-event=IoHwAb_Write_LEDS_LED5, operation=LEDS_LED5.Write
      IoHwAbOpEvent_LEDS_LED5_Read: start-on-event=IoHwAb_Read_LEDS_LED5, operation=LEDS_LED5.Read
    4 x runnable, all with can-be-invoked-concurrently=true:
      IoHwAb_Write_LEDS_LED4
      IoHwAb_Read_LEDS_LED4
      IoHwAb_Write_LEDS_LED5
      IoHwAb_Read_LEDS_LED5
  swc implementation led_rte_ecuc_mpc5516_IoHwAbImplementation: behavior=led_rte_ecuc_mpc5516_IoHwAbBehavior
package /led_rte_ecuc_mpc5516/GeneratedIoHardwareAbstraction/DataTypes
  boolean type BooleanType
package /led_rte_ecuc_mpc5516/GeneratedIoHardwareAbstraction/Interfaces
  client server interface DigitalInterface
    operation Write
      arg Value: type=BooleanType, direction=IN
    operation Read
      arg Value: type=BooleanType, direction=OUT
