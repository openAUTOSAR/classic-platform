AUTOSAR XML (schema 3-1-5)
package /led_rte_ecuc_mpc5516
  ecu configuration led_rte_ecuc_mpc5516: ecu-extract=led_rte_extract, ecu-sw-composition=SwComposition_led_rte_ecuc_mpc5516, module=[EcuM, IoHwAb, Os, Port, Dio, Mcu, Rte, Det]
  ecu sw composition SwComposition_led_rte_ecuc_mpc5516: ecu-extract=led_rte_extract
  module config EcuM
    EcuMGeneral: EcuMDevErrorDetect=false, EcuMIncludeNvramMgr=false, EcuMVersionInfoApi=false, EcuMMainFunctionPeriod=0.2
    EcuMConfiguration: EcuMNvramReadallTimeout=10.0, EcuMRunMinimumDuration=10.0, EcuMNvramWriteallTimeout=10.0
      User_1 (EcuMUserConfig)
      EcuMDefaultShutdownTarget: EcuMDefaultState=EcuMStateReset, EcuMDefaultSleepModeRef=(unset)
      EcuMSleepMode: EcuMSleepModeId=0, EcuMSleepModeSuspend=false, EcuMSleepModeMcuModeRef=SLEEP, EcuMWakeupSourceMask=EcuMWakeupSource
      EcuMWakeupSource: EcuMResetReason=0, EcuMValidationTimeout=0.0, EcuMWakeupSourceId=0, EcuMWakeupSourcePolling=false
  module config IoHwAb
    IoHwAbGeneral: IoHwAbDevErrorDetect=true, IoHwAbUseRte=false, IoHwAbAnalogMaxVoltage=5.0
    DigitalSignal_Led4 (IoHwAbDigitalSignal):
      IoHwAbDigitalMethod = IOHWAB_DIGITAL_WRITE
      IoHwAbDigitalInverted = false
      IoHwAbDigitalDefaultValue = IOHWAB_LOW
      IoHwAbDigitalType = IOHWAB_DIO
      IoHwAbDioChannelRef = LEDS_LED4
  module config Os
    OsOS:
      OsStackMonitoring = true
      OsStatus = EXTENDED
      OsUseGetServiceId = true
      OsUseParameterAccess = true
      OsUseResScheduler = true
      OsTickFrequency = 100
      OsInterruptStackSize = 2048
      OsIdleStackSize = 512
      OsNumberOfCores = 1
      ArcOsIsrMaxCount = 10
      ArcCoreOsUseDebug = false
      ArcCoreOsDebugTask = false
      ArcCoreOsDebugAlarm = false
      ArcCoreOsDebugResource = false
      ArcCoreOsDebugScheduleTable = false
      ArcCoreOsDebugEvent = false
      OsHooks: OsErrorHook=true, OsPostTaskHook=true, OsPreTaskHook=true, OsProtectionHook=false, OsShutdownHook=true, OsStartupHook=true
    Startup (OsTask): OsTaskActivation=1, OsTaskPriority=1, OsTaskProcessType=BASIC, ArcCoreOsTaskStackSize=2048, OsTaskSchedule=FULL
      OsTaskAutostart
    Scheduled (OsTask): OsTaskActivation=1, OsTaskPriority=1, OsTaskProcessType=EXTENDED, ArcCoreOsTaskStackSize=2048, OsTaskSchedule=FULL, OsTaskEventRef=ScheduleEvent
      OsTaskAutostart
    OsTick (OsCounter): OsCounterMaxAllowedValue=65535, OsCounterMinCycle=1, OsCounterTicksPerBase=0, OsCounterType=OS_TICK
    OsApplication1 (OsApplication): ArcOsAppCoreId=0, OsTrusted=false, OsAppCounterRef=OsTick, OsAppTaskRef=Startup, OsAppTaskRef=Scheduled, OsAppAlarmRef=Alarm1
      OsApplicationHooks: OsAppErrorHook=false, OsAppShutdownHook=false, OsAppStartupHook=false
    Alarm1 (OsAlarm): OsAlarmCounterRef=OsTick
      OsAlarmAutostart: OsAlarmAlarmTime=50, OsAlarmAutostartType=ABSOLUTE, OsAlarmCycleTime=50
      OsAlarmSetEvent: OsAlarmSetEventRef=ScheduleEvent, OsAlarmSetEventTaskRef=Scheduled
    ScheduleEvent (OsEvent): ArcOsEventId=0, ArcOsEventAutoMask=true
  module config Port
    PortConfigSet
      LED_PORT (PortContainer)
        PD[4] (PortPin):
          PortPinPullMode = PULL_NONE
          PortPinDirection = PORT_PIN_OUT
          PortPinDirectionChangeable = false
          PortPinHysteresisEnabled = false
          PortPinOpenDrainEnabled = false
          PortPinId = 52
          PortPinSlewRate = SLEW_RATE_MIN
          PortPinLevelValue = PORT_PIN_LEVEL_LOW
          PortPinMode = PORT_PIN_MODE_DIO
        PD[5] (PortPin):
          PortPinPullMode = PULL_NONE
          PortPinDirection = PORT_PIN_OUT
          PortPinDirectionChangeable = false
          PortPinHysteresisEnabled = false
          PortPinOpenDrainEnabled = false
          PortPinId = 53
          PortPinSlewRate = SLEW_RATE_MIN
          PortPinLevelValue = PORT_PIN_LEVEL_LOW
          PortPinMode = PORT_PIN_MODE_DIO
    PortGeneral: PortDevErrorDetect=true, PortSetPinDirectionApi=true, PortSetPinModeApi=true, PortVersionInfoApi=true
  module config Dio
    DioGeneral: DioDevErrorDetect=true, DioVersionInfoApi=true
    LED_PORT (DioPort): DioPortId=0, ArcCoreDioPhysicalPort=DIO_PORT_D
      LEDS_LED4 (DioChannel): DioChannelId=52
      LEDS_LED5 (DioChannel): DioChannelId=53
  module config Mcu
    McuGeneralConfiguration: McuDevErrorDetect=true, McuPerformResetApi=true, McuVersionInfoApi=true
    McuModuleConfiguration: McuClockSrcFailureNotification=DISABLED, McuNumberOfMcuModes=0, McuRamSectors=1, McuResetSetting=0
      McuClockSettingConfig: McuDefaultClockReference=EXT_REF_80MHZ
        EXT_REF_80MHZ (McuClockReferencePoint): McuClockReferencePointFrequency=8000000.0, McuClockReferencePointPllEprediv=1, McuClockReferencePointPllEmfd=104, McuClockReferencePointPllErfd=5
        EXT_REF_66MHZ (McuClockReferencePoint): McuClockReferencePointFrequency=1.6E7, McuClockReferencePointPllEprediv=3, McuClockReferencePointPllEmfd=83, McuClockReferencePointPllErfd=5
      RUN (McuModeSettingConf): McuMode=0
      SLEEP (McuModeSettingConf): McuMode=0
  module config Rte
    RteGeneration:
      RteCalibrationSupport = NONE
      ArcGenerateWeakRunnableStubs = false
      ArcCalibrationFlashStartAddress = 0
      RteGenerationMode = 
      RteMeasurementSupport = false
      RteOptimizationMode = 
      RteVfbTrace = 0
      RteVfbTraceFunction = 
    Blinker_prototypeInstance (SwComponentInstance): ArcGenerationEnabled=true, ImplementationRef=BlinkerImplementation, SoftwareComponentInstanceRef=Blinker_prototype
      BlinkerRunnable_RunnableMapping (RunnableEntityMapping): ActivationOffset=0.0, PositionInTask=0, RTEEventRef=Blinker_timingEvent, MappedToTaskRef=Scheduled, UsedOsEventRef=ScheduleEvent
    EcuAbstraction_prototypeInstance (SwComponentInstance): ArcGenerationEnabled=true, ImplementationRef=EcuAbstractionImplementation, SoftwareComponentInstanceRef=EcuAbstraction_prototype
      DigitalOutput_Set_RunnableMapping (RunnableEntityMapping): ActivationOffset=0.0, PositionInTask=0, RTEEventRef=DigitalSignal_Led4_Set_oie
      DigitalOutput_ReadBack_RunnableMapping (RunnableEntityMapping): ActivationOffset=0.0, PositionInTask=0, RTEEventRef=DigitalSignal_Led4_ReadBack_oie
  module config Det
    DetGeneral: DetEnableCallbacks=false, DetUseRamlog=true, DetWrapRamlog=true, DetUseStdErr=false, DetDeInitAPI=false, DetNumberOfCallbacks=5, DetRamlogSize=16
package /led_rte_ecuc_mpc5516/GeneratedIoHardwareAbstraction
  ecu abstraction component type EcuAbstraction
    provide port DigitalSignal_Led4: provided-interface=DigitalOutput
  internal behavior EcuAbstractionBehaviour: component=EcuAbstraction
    operation invoked event DigitalSignal_Led4_Set_oie: start-on-event=DigitalOutput_Set, operation=DigitalSignal_Led4.Set
    operation invoked event DigitalSignal_Led4_ReadBack_oie: start-on-event=DigitalOutput_ReadBack, operation=DigitalSignal_Led4.ReadBack
    port-api-option port=DigitalSignal_Led4:
      port-arg-values:
        integer literal SignalId: type=IoHwAb_SignalType, value=0
    runnable DigitalOutput_Set: can-be-invoked-concurrently=true
    runnable DigitalOutput_ReadBack: can-be-invoked-concurrently=true
  swc implementation EcuAbstractionImplementation: programming-language=C, behavior=EcuAbstractionBehaviour
  integer type IoHwAb_SignalType: lower-limit=0, upper-limit=65535
