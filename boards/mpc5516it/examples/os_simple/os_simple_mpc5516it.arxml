AUTOSAR XML (schema 3-1-5)
package /os_simple_mpc5516it
  ecu configuration os_simple_mpc5516it: ecu-sw-composition=SwComposition_os_simple_mpc5516it, module=[Dio, Mcu, Os, Port, Det, EcuM]
  ecu sw composition SwComposition_os_simple_mpc5516it
  module config Dio
    DioGeneral: DioDevErrorDetect=true, DioVersionInfoApi=true
    LED_PORT (DioPort): DioPortId=0, ArcCoreDioPhysicalPort=DIO_PORT_D
      LEDS_LED4 (DioChannel): DioChannelId=52
      LEDS_LED5 (DioChannel): DioChannelId=53
      LED_GRP_PTR (DioChannelGroup): DioPortMask=48, DioPortOffset=0
  module config Mcu
    McuGeneralConfiguration: McuDevErrorDetect=true, McuPerformResetApi=true, McuVersionInfoApi=true
    McuModuleConfiguration: McuClockSrcFailureNotification=DISABLED, McuNumberOfMcuModes=0, McuRamSectors=1, McuResetSetting=0
      McuClockSettingConfig: McuDefaultClockReference=EXT_REF_80MHZ
        EXT_REF_80MHZ (McuClockReferencePoint): McuClockReferencePointFrequency=8000000.0, McuClockReferencePointPllEprediv=1, McuClockReferencePointPllEmfd=104, McuClockReferencePointPllErfd=5
        EXT_REF_66MHZ (McuClockReferencePoint): McuClockReferencePointFrequency=1.6E7, McuClockReferencePointPllEprediv=3, McuClockReferencePointPllEmfd=83, McuClockReferencePointPllErfd=5
      RUN (McuModeSettingConf): McuMode=0
      SLEEP (McuModeSettingConf): McuMode=0
  module config Os
    OsOS:
      OsStackMonitoring = true
      OsStatus = EXTENDED
      OsUseGetServiceId = true
      OsUseParameterAccess = true
      OsUseResScheduler = true
      OsTickFrequency = 1000
      OsInterruptStackSize = 2048
      OsIdleStackSize = 512
      ArcCoreOsUseDebug = false
      ArcCoreOsDebugTask = false
      ArcCoreOsDebugAlarm = false
      ArcCoreOsDebugResource = false
      ArcCoreOsDebugScheduleTable = false
      ArcCoreOsDebugEvent = false
      ArcOsIsrMaxCount = 10
      OsNumberOfCores = 1
      OsHooks: OsErrorHook=true, OsPostTaskHook=true, OsPreTaskHook=true, OsProtectionHook=false, OsShutdownHook=true, OsStartupHook=true
    Alarm1 (OsAlarm): OsAlarmCounterRef=Counter1
      OsAlarmAction
        OsAlarmSetEvent: OsAlarmSetEventRef=Event1, OsAlarmSetEventTaskRef=eTask2
      OsAlarmAutostart: OsAlarmAlarmTime=100, OsAlarmAutostartType=RELATIVE, OsAlarmCycleTime=100
      OsAlarmSetEvent: OsAlarmSetEventRef=Event1, OsAlarmSetEventTaskRef=eTask1
    3 x OsTask, all with OsTaskActivation=1, OsTaskPriority=1, ArcCoreOsTaskStackSize=2048, OsTaskSchedule=FULL:
      bTask3: OsTaskProcessType=BASIC
      eTask1: OsTaskProcessType=EXTENDED, OsTaskEventRef=Event1
        OsTaskAutostart
      eTask2: OsTaskProcessType=EXTENDED, OsTaskEventRef=Event2
        OsTaskAutostart
    Event1 (OsEvent): OsEventMask=1, ArcOsEventAutoMask=true, ArcOsEventId=0
    Event2 (OsEvent): OsEventMask=2, ArcOsEventAutoMask=true, ArcOsEventId=0
    OsApplication1 (OsApplication): ArcOsAppCoreId=0, OsTrusted=false, OsAppAlarmRef=Alarm1, OsAppTaskRef=bTask3, OsAppTaskRef=eTask1, OsAppTaskRef=eTask2, OsAppCounterRef=Counter1
      OsApplicationHooks: OsAppErrorHook=false, OsAppShutdownHook=false, OsAppStartupHook=false
    Counter1 (OsCounter): OsCounterMaxAllowedValue=65535, OsCounterMinCycle=1, OsCounterTicksPerBase=0, OsCounterType=OS_TICK
  module config Port
    PortConfigSet
      PortContainer_1 (PortContainer)
        19 x PortPin, all with PortPinDirectionChangeable=false, PortPinHysteresisEnabled=false, PortPinOpenDrainEnabled=false, PortPinLevelValue=PORT_PIN_LEVEL_LOW:
          CNTX_A: PortPinPullMode=PULL_NONE, PortPinDirection=PORT_PIN_OUT, PortPinId=48, PortPinSlewRate=SLEW_RATE_MIN, PortPinMode=PORT_PIN_MODE_CAN
          CNRX_A: PortPinPullMode=PULL_NONE, PortPinDirection=PORT_PIN_IN, PortPinId=49, PortPinSlewRate=SLEW_RATE_MIN, PortPinMode=PORT_PIN_MODE_CAN
          BOOTCFG: PortPinPullMode=PULL_NONE, PortPinDirection=PORT_PIN_IN, PortPinId=50, PortPinSlewRate=SLEW_RATE_MIN, PortPinMode=PORT_PIN_MODE_OTHER
          PD[4]_LED: PortPinPullMode=PULL_NONE, PortPinDirection=PORT_PIN_OUT, PortPinId=52, PortPinSlewRate=SLEW_RATE_MIN, PortPinMode=PORT_PIN_MODE_DIO
          PD[5]_LED: PortPinPullMode=PULL_NONE, PortPinDirection=PORT_PIN_OUT, PortPinId=53, PortPinSlewRate=SLEW_RATE_MIN, PortPinMode=PORT_PIN_MODE_DIO
          TXD_B_LIN: PortPinPullMode=PULL_NONE, PortPinDirection=PORT_PIN_OUT, PortPinId=56, PortPinSlewRate=SLEW_RATE_MIN, PortPinMode=PORT_PIN_MODE_OTHER
          RXD_B_LIN: PortPinPullMode=PULL_NONE, PortPinDirection=PORT_PIN_IN, PortPinId=57, PortPinSlewRate=SLEW_RATE_MIN, PortPinMode=PORT_PIN_MODE_OTHER
          PCS_B[0]_SPI: PortPinPullMode=PULL_NONE, PortPinDirection=PORT_PIN_OUT, PortPinId=60, PortPinSlewRate=SLEW_RATE_MAX, PortPinMode=PORT_PIN_MODE_SPI
          SCK_B_SPI: PortPinPullMode=PULL_NONE, PortPinDirection=PORT_PIN_OUT, PortPinId=61, PortPinSlewRate=SLEW_RATE_MAX, PortPinMode=PORT_PIN_MODE_SPI
          SOUT_B_SPI: PortPinPullMode=PULL_NONE, PortPinDirection=PORT_PIN_OUT, PortPinId=62, PortPinSlewRate=SLEW_RATE_MAX, PortPinMode=PORT_PIN_MODE_SPI
          SIN_B_SPI: PortPinPullMode=PULL_NONE, PortPinDirection=PORT_PIN_IN, PortPinId=63, PortPinSlewRate=SLEW_RATE_MIN, PortPinMode=PORT_PIN_MODE_SPI
          PCS_A[2]_SPI: PortPinPullMode=PULL_NONE, PortPinDirection=PORT_PIN_OUT, PortPinId=64, PortPinSlewRate=SLEW_RATE_MIN, PortPinMode=PORT_PIN_MODE_SPI
          PCS_A[1]_SPI: PortPinPullMode=PULL_NONE, PortPinDirection=PORT_PIN_OUT, PortPinId=65, PortPinSlewRate=SLEW_RATE_MIN, PortPinMode=PORT_PIN_MODE_SPI
          SCK_A_SPI: PortPinPullMode=PULL_NONE, PortPinDirection=PORT_PIN_OUT, PortPinId=67, PortPinSlewRate=SLEW_RATE_MAX, PortPinMode=PORT_PIN_MODE_SPI
          SOUT_A_LIN: PortPinPullMode=PULL_NONE, PortPinDirection=PORT_PIN_OUT, PortPinId=68, PortPinSlewRate=SLEW_RATE_MAX, PortPinMode=PORT_PIN_MODE_SPI
          SIN_A_LIN: PortPinPullMode=PULL_NONE, PortPinDirection=PORT_PIN_IN, PortPinId=69, PortPinSlewRate=SLEW_RATE_MIN, PortPinMode=PORT_PIN_MODE_SPI
          TXD_D_SCI: PortPinPullMode=PULL_UP, PortPinDirection=PORT_PIN_OUT, PortPinId=92, PortPinSlewRate=SLEW_RATE_MIN, PortPinMode=PORT_PIN_MODE_OTHER
          RXD_D_SCI: PortPinPullMode=PULL_UP, PortPinDirection=PORT_PIN_IN, PortPinId=93, PortPinSlewRate=SLEW_RATE_MIN, PortPinMode=PORT_PIN_MODE_OTHER
          eMIOS[17]: PortPinPullMode=PULL_UP, PortPinDirection=PORT_PIN_IN, PortPinId=97, PortPinSlewRate=SLEW_RATE_MIN, PortPinMode=PORT_PIN_MODE_ICU
    PortGeneral: PortDevErrorDetect=true, PortSetPinDirectionApi=true, PortSetPinModeApi=false, PortVersionInfoApi=true
  module config Det
    DetGeneral: DetEnableCallbacks=false, DetUseRamlog=true, DetWrapRamlog=true, DetUseStdErr=false, DetDeInitAPI=false, DetNumberOfCallbacks=5, DetRamlogSize=16
  module config EcuM
    EcuMGeneral: EcuMDevErrorDetect=true, EcuMIncludeNvramMgr=false, EcuMVersionInfoApi=true, EcuMMainFunctionPeriod=0.2
    EcuMConfiguration: EcuMNvramReadallTimeout=10.0, EcuMRunMinimumDuration=10.0, EcuMNvramWriteallTimeout=10.0
      EcuMUserConfig
      EcuMDefaultShutdownTarget: EcuMDefaultState=EcuMStateReset, EcuMDefaultSleepModeRef=(unset)
      EcuMSleepMode: EcuMSleepModeId=0, EcuMSleepModeSuspend=false, EcuMSleepModeMcuModeRef=SLEEP, EcuMWakeupSourceMask=EcuMWakeupSource
      EcuMWakeupSource: EcuMResetReason=0, EcuMValidationTimeout=0.0, EcuMWakeupSourceId=0, EcuMWakeupSourcePolling=false
