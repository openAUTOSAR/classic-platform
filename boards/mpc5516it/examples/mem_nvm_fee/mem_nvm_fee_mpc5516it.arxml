AUTOSAR XML (schema 3-2-1)
package /nvm_05_fls_mpc5516it
  ecu configuration nvm_05_fls_mpc5516it: ecu-sw-composition=SwComposition_nvm_05_fls_mpc5516it, module=[Dio, EcuM, Mcu, Port, NvM, Fee, MemIf, Os]
  ecu sw composition SwComposition_nvm_05_fls_mpc5516it
  module config NvM
    block_1_dataset (NvmBlockDescriptor):
      NvmBlockCRCType = NVM_CRC16
      NvmBlockJobPriority = 0
      NvmBlockManagementType = NVM_BLOCK_DATASET
      NvmBlockUseCrc = true
      NvmBlockWriteProt = false
      NvmCalcRamBlockCrc = false
      NvmInitBlockCallback = 
      NvmNvBlockBaseNumber = 2
      NvmNvBlockLength = 20
      NvmNvBlockNum = 2
      NvmNvramBlockIdentifier = 0
      NvmNvramDeviceId = 0
      NvmRamBlockDataAddress = 
      NvmResistantToChangedSw = false
      NvmRomBlockDataAddress = 
      NvmRomBlockNum = 0
      NvmSelectBlockForReadall = false
      NvmSingleBlockCallback = 
      NvmWriteBlockOnce = false
      NvmBlockCbkUsePort = false
      NvmFeeRef: NvmNameOfFeeBlock=Fee_Block_1
    NvmCommon:
      NvmApiConfigClass = NVM_API_CONFIG_CLASS_2
      NvmCompiledConfigId = 0
      NvmCrcNumOfBytes = 10
      NvmDatasetSelectionBits = 1
      NvmDevErrorDetect = false
      NvmDrvModeSwitch = false
      NvmDynamicConfiguration = false
      NvmJobPrioritization = false
      NvmMaxNoOfWriteRetries = 2
      NvmMultiBlockCallback = TEST_MultiBlockCallback
      NvmPollingMode = false
      NvmSetRamBlockStatusApi = true
      NvmSizeImmediateJobQueue = 0
      NvmSizeStandardJobQueue = 4
      NvmVersionInfoApi = false
  module config Fee
    Fee_Block_1 (FeeBlockConfiguration): FeeBlockNumber=2, FeeBlockSize=22, FeeImmediateData=false, FeeNumberOfWriteCycles=0
    FeeGeneral:
      FeeDevErrorDetect = false
      FeeIndex = 0
      ArcUseJobNotifications = true
      FeePollingMode = true
      FeeVersionInfoApi = false
      FeeVirtualPageSize = 16
      ArcFeeBank1Size = 16384
      ArcFeeBank2Size = 16384
      ArcFeeBank2Offset = 49152
      ArcFeeBank1Offset = 32768
    FeePublishedInformation: FeeBlockOverhead=0, FeeMaximumBlockingTime=0.0, FeePageOverhead=0
    Fee_Block_2 (FeeBlockConfiguration): FeeBlockNumber=3, FeeBlockSize=22, FeeImmediateData=false, FeeNumberOfWriteCycles=0
  module config MemIf
    MemIfGeneral: MemIfDevErrorDetect=false, MemIfNumberOfDevices=0, MemIfVersionInfoApi=false
  module config Os
    OsOS:
      OsStackMonitoring = true
      OsStatus = EXTENDED
      OsUseGetServiceId = true
      OsUseParameterAccess = true
      OsUseResScheduler = true
      OsTickFrequency = 100
      OsInterruptStackSize = 2048
      OsIdleStackSize = 512
      OsNumberOfCores = 1
      ArcOsIsrMaxCount = 10
      ArcCoreOsUseDebug = false
      ArcCoreOsDebugTask = false
      ArcCoreOsDebugAlarm = false
      ArcCoreOsDebugResource = false
      ArcCoreOsDebugScheduleTable = false
      ArcCoreOsDebugEvent = false
      OsHooks: OsErrorHook=true, OsPostTaskHook=true, OsPreTaskHook=true, OsProtectionHook=false, OsShutdownHook=true, OsStartupHook=true
    OsApplication1 (OsApplication):
      ArcOsAppCoreId = 0
      OsTrusted = false
      OsAppCounterRef = Counter1
      OsAppTaskRef = Task_Startup
      OsAppTaskRef = Task_BswService
      OsAppTaskRef = Task_BswServiceMem
      OsAppAlarmRef = Alarm_BswService
      OsAppAlarmRef = Alarm_BswServiceMem
      OsAppTaskRef = Task_Application
      OsApplicationHooks: OsAppErrorHook=false, OsAppShutdownHook=false, OsAppStartupHook=false
    Task_Startup (OsTask): OsTaskActivation=1, OsTaskPriority=3, OsTaskProcessType=EXTENDED, ArcCoreOsTaskStackSize=2048, OsTaskSchedule=FULL
      OsTaskAutostart
    Counter1 (OsCounter): OsCounterMaxAllowedValue=65535, OsCounterMinCycle=1, OsCounterTicksPerBase=0, OsCounterType=OS_TICK
    Task_BswServiceMem (OsTask): OsTaskActivation=10, OsTaskPriority=4, OsTaskProcessType=BASIC, ArcCoreOsTaskStackSize=2048, OsTaskSchedule=FULL
    Task_BswService (OsTask): OsTaskActivation=1, OsTaskPriority=4, OsTaskProcessType=BASIC, ArcCoreOsTaskStackSize=2048, OsTaskSchedule=FULL
    Alarm_BswService (OsAlarm): OsAlarmCounterRef=Counter1
      OsAlarmActivateTask: OsAlarmActivateTaskRef=Task_BswService
    Alarm_BswServiceMem (OsAlarm): OsAlarmCounterRef=Counter1
      OsAlarmActivateTask: OsAlarmActivateTaskRef=Task_BswServiceMem
    Task_Application (OsTask): OsTaskActivation=1, OsTaskPriority=1, OsTaskProcessType=EXTENDED, ArcCoreOsTaskStackSize=2048, OsTaskSchedule=FULL
